VERSION ""

NS_ :

BS_:

BU_: Abgasnachbehandlung EGRValvePosition ExhaustGasTemperature

BO_ 444 EGRValve_Position: 2 EGRValvePosition
 SG_ AGRVentilstellung : 0|10@1+ (0.1,0.0) [0.0|100.0] "%"  Abgasnachbehandlung

BO_ 453 Exhaust_Gas_Temperature: 2 ExhaustGasTemperature
 SG_ Abgastemperatur : 0|11@1+ (1,0) [0.0|1100.0] "degC"  Abgasnachbehandlung

CM_ BO_ 444 "CanonicalMessage=69bfe0bb-f78a-40dc-a1a4-aa37a1b01947; Network=Antriebsstrang_01-IO-abgasnachbehandlung-can-fd-S01; Technology=can_fd";
CM_ SG_ 444 AGRVentilstellung "CanonicalSignal=16e07855-e35c-4e01-b1a9-5e85ac4ea43f";
CM_ BO_ 453 "CanonicalMessage=185d7882-72ef-4c00-9052-466ea6de32be; Network=Antriebsstrang_01-IO-abgasnachbehandlung-can-fd-S01; Technology=can_fd";
CM_ SG_ 453 Abgastemperatur "CanonicalSignal=c8756c53-3481-4cb3-87af-93e7dc985196";
BA_DEF_ BO_  "VFrameFormat" ENUM  "StandardCAN","ExtendedCAN","StandardCAN_FD","ExtendedCAN_FD";
BA_DEF_DEF_  "VFrameFormat" "0";
BA_ "VFrameFormat" BO_ 444 2;
BA_ "VFrameFormat" BO_ 453 2;
