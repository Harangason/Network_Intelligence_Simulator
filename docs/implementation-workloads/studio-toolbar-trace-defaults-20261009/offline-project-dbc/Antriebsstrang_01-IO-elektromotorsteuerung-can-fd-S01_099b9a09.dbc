VERSION ""

NS_ :

BS_:

BU_: Elektromotorsteuerung MotorCurrent MotorSpeed MotorTemperature

BO_ 559 Motor_Temperature: 2 MotorTemperature
 SG_ Motortemperatur : 0|12@1- (0.1,0.0) [-40.0|200.0] "degC"  Elektromotorsteuerung

BO_ 554 Motor_Current: 2 MotorCurrent
 SG_ Motorstrom : 0|15@1- (0.1,0.0) [-1500.0|1500.0] "A"  Elektromotorsteuerung

BO_ 555 Motor_Speed: 2 MotorSpeed
 SG_ Elektromotordrehzahl : 0|16@1- (1,0) [-20000.0|20000.0] "rpm"  Elektromotorsteuerung

CM_ BO_ 559 "CanonicalMessage=e165f08a-2b12-4956-a46f-52cfa8a4acd9; Network=Antriebsstrang_01-IO-elektromotorsteuerung-can-fd-S01; Technology=can_fd";
CM_ SG_ 559 Motortemperatur "CanonicalSignal=5a3474c5-2990-4540-a65a-282dfbd97bbe";
CM_ BO_ 554 "CanonicalMessage=95aa353a-8a93-4c94-aee2-9a30c725026f; Network=Antriebsstrang_01-IO-elektromotorsteuerung-can-fd-S01; Technology=can_fd";
CM_ SG_ 554 Motorstrom "CanonicalSignal=a9f6132a-8569-42fd-95ac-f0fe513bce69";
CM_ BO_ 555 "CanonicalMessage=f6dc3805-c645-41e9-981f-94a2da3b8469; Network=Antriebsstrang_01-IO-elektromotorsteuerung-can-fd-S01; Technology=can_fd";
CM_ SG_ 555 Elektromotordrehzahl "CanonicalSignal=fefa07e5-780f-45d9-99e4-ecc2b7702185";
BA_DEF_ BO_  "VFrameFormat" ENUM  "StandardCAN","ExtendedCAN","StandardCAN_FD","ExtendedCAN_FD";
BA_DEF_DEF_  "VFrameFormat" "0";
BA_ "VFrameFormat" BO_ 559 2;
BA_ "VFrameFormat" BO_ 554 2;
BA_ "VFrameFormat" BO_ 555 2;
