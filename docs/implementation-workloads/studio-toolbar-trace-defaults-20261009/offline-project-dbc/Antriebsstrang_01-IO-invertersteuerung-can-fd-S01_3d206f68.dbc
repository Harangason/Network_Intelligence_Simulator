VERSION ""

NS_ :

BS_:

BU_: DCLinkVoltage InverterTemperature Invertersteuerung

BO_ 436 DCLink_Voltage: 2 DCLinkVoltage
 SG_ Zwischenkreisspannung : 0|14@1+ (0.1,0.0) [0.0|1200.0] "V"  Invertersteuerung

BO_ 522 Inverter_Temperature: 2 InverterTemperature
 SG_ Invertertemperatur : 0|12@1- (0.1,0.0) [-40.0|180.0] "degC"  Invertersteuerung

CM_ BO_ 436 "CanonicalMessage=a647a49b-7481-4164-8f98-0d2c0542f6df; Network=Antriebsstrang_01-IO-invertersteuerung-can-fd-S01; Technology=can_fd";
CM_ SG_ 436 Zwischenkreisspannung "CanonicalSignal=c370ecb0-0054-4dcc-bc54-ad81fda5abab";
CM_ BO_ 522 "CanonicalMessage=69866ca4-f52d-4e13-b461-38fe4f450202; Network=Antriebsstrang_01-IO-invertersteuerung-can-fd-S01; Technology=can_fd";
CM_ SG_ 522 Invertertemperatur "CanonicalSignal=4bf05979-3e15-4af1-9d61-83f11b379791";
BA_DEF_ BO_  "VFrameFormat" ENUM  "StandardCAN","ExtendedCAN","StandardCAN_FD","ExtendedCAN_FD";
BA_DEF_DEF_  "VFrameFormat" "0";
BA_ "VFrameFormat" BO_ 436 2;
BA_ "VFrameFormat" BO_ 522 2;
