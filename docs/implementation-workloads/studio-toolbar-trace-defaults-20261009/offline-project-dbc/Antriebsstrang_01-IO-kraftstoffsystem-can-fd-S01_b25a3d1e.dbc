VERSION ""

NS_ :

BS_:

BU_: FuelPressure Kraftstoffsystem

BO_ 498 Fuel_Pressure: 2 FuelPressure
 SG_ Kraftstoffdruck : 0|15@1+ (0.1,0.0) [0.0|2500.0] "bar"  Kraftstoffsystem

CM_ BO_ 498 "CanonicalMessage=1668008e-61f1-412e-a9e9-43b9847e466e; Network=Antriebsstrang_01-IO-kraftstoffsystem-can-fd-S01; Technology=can_fd";
CM_ SG_ 498 Kraftstoffdruck "CanonicalSignal=493d8334-1409-4483-8d73-34fbc850300a";
BA_DEF_ BO_  "VFrameFormat" ENUM  "StandardCAN","ExtendedCAN","StandardCAN_FD","ExtendedCAN_FD";
BA_DEF_DEF_  "VFrameFormat" "0";
BA_ "VFrameFormat" BO_ 498 2;
