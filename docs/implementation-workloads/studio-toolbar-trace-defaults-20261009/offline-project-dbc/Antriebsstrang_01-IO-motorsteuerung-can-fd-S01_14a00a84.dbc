VERSION ""

NS_ :

BS_:

BU_: AcceleratorPosition BoostPressure CoolantTemperature EngineOilPressure EngineSpeed Motorsteuerung OilTemperature ThrottlePosition TurboSpeed

BO_ 452 Engine_Speed: 2 EngineSpeed
 SG_ Motordrehzahl : 0|14@1+ (1,0) [0.0|9000.0] "rpm"  Motorsteuerung

BO_ 451 Engine_Oil_Pressure: 2 EngineOilPressure
 SG_ Motoroeldruck : 0|11@1+ (0.01,0.0) [0.0|12.0] "bar"  Motorsteuerung

BO_ 561 Oil_Temperature: 2 OilTemperature
 SG_ Oeltemperatur : 0|12@1- (0.1,0.0) [-40.0|180.0] "degC"  Motorsteuerung

BO_ 617 Throttle_Position: 2 ThrottlePosition
 SG_ Drosselklappenstellung : 0|10@1+ (0.1,0.0) [0.0|100.0] "%"  Motorsteuerung

BO_ 419 Boost_Pressure: 2 BoostPressure
 SG_ Ladedruck : 0|12@1+ (0.1,0.0) [0.0|400.0] "kPa"  Motorsteuerung

BO_ 621 Turbo_Speed: 2 TurboSpeed
 SG_ Turboladerdrehzahl : 0|15@1+ (10,0) [0.0|250000.0] "rpm"  Motorsteuerung

BO_ 387 Accelerator_Position: 2 AcceleratorPosition
 SG_ Fahrpedalstellung : 0|10@1+ (0.1,0.0) [0.0|100.0] "%"  Motorsteuerung

BO_ 432 Coolant_Temperature: 2 CoolantTemperature
 SG_ Kuehlmitteltemperatur : 0|12@1- (0.1,0.0) [-40.0|150.0] "degC"  Motorsteuerung

CM_ BO_ 452 "CanonicalMessage=6f366c28-0047-4cc7-a9f8-fca3c1a95096; Network=Antriebsstrang_01-IO-motorsteuerung-can-fd-S01; Technology=can_fd";
CM_ SG_ 452 Motordrehzahl "CanonicalSignal=801994c8-50e0-4e07-9ae3-85d66ec4f026";
CM_ BO_ 451 "CanonicalMessage=b938c634-db3e-4b75-aeed-5e75f1f521d2; Network=Antriebsstrang_01-IO-motorsteuerung-can-fd-S01; Technology=can_fd";
CM_ SG_ 451 Motoroeldruck "CanonicalSignal=3cc4b998-0c4e-4f57-9bad-5b61acf26784";
CM_ BO_ 561 "CanonicalMessage=fa4c303b-1c12-4e18-a094-dff743ecdd88; Network=Antriebsstrang_01-IO-motorsteuerung-can-fd-S01; Technology=can_fd";
CM_ SG_ 561 Oeltemperatur "CanonicalSignal=6472f4c2-3572-4baf-b5cb-9995b1ebfe96";
CM_ BO_ 617 "CanonicalMessage=c2c7052c-39d7-4ed1-b5df-de9057e77bf6; Network=Antriebsstrang_01-IO-motorsteuerung-can-fd-S01; Technology=can_fd";
CM_ SG_ 617 Drosselklappenstellung "CanonicalSignal=cb09a9ca-1078-43cf-a0b0-917f6ca6a752";
CM_ BO_ 419 "CanonicalMessage=c1f5e54e-f464-41a9-b86b-48a6d8a6ea75; Network=Antriebsstrang_01-IO-motorsteuerung-can-fd-S01; Technology=can_fd";
CM_ SG_ 419 Ladedruck "CanonicalSignal=ccb69c3d-4dd4-40f9-bab6-184dde9a32ba";
CM_ BO_ 621 "CanonicalMessage=9aa5e722-a70f-47ea-b356-3c4ed1bd4352; Network=Antriebsstrang_01-IO-motorsteuerung-can-fd-S01; Technology=can_fd";
CM_ SG_ 621 Turboladerdrehzahl "CanonicalSignal=0ffbd56a-c7a3-4599-9a2b-8cc4bce77da6";
CM_ BO_ 387 "CanonicalMessage=73a8c983-e6a3-4f69-9e96-c4449eaf9766; Network=Antriebsstrang_01-IO-motorsteuerung-can-fd-S01; Technology=can_fd";
CM_ SG_ 387 Fahrpedalstellung "CanonicalSignal=cc7f5bc2-61c6-4b15-b11b-2a241b746ebe";
CM_ BO_ 432 "CanonicalMessage=18ae3bdc-6765-47d9-aebb-fc013569a170; Network=Antriebsstrang_01-IO-motorsteuerung-can-fd-S01; Technology=can_fd";
CM_ SG_ 432 Kuehlmitteltemperatur "CanonicalSignal=ca5548e9-0072-4227-90b4-769be910a309";
BA_DEF_ BO_  "VFrameFormat" ENUM  "StandardCAN","ExtendedCAN","StandardCAN_FD","ExtendedCAN_FD";
BA_DEF_DEF_  "VFrameFormat" "0";
BA_ "VFrameFormat" BO_ 452 2;
BA_ "VFrameFormat" BO_ 451 2;
BA_ "VFrameFormat" BO_ 561 2;
BA_ "VFrameFormat" BO_ 617 2;
BA_ "VFrameFormat" BO_ 419 2;
BA_ "VFrameFormat" BO_ 621 2;
BA_ "VFrameFormat" BO_ 387 2;
BA_ "VFrameFormat" BO_ 432 2;
