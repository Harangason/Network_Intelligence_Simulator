VERSION ""

NS_ :

BS_:

BU_: Batteriemanagement BatteryCurrent BatteryTemperature BatteryVoltage CellVoltageMax CellVoltageMin

BO_ 429 Cell_Voltage_Min: 2 CellVoltageMin
 SG_ MinimaleZellspannung : 0|13@1+ (0.001,0.0) [0.0|5.0] "V"  Batteriemanagement

BO_ 409 Battery_Voltage: 2 BatteryVoltage
 SG_ Batteriespannung : 0|14@1+ (0.1,0.0) [0.0|1000.0] "V"  Batteriemanagement

BO_ 407 Battery_Current: 2 BatteryCurrent
 SG_ Batteriestrom : 0|15@1- (0.1,0.0) [-1000.0|1000.0] "A"  Batteriemanagement

BO_ 408 Battery_Temperature: 2 BatteryTemperature
 SG_ Batterietemperatur : 0|11@1- (0.1,0.0) [-40.0|100.0] "degC"  Batteriemanagement

BO_ 428 Cell_Voltage_Max: 2 CellVoltageMax
 SG_ MaximaleZellspannung : 0|13@1+ (0.001,0.0) [0.0|5.0] "V"  Batteriemanagement

CM_ BO_ 429 "CanonicalMessage=614b698e-71bf-4589-8562-675efb15c3a9; Network=Energieversorgung_02-IO-batteriemanagement-can-fd-S01; Technology=can_fd";
CM_ SG_ 429 MinimaleZellspannung "CanonicalSignal=c9105ceb-e85a-40b8-8245-7d72e9bc11f5";
CM_ BO_ 409 "CanonicalMessage=f4615d29-f461-4779-b078-54f2c0148bed; Network=Energieversorgung_02-IO-batteriemanagement-can-fd-S01; Technology=can_fd";
CM_ SG_ 409 Batteriespannung "CanonicalSignal=01ce648e-9f55-467a-a227-52698cf76530";
CM_ BO_ 407 "CanonicalMessage=2ac0c230-5c5a-4987-adc4-b6ce231f02f4; Network=Energieversorgung_02-IO-batteriemanagement-can-fd-S01; Technology=can_fd";
CM_ SG_ 407 Batteriestrom "CanonicalSignal=2e11edb5-99b2-4594-9638-9d1a460b20ba";
CM_ BO_ 408 "CanonicalMessage=b28c5c11-6f7a-4b15-9266-532ecb650fc9; Network=Energieversorgung_02-IO-batteriemanagement-can-fd-S01; Technology=can_fd";
CM_ SG_ 408 Batterietemperatur "CanonicalSignal=11de2950-3bd4-4ac8-8a10-6946ba964cb3";
CM_ BO_ 428 "CanonicalMessage=23c5c36c-91ed-4e6a-8473-2d7e3b78dc34; Network=Energieversorgung_02-IO-batteriemanagement-can-fd-S01; Technology=can_fd";
CM_ SG_ 428 MaximaleZellspannung "CanonicalSignal=20f76bb6-9f87-4f8d-8b67-741354815abe";
BA_DEF_ BO_  "VFrameFormat" ENUM  "StandardCAN","ExtendedCAN","StandardCAN_FD","ExtendedCAN_FD";
BA_DEF_DEF_  "VFrameFormat" "0";
BA_ "VFrameFormat" BO_ 429 2;
BA_ "VFrameFormat" BO_ 409 2;
BA_ "VFrameFormat" BO_ 407 2;
BA_ "VFrameFormat" BO_ 408 2;
BA_ "VFrameFormat" BO_ 428 2;
