VERSION ""

NS_ :

BS_:

BU_: AlternatorCurrent Bordnetzmanagement

BO_ 395 Alternator_Current: 2 AlternatorCurrent
 SG_ Generatorstrom : 0|13@1- (0.1,0.0) [-300.0|300.0] "A"  Bordnetzmanagement

CM_ BO_ 395 "CanonicalMessage=beada0eb-819a-4cb9-af07-b25a4ac5b61d; Network=Energieversorgung_02-IO-bordnetzmanagement-can-fd-S01; Technology=can_fd";
CM_ SG_ 395 Generatorstrom "CanonicalSignal=23177be0-a50b-4a0c-bf13-7f52c06c7bea";
BA_DEF_ BO_  "VFrameFormat" ENUM  "StandardCAN","ExtendedCAN","StandardCAN_FD","ExtendedCAN_FD";
BA_DEF_DEF_  "VFrameFormat" "0";
BA_ "VFrameFormat" BO_ 395 2;
