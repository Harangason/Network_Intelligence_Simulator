VERSION ""

NS_ :

BS_:

BU_: Fahrerassistenz IntakeAirTemperature

BO_ 518 Intake_Air_Temperature: 2 IntakeAirTemperature
 SG_ Ansauglufttemperatur : 0|12@1- (0.1,0.0) [-40.0|120.0] "degC"  Fahrerassistenz

CM_ BO_ 518 "CanonicalMessage=bfb9131c-edb9-46fb-98d7-2d5ef95890eb; Network=Fahrerassistenz_05-IO-fahrerassistenz-can-fd-S01; Technology=can_fd";
CM_ SG_ 518 Ansauglufttemperatur "CanonicalSignal=163f5567-b0e3-4066-9b2a-9babf795ff48";
BA_DEF_ BO_  "VFrameFormat" ENUM  "StandardCAN","ExtendedCAN","StandardCAN_FD","ExtendedCAN_FD";
BA_DEF_DEF_  "VFrameFormat" "0";
BA_ "VFrameFormat" BO_ 518 2;
