VERSION ""

NS_ :

BS_:

BU_: Bremsregelung FrontLeftBrakePressure FrontLeftBrakeTemperature

BO_ 473 Front_Left_Brake_Temperature: 2 FrontLeftBrakeTemperature
 SG_ BremstemperaturVorneLinks : 0|12@1- (0.5,0.0) [-40.0|900.0] "degC"  Bremsregelung

BO_ 472 Front_Left_Brake_Pressure: 2 FrontLeftBrakePressure
 SG_ BremsdruckVorneLinks : 0|12@1+ (0.1,0.0) [0.0|250.0] "bar"  Bremsregelung

CM_ BO_ 473 "CanonicalMessage=f6340b77-e761-481a-89b5-5f45afa1d6f9; Network=Fahrwerk_Fahrdynamik_03-IO-bremsregelung-can-fd-FL-S01; Technology=can_fd";
CM_ SG_ 473 BremstemperaturVorneLinks "CanonicalSignal=82730faf-2276-4018-8dcf-be167e455996";
CM_ BO_ 472 "CanonicalMessage=892eb2b4-7129-4008-906c-02865c40e2e5; Network=Fahrwerk_Fahrdynamik_03-IO-bremsregelung-can-fd-FL-S01; Technology=can_fd";
CM_ SG_ 472 BremsdruckVorneLinks "CanonicalSignal=69e53e34-950b-4bc8-8257-456f14b34c26";
BA_DEF_ BO_  "VFrameFormat" ENUM  "StandardCAN","ExtendedCAN","StandardCAN_FD","ExtendedCAN_FD";
BA_DEF_DEF_  "VFrameFormat" "0";
BA_ "VFrameFormat" BO_ 473 2;
BA_ "VFrameFormat" BO_ 472 2;
