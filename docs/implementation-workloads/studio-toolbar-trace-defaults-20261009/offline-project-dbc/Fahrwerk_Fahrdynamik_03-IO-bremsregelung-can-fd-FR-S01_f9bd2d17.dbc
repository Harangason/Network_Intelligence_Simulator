VERSION ""

NS_ :

BS_:

BU_: Bremsregelung FrontRightBrakePressure FrontRightBrakeTemperature

BO_ 485 Front_Right_Brake_Pressure: 2 FrontRightBrakePressure
 SG_ BremsdruckVorneRechts : 0|12@1+ (0.1,0.0) [0.0|250.0] "bar"  Bremsregelung

BO_ 486 Front_Right_Brake_Temperature: 2 FrontRightBrakeTemperature
 SG_ BremstemperaturVorneRechts : 0|12@1- (0.5,0.0) [-40.0|900.0] "degC"  Bremsregelung

CM_ BO_ 485 "CanonicalMessage=8f1cc3bb-6777-4461-ad9c-78ae625f8dbf; Network=Fahrwerk_Fahrdynamik_03-IO-bremsregelung-can-fd-FR-S01; Technology=can_fd";
CM_ SG_ 485 BremsdruckVorneRechts "CanonicalSignal=797001f4-8c39-4c04-82f1-06d8eceb06a9";
CM_ BO_ 486 "CanonicalMessage=814cde11-33d9-4469-a683-0f2a48ab927a; Network=Fahrwerk_Fahrdynamik_03-IO-bremsregelung-can-fd-FR-S01; Technology=can_fd";
CM_ SG_ 486 BremstemperaturVorneRechts "CanonicalSignal=b09d0a70-b178-4759-8c18-0c80a908e7ba";
BA_DEF_ BO_  "VFrameFormat" ENUM  "StandardCAN","ExtendedCAN","StandardCAN_FD","ExtendedCAN_FD";
BA_DEF_DEF_  "VFrameFormat" "0";
BA_ "VFrameFormat" BO_ 485 2;
BA_ "VFrameFormat" BO_ 486 2;
