VERSION ""

NS_ :

BS_:

BU_: Bremsregelung RearLeftBrakePressure RearLeftBrakeTemperature

BO_ 569 Rear_Left_Brake_Pressure: 2 RearLeftBrakePressure
 SG_ BremsdruckHintenLinks : 0|12@1+ (0.1,0.0) [0.0|250.0] "bar"  Bremsregelung

BO_ 570 Rear_Left_Brake_Temperature: 2 RearLeftBrakeTemperature
 SG_ BremstemperaturHintenLinks : 0|12@1- (0.5,0.0) [-40.0|900.0] "degC"  Bremsregelung

CM_ BO_ 569 "CanonicalMessage=1fbf188a-9496-431d-915f-0d5f98437aaf; Network=Fahrwerk_Fahrdynamik_03-IO-bremsregelung-can-fd-RL-S01; Technology=can_fd";
CM_ SG_ 569 BremsdruckHintenLinks "CanonicalSignal=3a343e4e-d0d7-4fef-8295-0a637a8edca5";
CM_ BO_ 570 "CanonicalMessage=94f1c4c4-86e7-4ba2-b323-97860909eaa3; Network=Fahrwerk_Fahrdynamik_03-IO-bremsregelung-can-fd-RL-S01; Technology=can_fd";
CM_ SG_ 570 BremstemperaturHintenLinks "CanonicalSignal=7ba653b8-3e73-4624-a07d-a43a2b5c4b4c";
BA_DEF_ BO_  "VFrameFormat" ENUM  "StandardCAN","ExtendedCAN","StandardCAN_FD","ExtendedCAN_FD";
BA_DEF_DEF_  "VFrameFormat" "0";
BA_ "VFrameFormat" BO_ 569 2;
BA_ "VFrameFormat" BO_ 570 2;
