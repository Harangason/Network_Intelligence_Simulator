VERSION ""

NS_ :

BS_:

BU_: Bremsregelung RearRightBrakePressure RearRightBrakeTemperature

BO_ 582 Rear_Right_Brake_Temperature: 2 RearRightBrakeTemperature
 SG_ BremstemperaturHintenRechts : 0|12@1- (0.5,0.0) [-40.0|900.0] "degC"  Bremsregelung

BO_ 581 Rear_Right_Brake_Pressure: 2 RearRightBrakePressure
 SG_ BremsdruckHintenRechts : 0|12@1+ (0.1,0.0) [0.0|250.0] "bar"  Bremsregelung

CM_ BO_ 582 "CanonicalMessage=cd3bf00b-4c56-4aa2-adf9-c3492d4338f7; Network=Fahrwerk_Fahrdynamik_03-IO-bremsregelung-can-fd-RR-S01; Technology=can_fd";
CM_ SG_ 582 BremstemperaturHintenRechts "CanonicalSignal=07c00712-b8e4-4d5c-ae50-33730a918c39";
CM_ BO_ 581 "CanonicalMessage=3d04cc2f-58d0-4d01-b6e0-3753362c1e23; Network=Fahrwerk_Fahrdynamik_03-IO-bremsregelung-can-fd-RR-S01; Technology=can_fd";
CM_ SG_ 581 BremsdruckHintenRechts "CanonicalSignal=a075faae-2fa0-4463-9e69-d98c98c59fea";
BA_DEF_ BO_  "VFrameFormat" ENUM  "StandardCAN","ExtendedCAN","StandardCAN_FD","ExtendedCAN_FD";
BA_DEF_DEF_  "VFrameFormat" "0";
BA_ "VFrameFormat" BO_ 582 2;
BA_ "VFrameFormat" BO_ 581 2;
