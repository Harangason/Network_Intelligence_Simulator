VERSION ""

NS_ :

BS_:

BU_: BrakePedalPosition Bremsregelung

BO_ 423 Brake_Pedal_Position: 2 BrakePedalPosition
 SG_ Bremspedalstellung : 0|10@1+ (0.1,0.0) [0.0|100.0] "%"  Bremsregelung

CM_ BO_ 423 "CanonicalMessage=50e8dd8c-8a1b-469e-bca1-d505904af714; Network=Fahrwerk_Fahrdynamik_03-IO-bremsregelung-can-fd-S01; Technology=can_fd";
CM_ SG_ 423 Bremspedalstellung "CanonicalSignal=c7d42f48-f4d5-412d-8aef-553916778c2b";
BA_DEF_ BO_  "VFrameFormat" ENUM  "StandardCAN","ExtendedCAN","StandardCAN_FD","ExtendedCAN_FD";
BA_DEF_DEF_  "VFrameFormat" "0";
BA_ "VFrameFormat" BO_ 423 2;
