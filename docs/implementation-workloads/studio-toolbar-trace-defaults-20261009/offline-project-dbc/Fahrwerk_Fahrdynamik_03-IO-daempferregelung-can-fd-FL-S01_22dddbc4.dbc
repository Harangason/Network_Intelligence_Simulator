VERSION ""

NS_ :

BS_:

BU_: Daempferregelung FrontLeftDamperPosition FrontLeftSuspensionTravel

BO_ 474 Front_Left_Damper_Position: 2 FrontLeftDamperPosition
 SG_ DaempferpositionVorneLinks : 0|10@1+ (0.1,0.0) [0.0|100.0] "%"  Daempferregelung

BO_ 475 Front_Left_Suspension_Travel: 2 FrontLeftSuspensionTravel
 SG_ FederwegVorneLinks : 0|12@1- (0.1,0.0) [-150.0|150.0] "mm"  Daempferregelung

CM_ BO_ 474 "CanonicalMessage=5d0accd6-1526-4957-9b6a-9abd0979c8e6; Network=Fahrwerk_Fahrdynamik_03-IO-daempferregelung-can-fd-FL-S01; Technology=can_fd";
CM_ SG_ 474 DaempferpositionVorneLinks "CanonicalSignal=24c8c8fd-73ca-4f2a-b426-66b36287f233";
CM_ BO_ 475 "CanonicalMessage=cdefbdfd-87b1-4147-96e2-99d7b7a111ab; Network=Fahrwerk_Fahrdynamik_03-IO-daempferregelung-can-fd-FL-S01; Technology=can_fd";
CM_ SG_ 475 FederwegVorneLinks "CanonicalSignal=c9df189b-c0f7-4097-a484-0cce285394a6";
BA_DEF_ BO_  "VFrameFormat" ENUM  "StandardCAN","ExtendedCAN","StandardCAN_FD","ExtendedCAN_FD";
BA_DEF_DEF_  "VFrameFormat" "0";
BA_ "VFrameFormat" BO_ 474 2;
BA_ "VFrameFormat" BO_ 475 2;
