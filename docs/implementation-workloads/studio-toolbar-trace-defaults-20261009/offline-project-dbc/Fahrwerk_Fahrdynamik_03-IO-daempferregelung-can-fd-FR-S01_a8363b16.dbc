VERSION ""

NS_ :

BS_:

BU_: Daempferregelung FrontRightDamperPosition FrontRightSuspensionTravel

BO_ 487 Front_Right_Damper_Position: 2 FrontRightDamperPosition
 SG_ DaempferpositionVorneRechts : 0|10@1+ (0.1,0.0) [0.0|100.0] "%"  Daempferregelung

BO_ 488 Front_Right_Suspension_Travel: 2 FrontRightSuspensionTravel
 SG_ FederwegVorneRechts : 0|12@1- (0.1,0.0) [-150.0|150.0] "mm"  Daempferregelung

CM_ BO_ 487 "CanonicalMessage=c98b0cb8-2b8f-4453-a524-5ce90043e72f; Network=Fahrwerk_Fahrdynamik_03-IO-daempferregelung-can-fd-FR-S01; Technology=can_fd";
CM_ SG_ 487 DaempferpositionVorneRechts "CanonicalSignal=05aee791-ec9e-49d9-8d82-adcef7072cc6";
CM_ BO_ 488 "CanonicalMessage=b47f4e5f-b088-42f2-95d8-e08bf1b95c8d; Network=Fahrwerk_Fahrdynamik_03-IO-daempferregelung-can-fd-FR-S01; Technology=can_fd";
CM_ SG_ 488 FederwegVorneRechts "CanonicalSignal=61b119c9-3e7b-41bb-87e9-e1dc9fa12fea";
BA_DEF_ BO_  "VFrameFormat" ENUM  "StandardCAN","ExtendedCAN","StandardCAN_FD","ExtendedCAN_FD";
BA_DEF_DEF_  "VFrameFormat" "0";
BA_ "VFrameFormat" BO_ 487 2;
BA_ "VFrameFormat" BO_ 488 2;
