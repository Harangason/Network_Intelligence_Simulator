VERSION ""

NS_ :

BS_:

BU_: Daempferregelung RearLeftDamperPosition RearLeftSuspensionTravel

BO_ 571 Rear_Left_Damper_Position: 2 RearLeftDamperPosition
 SG_ DaempferpositionHintenLinks : 0|10@1+ (0.1,0.0) [0.0|100.0] "%"  Daempferregelung

BO_ 572 Rear_Left_Suspension_Travel: 2 RearLeftSuspensionTravel
 SG_ FederwegHintenLinks : 0|12@1- (0.1,0.0) [-150.0|150.0] "mm"  Daempferregelung

CM_ BO_ 571 "CanonicalMessage=cb33ffad-2f50-4033-a65d-bb1bce35677d; Network=Fahrwerk_Fahrdynamik_03-IO-daempferregelung-can-fd-RL-S01; Technology=can_fd";
CM_ SG_ 571 DaempferpositionHintenLinks "CanonicalSignal=dd5ad783-5748-4f4f-b124-de2e421f52cc";
CM_ BO_ 572 "CanonicalMessage=2b2f6773-c537-4635-9803-37c74832a00e; Network=Fahrwerk_Fahrdynamik_03-IO-daempferregelung-can-fd-RL-S01; Technology=can_fd";
CM_ SG_ 572 FederwegHintenLinks "CanonicalSignal=8007807b-f91b-4a0d-8ef1-46d7090cc698";
BA_DEF_ BO_  "VFrameFormat" ENUM  "StandardCAN","ExtendedCAN","StandardCAN_FD","ExtendedCAN_FD";
BA_DEF_DEF_  "VFrameFormat" "0";
BA_ "VFrameFormat" BO_ 571 2;
BA_ "VFrameFormat" BO_ 572 2;
