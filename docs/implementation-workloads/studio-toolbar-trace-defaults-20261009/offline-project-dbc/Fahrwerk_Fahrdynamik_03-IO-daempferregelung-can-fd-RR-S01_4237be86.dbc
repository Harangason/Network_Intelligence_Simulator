VERSION ""

NS_ :

BS_:

BU_: Daempferregelung RearRightDamperPosition RearRightSuspensionTravel

BO_ 584 Rear_Right_Suspension_Travel: 2 RearRightSuspensionTravel
 SG_ FederwegHintenRechts : 0|12@1- (0.1,0.0) [-150.0|150.0] "mm"  Daempferregelung

BO_ 583 Rear_Right_Damper_Position: 2 RearRightDamperPosition
 SG_ DaempferpositionHintenRechts : 0|10@1+ (0.1,0.0) [0.0|100.0] "%"  Daempferregelung

CM_ BO_ 584 "CanonicalMessage=f28f744e-0304-4f50-8e1c-95188f392805; Network=Fahrwerk_Fahrdynamik_03-IO-daempferregelung-can-fd-RR-S01; Technology=can_fd";
CM_ SG_ 584 FederwegHintenRechts "CanonicalSignal=d75a27b4-c456-4599-9628-c142071971b2";
CM_ BO_ 583 "CanonicalMessage=d3ee8bc1-8fe1-46ff-a149-ab02fad72a88; Network=Fahrwerk_Fahrdynamik_03-IO-daempferregelung-can-fd-RR-S01; Technology=can_fd";
CM_ SG_ 583 DaempferpositionHintenRechts "CanonicalSignal=f680ae5a-c6f7-4fe6-9ccf-4b4db204ca11";
BA_DEF_ BO_  "VFrameFormat" ENUM  "StandardCAN","ExtendedCAN","StandardCAN_FD","ExtendedCAN_FD";
BA_DEF_DEF_  "VFrameFormat" "0";
BA_ "VFrameFormat" BO_ 584 2;
BA_ "VFrameFormat" BO_ 583 2;
