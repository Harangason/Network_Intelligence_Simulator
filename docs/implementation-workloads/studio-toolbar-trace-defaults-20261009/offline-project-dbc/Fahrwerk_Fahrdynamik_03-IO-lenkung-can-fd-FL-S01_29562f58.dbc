VERSION ""

NS_ :

BS_:

BU_: FrontLeftWheelAngle Lenkung

BO_ 480 Front_Left_Wheel_Angle: 2 FrontLeftWheelAngle
 SG_ RadwinkelVorneLinks : 0|14@1- (0.01,0.0) [-60.0|60.0] "deg"  Lenkung

CM_ BO_ 480 "CanonicalMessage=523f552f-8e81-4d41-b57a-dcefdf556a9b; Network=Fahrwerk_Fahrdynamik_03-IO-lenkung-can-fd-FL-S01; Technology=can_fd";
CM_ SG_ 480 RadwinkelVorneLinks "CanonicalSignal=edc10cdf-dfeb-462d-b802-e08bdefdd5c1";
BA_DEF_ BO_  "VFrameFormat" ENUM  "StandardCAN","ExtendedCAN","StandardCAN_FD","ExtendedCAN_FD";
BA_DEF_DEF_  "VFrameFormat" "0";
BA_ "VFrameFormat" BO_ 480 2;
