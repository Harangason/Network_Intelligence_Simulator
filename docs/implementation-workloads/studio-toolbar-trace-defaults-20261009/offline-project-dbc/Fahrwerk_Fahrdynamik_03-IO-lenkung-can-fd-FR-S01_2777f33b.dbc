VERSION ""

NS_ :

BS_:

BU_: FrontRightWheelAngle Lenkung

BO_ 493 Front_Right_Wheel_Angle: 2 FrontRightWheelAngle
 SG_ RadwinkelVorneRechts : 0|14@1- (0.01,0.0) [-60.0|60.0] "deg"  Lenkung

CM_ BO_ 493 "CanonicalMessage=292576e5-6d00-488b-a065-6dcd6b69aebe; Network=Fahrwerk_Fahrdynamik_03-IO-lenkung-can-fd-FR-S01; Technology=can_fd";
CM_ SG_ 493 RadwinkelVorneRechts "CanonicalSignal=adf752c2-55be-40e3-bd4a-b74e30f8b0b9";
BA_DEF_ BO_  "VFrameFormat" ENUM  "StandardCAN","ExtendedCAN","StandardCAN_FD","ExtendedCAN_FD";
BA_DEF_DEF_  "VFrameFormat" "0";
BA_ "VFrameFormat" BO_ 493 2;
