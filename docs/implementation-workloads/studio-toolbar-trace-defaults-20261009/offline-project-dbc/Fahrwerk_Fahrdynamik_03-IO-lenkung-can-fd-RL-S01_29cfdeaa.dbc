VERSION ""

NS_ :

BS_:

BU_: Lenkung RearLeftWheelAngle

BO_ 577 Rear_Left_Wheel_Angle: 2 RearLeftWheelAngle
 SG_ RadwinkelHintenLinks : 0|14@1- (0.01,0.0) [-60.0|60.0] "deg"  Lenkung

CM_ BO_ 577 "CanonicalMessage=3d7d260d-8f0d-4e72-a499-d6ebc041ede7; Network=Fahrwerk_Fahrdynamik_03-IO-lenkung-can-fd-RL-S01; Technology=can_fd";
CM_ SG_ 577 RadwinkelHintenLinks "CanonicalSignal=0245b80d-949f-4929-a6fa-c836485bc679";
BA_DEF_ BO_  "VFrameFormat" ENUM  "StandardCAN","ExtendedCAN","StandardCAN_FD","ExtendedCAN_FD";
BA_DEF_DEF_  "VFrameFormat" "0";
BA_ "VFrameFormat" BO_ 577 2;
