VERSION ""

NS_ :

BS_:

BU_: Lenkung RearRightWheelAngle

BO_ 589 Rear_Right_Wheel_Angle: 2 RearRightWheelAngle
 SG_ RadwinkelHintenRechts : 0|14@1- (0.01,0.0) [-60.0|60.0] "deg"  Lenkung

CM_ BO_ 589 "CanonicalMessage=81d4309f-671f-4e5e-a0ad-20c72dc2bf76; Network=Fahrwerk_Fahrdynamik_03-IO-lenkung-can-fd-RR-S01; Technology=can_fd";
CM_ SG_ 589 RadwinkelHintenRechts "CanonicalSignal=e53e75e0-ffc4-41ea-8e11-7caf3d30ede2";
BA_DEF_ BO_  "VFrameFormat" ENUM  "StandardCAN","ExtendedCAN","StandardCAN_FD","ExtendedCAN_FD";
BA_DEF_DEF_  "VFrameFormat" "0";
BA_ "VFrameFormat" BO_ 589 2;
