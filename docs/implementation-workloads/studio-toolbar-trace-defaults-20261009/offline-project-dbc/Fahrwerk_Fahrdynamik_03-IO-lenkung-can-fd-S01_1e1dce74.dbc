VERSION ""

NS_ :

BS_:

BU_: Lenkung SteeringAngle SteeringTorque

BO_ 606 Steering_Angle: 2 SteeringAngle
 SG_ Lenkwinkel : 0|14@1- (0.1,0.0) [-720.0|720.0] "deg"  Lenkung

BO_ 607 Steering_Torque: 2 SteeringTorque
 SG_ Lenkmoment : 0|13@1- (0.01,0.0) [-30.0|30.0] "Nm"  Lenkung

CM_ BO_ 606 "CanonicalMessage=91f35754-149b-45e4-bedc-b890eca4c4d6; Network=Fahrwerk_Fahrdynamik_03-IO-lenkung-can-fd-S01; Technology=can_fd";
CM_ SG_ 606 Lenkwinkel "CanonicalSignal=13df659d-5362-4ab8-87f0-34af4371b395";
CM_ BO_ 607 "CanonicalMessage=b7398d6e-77b1-4c60-8fb4-e5f4e9716bc8; Network=Fahrwerk_Fahrdynamik_03-IO-lenkung-can-fd-S01; Technology=can_fd";
CM_ SG_ 607 Lenkmoment "CanonicalSignal=ba1aa4b6-fd47-4eda-9707-accc1f66f0a8";
BA_DEF_ BO_  "VFrameFormat" ENUM  "StandardCAN","ExtendedCAN","StandardCAN_FD","ExtendedCAN_FD";
BA_DEF_DEF_  "VFrameFormat" "0";
BA_ "VFrameFormat" BO_ 606 2;
BA_ "VFrameFormat" BO_ 607 2;
