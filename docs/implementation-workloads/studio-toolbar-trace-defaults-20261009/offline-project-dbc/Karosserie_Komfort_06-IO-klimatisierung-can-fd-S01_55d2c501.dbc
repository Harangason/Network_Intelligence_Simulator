VERSION ""

NS_ :

BS_:

BU_: CabinTemperature Klimatisierung

BO_ 427 Cabin_Temperature: 2 CabinTemperature
 SG_ Innenraumtemperatur : 0|11@1- (0.1,0.0) [-40.0|85.0] "degC"  Klimatisierung

CM_ BO_ 427 "CanonicalMessage=b4131104-c0b6-4d3e-9ac2-0370c77d367a; Network=Karosserie_Komfort_06-IO-klimatisierung-can-fd-S01; Technology=can_fd";
CM_ SG_ 427 Innenraumtemperatur "CanonicalSignal=314b0577-e8fc-4a5e-98ac-094e69ab9bff";
BA_DEF_ BO_  "VFrameFormat" ENUM  "StandardCAN","ExtendedCAN","StandardCAN_FD","ExtendedCAN_FD";
BA_DEF_DEF_  "VFrameFormat" "0";
BA_ "VFrameFormat" BO_ 427 2;
