VERSION ""

NS_ :

BS_:

BU_: FrontLeftWheelAcceleration FrontLeftWheelLoad FrontLeftWheelSpeed FrontLeftWheelTorque Stabilitaetsregelung

BO_ 482 Front_Left_Wheel_Speed: 2 FrontLeftWheelSpeed
 SG_ RaddrehzahlVorneLinks : 0|12@1+ (1,0) [0.0|2500.0] "rpm"  Stabilitaetsregelung

BO_ 479 Front_Left_Wheel_Acceleration: 2 FrontLeftWheelAcceleration
 SG_ RadbeschleunigungVorneLinks : 0|15@1- (0.01,0.0) [-100.0|100.0] "m/s2"  Stabilitaetsregelung

BO_ 483 Front_Left_Wheel_Torque: 2 FrontLeftWheelTorque
 SG_ RaddrehmomentVorneLinks : 0|14@1- (1,0) [-5000.0|5000.0] "Nm"  Stabilitaetsregelung

BO_ 481 Front_Left_Wheel_Load: 2 FrontLeftWheelLoad
 SG_ RadlastVorneLinks : 0|14@1+ (1,0) [0.0|15000.0] "N"  Stabilitaetsregelung

CM_ BO_ 482 "CanonicalMessage=c908fe04-a3b9-4808-91bf-803a2765edb9; Network=Regelung_10-IO-stabilitaetsregelung-can-fd-FL-S01; Technology=can_fd";
CM_ SG_ 482 RaddrehzahlVorneLinks "CanonicalSignal=8d87325e-4051-4909-957b-373bff3c3745";
CM_ BO_ 479 "CanonicalMessage=fd9f4543-a2ff-4b32-96c5-37ce84650740; Network=Regelung_10-IO-stabilitaetsregelung-can-fd-FL-S01; Technology=can_fd";
CM_ SG_ 479 RadbeschleunigungVorneLinks "CanonicalSignal=d0bfd758-9657-4abf-8015-71f7c0665664";
CM_ BO_ 483 "CanonicalMessage=54c0b6fa-2fb8-4fb2-8679-0e673379c39f; Network=Regelung_10-IO-stabilitaetsregelung-can-fd-FL-S01; Technology=can_fd";
CM_ SG_ 483 RaddrehmomentVorneLinks "CanonicalSignal=114d9177-f360-4e39-86f4-3110ce747213";
CM_ BO_ 481 "CanonicalMessage=03d93c00-cc19-41a3-b2ba-970dff229f4d; Network=Regelung_10-IO-stabilitaetsregelung-can-fd-FL-S01; Technology=can_fd";
CM_ SG_ 481 RadlastVorneLinks "CanonicalSignal=416e4bf1-98be-4b84-8eac-6ff4e34040d7";
BA_DEF_ BO_  "VFrameFormat" ENUM  "StandardCAN","ExtendedCAN","StandardCAN_FD","ExtendedCAN_FD";
BA_DEF_DEF_  "VFrameFormat" "0";
BA_ "VFrameFormat" BO_ 482 2;
BA_ "VFrameFormat" BO_ 479 2;
BA_ "VFrameFormat" BO_ 483 2;
BA_ "VFrameFormat" BO_ 481 2;
