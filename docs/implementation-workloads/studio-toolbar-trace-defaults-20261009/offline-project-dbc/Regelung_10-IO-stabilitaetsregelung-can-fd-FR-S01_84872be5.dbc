VERSION ""

NS_ :

BS_:

BU_: FrontRightWheelAcceleration FrontRightWheelLoad FrontRightWheelSpeed FrontRightWheelTorque Stabilitaetsregelung

BO_ 496 Front_Right_Wheel_Torque: 2 FrontRightWheelTorque
 SG_ RaddrehmomentVorneRechts : 0|14@1- (1,0) [-5000.0|5000.0] "Nm"  Stabilitaetsregelung

BO_ 492 Front_Right_Wheel_Acceleration: 2 FrontRightWheelAcceleration
 SG_ RadbeschleunigungVorneRechts : 0|15@1- (0.01,0.0) [-100.0|100.0] "m/s2"  Stabilitaetsregelung

BO_ 494 Front_Right_Wheel_Load: 2 FrontRightWheelLoad
 SG_ RadlastVorneRechts : 0|14@1+ (1,0) [0.0|15000.0] "N"  Stabilitaetsregelung

BO_ 495 Front_Right_Wheel_Speed: 2 FrontRightWheelSpeed
 SG_ RaddrehzahlVorneRechts : 0|12@1+ (1,0) [0.0|2500.0] "rpm"  Stabilitaetsregelung

CM_ BO_ 496 "CanonicalMessage=26d13ac7-c360-4b5e-a0f9-111f59ea4a6a; Network=Regelung_10-IO-stabilitaetsregelung-can-fd-FR-S01; Technology=can_fd";
CM_ SG_ 496 RaddrehmomentVorneRechts "CanonicalSignal=013c87de-9e74-4952-b103-303c2c1bddae";
CM_ BO_ 492 "CanonicalMessage=f31f2dcd-a99b-4bce-bc97-6a57af3e39e6; Network=Regelung_10-IO-stabilitaetsregelung-can-fd-FR-S01; Technology=can_fd";
CM_ SG_ 492 RadbeschleunigungVorneRechts "CanonicalSignal=406d135e-257b-4737-9e86-8300d5c65ea8";
CM_ BO_ 494 "CanonicalMessage=3356816b-9497-40b2-b7a8-4b0babd5d0ec; Network=Regelung_10-IO-stabilitaetsregelung-can-fd-FR-S01; Technology=can_fd";
CM_ SG_ 494 RadlastVorneRechts "CanonicalSignal=900617e4-de92-4bf3-a323-64b43c639e2d";
CM_ BO_ 495 "CanonicalMessage=63f7d24d-86ef-4f74-bfe3-b9ae388a8c12; Network=Regelung_10-IO-stabilitaetsregelung-can-fd-FR-S01; Technology=can_fd";
CM_ SG_ 495 RaddrehzahlVorneRechts "CanonicalSignal=201bf150-e162-41c4-b166-611590c984aa";
BA_DEF_ BO_  "VFrameFormat" ENUM  "StandardCAN","ExtendedCAN","StandardCAN_FD","ExtendedCAN_FD";
BA_DEF_DEF_  "VFrameFormat" "0";
BA_ "VFrameFormat" BO_ 496 2;
BA_ "VFrameFormat" BO_ 492 2;
BA_ "VFrameFormat" BO_ 494 2;
BA_ "VFrameFormat" BO_ 495 2;
