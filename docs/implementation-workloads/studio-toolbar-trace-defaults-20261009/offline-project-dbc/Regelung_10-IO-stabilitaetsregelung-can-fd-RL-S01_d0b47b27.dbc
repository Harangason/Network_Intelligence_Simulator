VERSION ""

NS_ :

BS_:

BU_: RearLeftWheelAcceleration RearLeftWheelLoad RearLeftWheelSpeed RearLeftWheelTorque Stabilitaetsregelung

BO_ 578 Rear_Left_Wheel_Load: 2 RearLeftWheelLoad
 SG_ RadlastHintenLinks : 0|14@1+ (1,0) [0.0|15000.0] "N"  Stabilitaetsregelung

BO_ 580 Rear_Left_Wheel_Torque: 2 RearLeftWheelTorque
 SG_ RaddrehmomentHintenLinks : 0|14@1- (1,0) [-5000.0|5000.0] "Nm"  Stabilitaetsregelung

BO_ 576 Rear_Left_Wheel_Acceleration: 2 RearLeftWheelAcceleration
 SG_ RadbeschleunigungHintenLinks : 0|15@1- (0.01,0.0) [-100.0|100.0] "m/s2"  Stabilitaetsregelung

BO_ 579 Rear_Left_Wheel_Speed: 2 RearLeftWheelSpeed
 SG_ RaddrehzahlHintenLinks : 0|12@1+ (1,0) [0.0|2500.0] "rpm"  Stabilitaetsregelung

CM_ BO_ 578 "CanonicalMessage=c1cfb90d-e2b6-4bd5-8929-34e426819d00; Network=Regelung_10-IO-stabilitaetsregelung-can-fd-RL-S01; Technology=can_fd";
CM_ SG_ 578 RadlastHintenLinks "CanonicalSignal=37d8e4d3-e8e0-4354-8f69-e0e4fc5cc302";
CM_ BO_ 580 "CanonicalMessage=80135002-d8af-4437-bbd2-5270aef90330; Network=Regelung_10-IO-stabilitaetsregelung-can-fd-RL-S01; Technology=can_fd";
CM_ SG_ 580 RaddrehmomentHintenLinks "CanonicalSignal=d0821cb5-6ffa-4b17-830f-5e1d61bb83eb";
CM_ BO_ 576 "CanonicalMessage=c09a898f-7e06-424b-9b65-b04de2b1adc9; Network=Regelung_10-IO-stabilitaetsregelung-can-fd-RL-S01; Technology=can_fd";
CM_ SG_ 576 RadbeschleunigungHintenLinks "CanonicalSignal=e38291d1-de65-4643-a0b0-f75638ec0f92";
CM_ BO_ 579 "CanonicalMessage=823b46d1-2532-4314-8ea9-a0e1f86c9fda; Network=Regelung_10-IO-stabilitaetsregelung-can-fd-RL-S01; Technology=can_fd";
CM_ SG_ 579 RaddrehzahlHintenLinks "CanonicalSignal=3b5df472-d02b-43bf-b3b0-03815867fec8";
BA_DEF_ BO_  "VFrameFormat" ENUM  "StandardCAN","ExtendedCAN","StandardCAN_FD","ExtendedCAN_FD";
BA_DEF_DEF_  "VFrameFormat" "0";
BA_ "VFrameFormat" BO_ 578 2;
BA_ "VFrameFormat" BO_ 580 2;
BA_ "VFrameFormat" BO_ 576 2;
BA_ "VFrameFormat" BO_ 579 2;
