VERSION ""

NS_ :

BS_:

BU_: RearRightWheelAcceleration RearRightWheelLoad RearRightWheelSpeed RearRightWheelTorque Stabilitaetsregelung

BO_ 590 Rear_Right_Wheel_Load: 2 RearRightWheelLoad
 SG_ RadlastHintenRechts : 0|14@1+ (1,0) [0.0|15000.0] "N"  Stabilitaetsregelung

BO_ 588 Rear_Right_Wheel_Acceleration: 2 RearRightWheelAcceleration
 SG_ RadbeschleunigungHintenRechts : 0|15@1- (0.01,0.0) [-100.0|100.0] "m/s2"  Stabilitaetsregelung

BO_ 591 Rear_Right_Wheel_Speed: 2 RearRightWheelSpeed
 SG_ RaddrehzahlHintenRechts : 0|12@1+ (1,0) [0.0|2500.0] "rpm"  Stabilitaetsregelung

BO_ 592 Rear_Right_Wheel_Torque: 2 RearRightWheelTorque
 SG_ RaddrehmomentHintenRechts : 0|14@1- (1,0) [-5000.0|5000.0] "Nm"  Stabilitaetsregelung

CM_ BO_ 590 "CanonicalMessage=f1cf65f8-84db-4e44-a2ce-acae5ad1c83f; Network=Regelung_10-IO-stabilitaetsregelung-can-fd-RR-S01; Technology=can_fd";
CM_ SG_ 590 RadlastHintenRechts "CanonicalSignal=ffc6b82e-3043-47ec-8e45-b097fddfdc6e";
CM_ BO_ 588 "CanonicalMessage=4b7e52cd-6698-44e6-afe8-8982669342d3; Network=Regelung_10-IO-stabilitaetsregelung-can-fd-RR-S01; Technology=can_fd";
CM_ SG_ 588 RadbeschleunigungHintenRechts "CanonicalSignal=a2f54265-58c2-43e2-a3d0-85d3dadcded3";
CM_ BO_ 591 "CanonicalMessage=0ada53f9-483b-47b3-92e1-2246e29500b6; Network=Regelung_10-IO-stabilitaetsregelung-can-fd-RR-S01; Technology=can_fd";
CM_ SG_ 591 RaddrehzahlHintenRechts "CanonicalSignal=7a003643-f0b9-4b29-a539-8f721887af73";
CM_ BO_ 592 "CanonicalMessage=6e52f2d9-2982-4195-a8d3-25081ac7d78b; Network=Regelung_10-IO-stabilitaetsregelung-can-fd-RR-S01; Technology=can_fd";
CM_ SG_ 592 RaddrehmomentHintenRechts "CanonicalSignal=257ff986-f935-4321-a47c-d947f37c92bb";
BA_DEF_ BO_  "VFrameFormat" ENUM  "StandardCAN","ExtendedCAN","StandardCAN_FD","ExtendedCAN_FD";
BA_DEF_DEF_  "VFrameFormat" "0";
BA_ "VFrameFormat" BO_ 590 2;
BA_ "VFrameFormat" BO_ 588 2;
BA_ "VFrameFormat" BO_ 591 2;
BA_ "VFrameFormat" BO_ 592 2;
