VERSION ""

NS_ :

BS_:

BU_: LateralAcceleration LongitudinalAcceleration PitchRate RollRate Stabilitaetsregelung VerticalAcceleration YawRate

BO_ 634 Yaw_Rate: 2 YawRate
 SG_ Gierrate : 0|16@1- (0.01,0.0) [-300.0|300.0] "deg/s"  Stabilitaetsregelung

BO_ 597 Roll_Rate: 2 RollRate
 SG_ Rollrate : 0|16@1- (0.01,0.0) [-300.0|300.0] "deg/s"  Stabilitaetsregelung

BO_ 547 Lateral_Acceleration: 2 LateralAcceleration
 SG_ Querbeschleunigung : 0|13@1- (0.01,0.0) [-30.0|30.0] "m/s2"  Stabilitaetsregelung

BO_ 565 Pitch_Rate: 2 PitchRate
 SG_ Nickrate : 0|16@1- (0.01,0.0) [-300.0|300.0] "deg/s"  Stabilitaetsregelung

BO_ 552 Longitudinal_Acceleration: 2 LongitudinalAcceleration
 SG_ Laengsbeschleunigung : 0|13@1- (0.01,0.0) [-30.0|30.0] "m/s2"  Stabilitaetsregelung

BO_ 626 Vertical_Acceleration: 2 VerticalAcceleration
 SG_ Vertikalbeschleunigung : 0|13@1- (0.01,0.0) [-30.0|30.0] "m/s2"  Stabilitaetsregelung

CM_ BO_ 634 "CanonicalMessage=1fb85061-ea07-4bd0-a6ba-7f8ebd9aa09d; Network=Regelung_10-IO-stabilitaetsregelung-can-fd-S01; Technology=can_fd";
CM_ SG_ 634 Gierrate "CanonicalSignal=a47a41c2-0264-49f4-bb09-7294bbe97513";
CM_ BO_ 597 "CanonicalMessage=71ff21b3-1f20-4ad8-bf75-00d89b638b66; Network=Regelung_10-IO-stabilitaetsregelung-can-fd-S01; Technology=can_fd";
CM_ SG_ 597 Rollrate "CanonicalSignal=15326b06-aaef-494b-9289-1abb076df67e";
CM_ BO_ 547 "CanonicalMessage=2b3cb3b8-ff6e-467d-8cdb-7a6673549566; Network=Regelung_10-IO-stabilitaetsregelung-can-fd-S01; Technology=can_fd";
CM_ SG_ 547 Querbeschleunigung "CanonicalSignal=3e9b7cab-3d6b-4ade-929f-ec0d1be83c87";
CM_ BO_ 565 "CanonicalMessage=22f62628-51b1-4b16-b719-40e2626864a6; Network=Regelung_10-IO-stabilitaetsregelung-can-fd-S01; Technology=can_fd";
CM_ SG_ 565 Nickrate "CanonicalSignal=ce568a8d-97aa-4067-a2d6-583c87b202d0";
CM_ BO_ 552 "CanonicalMessage=dd08969e-31e5-48fb-802a-1a8c360bf7cb; Network=Regelung_10-IO-stabilitaetsregelung-can-fd-S01; Technology=can_fd";
CM_ SG_ 552 Laengsbeschleunigung "CanonicalSignal=b4758373-f4b6-45bf-8bff-481a5f5cab38";
CM_ BO_ 626 "CanonicalMessage=86c9b323-a9cd-4212-a0d8-2a121c21e3e1; Network=Regelung_10-IO-stabilitaetsregelung-can-fd-S01; Technology=can_fd";
CM_ SG_ 626 Vertikalbeschleunigung "CanonicalSignal=a728a411-4904-4065-ab62-f9a2a0b3b28f";
BA_DEF_ BO_  "VFrameFormat" ENUM  "StandardCAN","ExtendedCAN","StandardCAN_FD","ExtendedCAN_FD";
BA_DEF_DEF_  "VFrameFormat" "0";
BA_ "VFrameFormat" BO_ 634 2;
BA_ "VFrameFormat" BO_ 597 2;
BA_ "VFrameFormat" BO_ 547 2;
BA_ "VFrameFormat" BO_ 565 2;
BA_ "VFrameFormat" BO_ 552 2;
BA_ "VFrameFormat" BO_ 626 2;
