VERSION "Realistic CAN Trace Generator"

NS_ :

BS_:

BU_: ADAS_DOMAIN BRAKE_CONTROLLER CAMERA_FRONT_WIDE IMU_YAW_RATE_SENSOR LIDAR_FRONT PARK_ASSIST RADAR_FRONT_LONG_RANGE RADAR_REAR_CROSS_TRAFFIC ULTRASONIC_LEFT_CLUSTER ULTRASONIC_RIGHT_CLUSTER VEHICLE_MOTION_CONTROLLER WHEEL_SPEED_FRONT_LEFT

BO_ 256 DATA_000_LIDAR_FRONT_TO_ADAS_DOMAIN: 64 LIDAR_FRONT
 SG_ CRC8 : 0|8@1+ (1,0) [0|255] "" ADAS_DOMAIN
 SG_ AliveCounter : 8|4@1+ (1,0) [0|15] "" ADAS_DOMAIN
 SG_ MuxState : 12|4@1+ (1,0) [0|15] "" ADAS_DOMAIN
 SG_ SIG_100_00 : 16|12@1+ (0.1,0.0) [0|4095] "rpm" ADAS_DOMAIN
 SG_ SIG_100_01 : 28|12@1+ (0.1,0.0) [0|4095] "km/h" ADAS_DOMAIN
 SG_ SIG_100_02 : 40|12@1+ (0.1,0.0) [0|4095] "V" ADAS_DOMAIN
 SG_ SIG_100_03 : 52|12@1+ (0.1,0.0) [0|4095] "Nm" ADAS_DOMAIN
 SG_ SIG_100_04 : 64|12@1+ (0.1,0.0) [0|4095] "Nm" ADAS_DOMAIN
 SG_ SIG_100_05 : 76|12@1+ (0.1,0.0) [0|4095] "deg" ADAS_DOMAIN
 SG_ SIG_100_06 : 88|12@1+ (0.1,0.0) [0|4095] "rpm" ADAS_DOMAIN
 SG_ SIG_100_07 : 100|12@1+ (0.1,0.0) [0|4095] "m" ADAS_DOMAIN
 SG_ SIG_100_08 : 112|12@1+ (0.1,0.0) [0|4095] "rpm" ADAS_DOMAIN
 SG_ SIG_100_09 : 124|12@1+ (0.1,0.0) [0|4095] "obj" ADAS_DOMAIN
 SG_ SIG_100_10 : 136|12@1+ (0.1,0.0) [0|4095] "%" ADAS_DOMAIN
 SG_ SIG_100_11 : 148|12@1+ (0.1,0.0) [0|4095] "km/h" ADAS_DOMAIN
 SG_ RouteInfoChar_00 : 160|8@1+ (1,0) [0|255] "ascii" ADAS_DOMAIN
 SG_ RouteInfoChar_01 : 168|8@1+ (1,0) [0|255] "ascii" ADAS_DOMAIN
 SG_ RouteInfoChar_02 : 176|8@1+ (1,0) [0|255] "ascii" ADAS_DOMAIN
 SG_ RouteInfoChar_03 : 184|8@1+ (1,0) [0|255] "ascii" ADAS_DOMAIN
 SG_ RouteInfoChar_04 : 192|8@1+ (1,0) [0|255] "ascii" ADAS_DOMAIN
 SG_ RouteInfoChar_05 : 200|8@1+ (1,0) [0|255] "ascii" ADAS_DOMAIN
 SG_ RouteInfoChar_06 : 208|8@1+ (1,0) [0|255] "ascii" ADAS_DOMAIN
 SG_ RouteInfoChar_07 : 216|8@1+ (1,0) [0|255] "ascii" ADAS_DOMAIN
 SG_ RouteInfoChar_08 : 224|8@1+ (1,0) [0|255] "ascii" ADAS_DOMAIN
 SG_ RouteInfoChar_09 : 232|8@1+ (1,0) [0|255] "ascii" ADAS_DOMAIN
 SG_ RouteInfoChar_10 : 240|8@1+ (1,0) [0|255] "ascii" ADAS_DOMAIN
 SG_ RouteInfoChar_11 : 248|8@1+ (1,0) [0|255] "ascii" ADAS_DOMAIN
 SG_ RouteInfoChar_12 : 256|8@1+ (1,0) [0|255] "ascii" ADAS_DOMAIN
 SG_ RouteInfoChar_13 : 264|8@1+ (1,0) [0|255] "ascii" ADAS_DOMAIN
 SG_ RouteInfoChar_14 : 272|8@1+ (1,0) [0|255] "ascii" ADAS_DOMAIN
 SG_ RouteInfoChar_15 : 280|8@1+ (1,0) [0|255] "ascii" ADAS_DOMAIN
 SG_ RouteInfoChar_16 : 288|8@1+ (1,0) [0|255] "ascii" ADAS_DOMAIN
 SG_ RouteInfoChar_17 : 296|8@1+ (1,0) [0|255] "ascii" ADAS_DOMAIN
 SG_ RouteInfoChar_18 : 304|8@1+ (1,0) [0|255] "ascii" ADAS_DOMAIN
 SG_ RouteInfoChar_19 : 312|8@1+ (1,0) [0|255] "ascii" ADAS_DOMAIN
 SG_ RouteInfoChar_20 : 320|8@1+ (1,0) [0|255] "ascii" ADAS_DOMAIN
 SG_ RouteInfoChar_21 : 328|8@1+ (1,0) [0|255] "ascii" ADAS_DOMAIN
 SG_ RouteInfoChar_22 : 336|8@1+ (1,0) [0|255] "ascii" ADAS_DOMAIN
 SG_ RouteInfoChar_23 : 344|8@1+ (1,0) [0|255] "ascii" ADAS_DOMAIN
 SG_ RouteInfoChar_24 : 352|8@1+ (1,0) [0|255] "ascii" ADAS_DOMAIN
 SG_ RouteInfoChar_25 : 360|8@1+ (1,0) [0|255] "ascii" ADAS_DOMAIN
 SG_ RouteInfoChar_26 : 368|8@1+ (1,0) [0|255] "ascii" ADAS_DOMAIN
 SG_ RouteInfoChar_27 : 376|8@1+ (1,0) [0|255] "ascii" ADAS_DOMAIN
 SG_ RouteInfoChar_28 : 384|8@1+ (1,0) [0|255] "ascii" ADAS_DOMAIN
 SG_ RouteInfoChar_29 : 392|8@1+ (1,0) [0|255] "ascii" ADAS_DOMAIN
 SG_ RouteInfoChar_30 : 400|8@1+ (1,0) [0|255] "ascii" ADAS_DOMAIN
 SG_ RouteInfoChar_31 : 408|8@1+ (1,0) [0|255] "ascii" ADAS_DOMAIN
 SG_ RouteInfoChar_32 : 416|8@1+ (1,0) [0|255] "ascii" ADAS_DOMAIN
 SG_ RouteInfoChar_33 : 424|8@1+ (1,0) [0|255] "ascii" ADAS_DOMAIN
 SG_ RouteInfoChar_34 : 432|8@1+ (1,0) [0|255] "ascii" ADAS_DOMAIN
 SG_ RouteInfoChar_35 : 440|8@1+ (1,0) [0|255] "ascii" ADAS_DOMAIN
 SG_ RouteInfoChar_36 : 448|8@1+ (1,0) [0|255] "ascii" ADAS_DOMAIN
 SG_ RouteInfoChar_37 : 456|8@1+ (1,0) [0|255] "ascii" ADAS_DOMAIN
 SG_ RouteInfoChar_38 : 464|8@1+ (1,0) [0|255] "ascii" ADAS_DOMAIN
 SG_ RouteInfoChar_39 : 472|8@1+ (1,0) [0|255] "ascii" ADAS_DOMAIN
 SG_ RouteInfoChar_40 : 480|8@1+ (1,0) [0|255] "ascii" ADAS_DOMAIN
 SG_ RouteInfoChar_41 : 488|8@1+ (1,0) [0|255] "ascii" ADAS_DOMAIN
 SG_ RouteInfoChar_42 : 496|8@1+ (1,0) [0|255] "ascii" ADAS_DOMAIN
 SG_ RouteInfoChar_43 : 504|8@1+ (1,0) [0|255] "ascii" ADAS_DOMAIN
CM_ BO_ 256 "Cycle=20ms; Channel=CAN0; CAN-FD; NominalBitrate=500kbit/s; DataBitrate=500kbit/s;  Data request; receiver answers with response frame; PayloadRouteInfo='LIDAR_FRONT -> ADAS_DOMAIN' in bytes 20-63; Gateway to CAN1";

BO_ 1536 RESP_000_ADAS_DOMAIN_TO_LIDAR_FRONT: 16 ADAS_DOMAIN
 SG_ CRC8 : 0|8@1+ (1,0) [0|255] "" LIDAR_FRONT
 SG_ ResponseCounter : 8|4@1+ (1,0) [0|15] "" LIDAR_FRONT
 SG_ AckState : 12|4@1+ (1,0) [0|15] "" LIDAR_FRONT
 SG_ ReceivedFrameId : 16|11@1+ (1,0) [0|2047] "" LIDAR_FRONT
 SG_ ReceivedCounter : 27|4@1+ (1,0) [0|15] "" LIDAR_FRONT
 SG_ ChecksumOk : 31|1@1+ (1,0) [0|1] "" LIDAR_FRONT
 SG_ PayloadLength : 32|8@1+ (1,0) [0|64] "byte" LIDAR_FRONT
 SG_ ErrorCode : 40|8@1+ (1,0) [0|255] "" LIDAR_FRONT
 SG_ ProcessingTimeUs : 48|16@1+ (1,0) [0|65535] "us" LIDAR_FRONT
 SG_ ResponseSequence : 64|16@1+ (1,0) [0|65535] "" LIDAR_FRONT
 SG_ ReceivedCrc : 80|8@1+ (1,0) [0|255] "" LIDAR_FRONT
 SG_ CalculatedCrc : 88|8@1+ (1,0) [0|255] "" LIDAR_FRONT
CM_ BO_ 1536 "Cycle=20ms; Channel=CAN0; CAN-FD; NominalBitrate=500kbit/s; DataBitrate=500kbit/s;  ResponseFor=0x100; ACK/NACK with CRC, DLC and counter check;";

BO_ 257 DATA_001_CAMERA_FRONT_WIDE_TO_ADAS_DOMAIN: 64 CAMERA_FRONT_WIDE
 SG_ CRC8 : 0|8@1+ (1,0) [0|255] "" ADAS_DOMAIN
 SG_ AliveCounter : 8|4@1+ (1,0) [0|15] "" ADAS_DOMAIN
 SG_ MuxState : 12|4@1+ (1,0) [0|15] "" ADAS_DOMAIN
 SG_ SIG_101_00 : 16|12@1+ (0.1,0.0) [0|4095] "km/h" ADAS_DOMAIN
 SG_ SIG_101_01 : 28|12@1+ (0.1,0.0) [0|4095] "rpm" ADAS_DOMAIN
 SG_ SIG_101_02 : 40|12@1+ (0.1,0.0) [0|4095] "Nm" ADAS_DOMAIN
 SG_ SIG_101_03 : 52|12@1+ (0.1,0.0) [0|4095] "Nm" ADAS_DOMAIN
 SG_ SIG_101_04 : 64|12@1+ (0.1,0.0) [0|4095] "m" ADAS_DOMAIN
 SG_ SIG_101_05 : 76|12@1+ (0.1,0.0) [0|4095] "obj" ADAS_DOMAIN
 SG_ SIG_101_06 : 88|12@1+ (0.1,0.0) [0|4095] "km/h" ADAS_DOMAIN
 SG_ SIG_101_07 : 100|12@1+ (0.1,0.0) [0|4095] "m" ADAS_DOMAIN
 SG_ SIG_101_08 : 112|12@1+ (0.1,0.0) [0|4095] "Nm" ADAS_DOMAIN
 SG_ SIG_101_09 : 124|12@1+ (0.1,0.0) [0|4095] "m" ADAS_DOMAIN
 SG_ SIG_101_10 : 136|12@1+ (0.1,0.0) [0|4095] "%" ADAS_DOMAIN
 SG_ SIG_101_11 : 148|12@1+ (0.1,0.0) [0|4095] "Nm" ADAS_DOMAIN
 SG_ RouteInfoChar_00 : 160|8@1+ (1,0) [0|255] "ascii" ADAS_DOMAIN
 SG_ RouteInfoChar_01 : 168|8@1+ (1,0) [0|255] "ascii" ADAS_DOMAIN
 SG_ RouteInfoChar_02 : 176|8@1+ (1,0) [0|255] "ascii" ADAS_DOMAIN
 SG_ RouteInfoChar_03 : 184|8@1+ (1,0) [0|255] "ascii" ADAS_DOMAIN
 SG_ RouteInfoChar_04 : 192|8@1+ (1,0) [0|255] "ascii" ADAS_DOMAIN
 SG_ RouteInfoChar_05 : 200|8@1+ (1,0) [0|255] "ascii" ADAS_DOMAIN
 SG_ RouteInfoChar_06 : 208|8@1+ (1,0) [0|255] "ascii" ADAS_DOMAIN
 SG_ RouteInfoChar_07 : 216|8@1+ (1,0) [0|255] "ascii" ADAS_DOMAIN
 SG_ RouteInfoChar_08 : 224|8@1+ (1,0) [0|255] "ascii" ADAS_DOMAIN
 SG_ RouteInfoChar_09 : 232|8@1+ (1,0) [0|255] "ascii" ADAS_DOMAIN
 SG_ RouteInfoChar_10 : 240|8@1+ (1,0) [0|255] "ascii" ADAS_DOMAIN
 SG_ RouteInfoChar_11 : 248|8@1+ (1,0) [0|255] "ascii" ADAS_DOMAIN
 SG_ RouteInfoChar_12 : 256|8@1+ (1,0) [0|255] "ascii" ADAS_DOMAIN
 SG_ RouteInfoChar_13 : 264|8@1+ (1,0) [0|255] "ascii" ADAS_DOMAIN
 SG_ RouteInfoChar_14 : 272|8@1+ (1,0) [0|255] "ascii" ADAS_DOMAIN
 SG_ RouteInfoChar_15 : 280|8@1+ (1,0) [0|255] "ascii" ADAS_DOMAIN
 SG_ RouteInfoChar_16 : 288|8@1+ (1,0) [0|255] "ascii" ADAS_DOMAIN
 SG_ RouteInfoChar_17 : 296|8@1+ (1,0) [0|255] "ascii" ADAS_DOMAIN
 SG_ RouteInfoChar_18 : 304|8@1+ (1,0) [0|255] "ascii" ADAS_DOMAIN
 SG_ RouteInfoChar_19 : 312|8@1+ (1,0) [0|255] "ascii" ADAS_DOMAIN
 SG_ RouteInfoChar_20 : 320|8@1+ (1,0) [0|255] "ascii" ADAS_DOMAIN
 SG_ RouteInfoChar_21 : 328|8@1+ (1,0) [0|255] "ascii" ADAS_DOMAIN
 SG_ RouteInfoChar_22 : 336|8@1+ (1,0) [0|255] "ascii" ADAS_DOMAIN
 SG_ RouteInfoChar_23 : 344|8@1+ (1,0) [0|255] "ascii" ADAS_DOMAIN
 SG_ RouteInfoChar_24 : 352|8@1+ (1,0) [0|255] "ascii" ADAS_DOMAIN
 SG_ RouteInfoChar_25 : 360|8@1+ (1,0) [0|255] "ascii" ADAS_DOMAIN
 SG_ RouteInfoChar_26 : 368|8@1+ (1,0) [0|255] "ascii" ADAS_DOMAIN
 SG_ RouteInfoChar_27 : 376|8@1+ (1,0) [0|255] "ascii" ADAS_DOMAIN
 SG_ RouteInfoChar_28 : 384|8@1+ (1,0) [0|255] "ascii" ADAS_DOMAIN
 SG_ RouteInfoChar_29 : 392|8@1+ (1,0) [0|255] "ascii" ADAS_DOMAIN
 SG_ RouteInfoChar_30 : 400|8@1+ (1,0) [0|255] "ascii" ADAS_DOMAIN
 SG_ RouteInfoChar_31 : 408|8@1+ (1,0) [0|255] "ascii" ADAS_DOMAIN
 SG_ RouteInfoChar_32 : 416|8@1+ (1,0) [0|255] "ascii" ADAS_DOMAIN
 SG_ RouteInfoChar_33 : 424|8@1+ (1,0) [0|255] "ascii" ADAS_DOMAIN
 SG_ RouteInfoChar_34 : 432|8@1+ (1,0) [0|255] "ascii" ADAS_DOMAIN
 SG_ RouteInfoChar_35 : 440|8@1+ (1,0) [0|255] "ascii" ADAS_DOMAIN
 SG_ RouteInfoChar_36 : 448|8@1+ (1,0) [0|255] "ascii" ADAS_DOMAIN
 SG_ RouteInfoChar_37 : 456|8@1+ (1,0) [0|255] "ascii" ADAS_DOMAIN
 SG_ RouteInfoChar_38 : 464|8@1+ (1,0) [0|255] "ascii" ADAS_DOMAIN
 SG_ RouteInfoChar_39 : 472|8@1+ (1,0) [0|255] "ascii" ADAS_DOMAIN
 SG_ RouteInfoChar_40 : 480|8@1+ (1,0) [0|255] "ascii" ADAS_DOMAIN
 SG_ RouteInfoChar_41 : 488|8@1+ (1,0) [0|255] "ascii" ADAS_DOMAIN
 SG_ RouteInfoChar_42 : 496|8@1+ (1,0) [0|255] "ascii" ADAS_DOMAIN
 SG_ RouteInfoChar_43 : 504|8@1+ (1,0) [0|255] "ascii" ADAS_DOMAIN
CM_ BO_ 257 "Cycle=33ms; Channel=CAN1; CAN-FD; NominalBitrate=500kbit/s; DataBitrate=500kbit/s;  Data request; receiver answers with response frame; PayloadRouteInfo='CAMERA_FRONT_WIDE -> ADAS_DOMAIN' in bytes 20-63;";

BO_ 1537 RESP_001_ADAS_DOMAIN_TO_CAMERA_FRONT_WIDE: 16 ADAS_DOMAIN
 SG_ CRC8 : 0|8@1+ (1,0) [0|255] "" CAMERA_FRONT_WIDE
 SG_ ResponseCounter : 8|4@1+ (1,0) [0|15] "" CAMERA_FRONT_WIDE
 SG_ AckState : 12|4@1+ (1,0) [0|15] "" CAMERA_FRONT_WIDE
 SG_ ReceivedFrameId : 16|11@1+ (1,0) [0|2047] "" CAMERA_FRONT_WIDE
 SG_ ReceivedCounter : 27|4@1+ (1,0) [0|15] "" CAMERA_FRONT_WIDE
 SG_ ChecksumOk : 31|1@1+ (1,0) [0|1] "" CAMERA_FRONT_WIDE
 SG_ PayloadLength : 32|8@1+ (1,0) [0|64] "byte" CAMERA_FRONT_WIDE
 SG_ ErrorCode : 40|8@1+ (1,0) [0|255] "" CAMERA_FRONT_WIDE
 SG_ ProcessingTimeUs : 48|16@1+ (1,0) [0|65535] "us" CAMERA_FRONT_WIDE
 SG_ ResponseSequence : 64|16@1+ (1,0) [0|65535] "" CAMERA_FRONT_WIDE
 SG_ ReceivedCrc : 80|8@1+ (1,0) [0|255] "" CAMERA_FRONT_WIDE
 SG_ CalculatedCrc : 88|8@1+ (1,0) [0|255] "" CAMERA_FRONT_WIDE
CM_ BO_ 1537 "Cycle=33ms; Channel=CAN1; CAN-FD; NominalBitrate=500kbit/s; DataBitrate=500kbit/s;  ResponseFor=0x101; ACK/NACK with CRC, DLC and counter check;";

BO_ 258 DATA_002_RADAR_FRONT_LONG_RANGE_TO_ADAS_DOMAIN: 64 RADAR_FRONT_LONG_RANGE
 SG_ CRC8 : 0|8@1+ (1,0) [0|255] "" ADAS_DOMAIN
 SG_ AliveCounter : 8|4@1+ (1,0) [0|15] "" ADAS_DOMAIN
 SG_ MuxState : 12|4@1+ (1,0) [0|15] "" ADAS_DOMAIN
 SG_ SIG_102_00 : 16|12@1+ (0.1,0.0) [0|4095] "C" ADAS_DOMAIN
 SG_ SIG_102_01 : 28|12@1+ (0.1,0.0) [0|4095] "obj" ADAS_DOMAIN
 SG_ SIG_102_02 : 40|12@1+ (0.1,0.0) [0|4095] "V" ADAS_DOMAIN
 SG_ SIG_102_03 : 52|12@1+ (0.1,0.0) [0|4095] "km/h" ADAS_DOMAIN
 SG_ SIG_102_04 : 64|12@1+ (0.1,0.0) [0|4095] "deg" ADAS_DOMAIN
 SG_ SIG_102_05 : 76|12@1+ (0.1,0.0) [0|4095] "%" ADAS_DOMAIN
 SG_ SIG_102_06 : 88|12@1+ (0.1,0.0) [0|4095] "A" ADAS_DOMAIN
 SG_ SIG_102_07 : 100|12@1+ (0.1,0.0) [0|4095] "V" ADAS_DOMAIN
 SG_ SIG_102_08 : 112|12@1+ (0.1,0.0) [0|4095] "deg" ADAS_DOMAIN
 SG_ SIG_102_09 : 124|12@1+ (0.1,0.0) [0|4095] "Nm" ADAS_DOMAIN
 SG_ SIG_102_10 : 136|12@1+ (0.1,0.0) [0|4095] "A" ADAS_DOMAIN
 SG_ SIG_102_11 : 148|12@1+ (0.1,0.0) [0|4095] "rpm" ADAS_DOMAIN
 SG_ RouteInfoChar_00 : 160|8@1+ (1,0) [0|255] "ascii" ADAS_DOMAIN
 SG_ RouteInfoChar_01 : 168|8@1+ (1,0) [0|255] "ascii" ADAS_DOMAIN
 SG_ RouteInfoChar_02 : 176|8@1+ (1,0) [0|255] "ascii" ADAS_DOMAIN
 SG_ RouteInfoChar_03 : 184|8@1+ (1,0) [0|255] "ascii" ADAS_DOMAIN
 SG_ RouteInfoChar_04 : 192|8@1+ (1,0) [0|255] "ascii" ADAS_DOMAIN
 SG_ RouteInfoChar_05 : 200|8@1+ (1,0) [0|255] "ascii" ADAS_DOMAIN
 SG_ RouteInfoChar_06 : 208|8@1+ (1,0) [0|255] "ascii" ADAS_DOMAIN
 SG_ RouteInfoChar_07 : 216|8@1+ (1,0) [0|255] "ascii" ADAS_DOMAIN
 SG_ RouteInfoChar_08 : 224|8@1+ (1,0) [0|255] "ascii" ADAS_DOMAIN
 SG_ RouteInfoChar_09 : 232|8@1+ (1,0) [0|255] "ascii" ADAS_DOMAIN
 SG_ RouteInfoChar_10 : 240|8@1+ (1,0) [0|255] "ascii" ADAS_DOMAIN
 SG_ RouteInfoChar_11 : 248|8@1+ (1,0) [0|255] "ascii" ADAS_DOMAIN
 SG_ RouteInfoChar_12 : 256|8@1+ (1,0) [0|255] "ascii" ADAS_DOMAIN
 SG_ RouteInfoChar_13 : 264|8@1+ (1,0) [0|255] "ascii" ADAS_DOMAIN
 SG_ RouteInfoChar_14 : 272|8@1+ (1,0) [0|255] "ascii" ADAS_DOMAIN
 SG_ RouteInfoChar_15 : 280|8@1+ (1,0) [0|255] "ascii" ADAS_DOMAIN
 SG_ RouteInfoChar_16 : 288|8@1+ (1,0) [0|255] "ascii" ADAS_DOMAIN
 SG_ RouteInfoChar_17 : 296|8@1+ (1,0) [0|255] "ascii" ADAS_DOMAIN
 SG_ RouteInfoChar_18 : 304|8@1+ (1,0) [0|255] "ascii" ADAS_DOMAIN
 SG_ RouteInfoChar_19 : 312|8@1+ (1,0) [0|255] "ascii" ADAS_DOMAIN
 SG_ RouteInfoChar_20 : 320|8@1+ (1,0) [0|255] "ascii" ADAS_DOMAIN
 SG_ RouteInfoChar_21 : 328|8@1+ (1,0) [0|255] "ascii" ADAS_DOMAIN
 SG_ RouteInfoChar_22 : 336|8@1+ (1,0) [0|255] "ascii" ADAS_DOMAIN
 SG_ RouteInfoChar_23 : 344|8@1+ (1,0) [0|255] "ascii" ADAS_DOMAIN
 SG_ RouteInfoChar_24 : 352|8@1+ (1,0) [0|255] "ascii" ADAS_DOMAIN
 SG_ RouteInfoChar_25 : 360|8@1+ (1,0) [0|255] "ascii" ADAS_DOMAIN
 SG_ RouteInfoChar_26 : 368|8@1+ (1,0) [0|255] "ascii" ADAS_DOMAIN
 SG_ RouteInfoChar_27 : 376|8@1+ (1,0) [0|255] "ascii" ADAS_DOMAIN
 SG_ RouteInfoChar_28 : 384|8@1+ (1,0) [0|255] "ascii" ADAS_DOMAIN
 SG_ RouteInfoChar_29 : 392|8@1+ (1,0) [0|255] "ascii" ADAS_DOMAIN
 SG_ RouteInfoChar_30 : 400|8@1+ (1,0) [0|255] "ascii" ADAS_DOMAIN
 SG_ RouteInfoChar_31 : 408|8@1+ (1,0) [0|255] "ascii" ADAS_DOMAIN
 SG_ RouteInfoChar_32 : 416|8@1+ (1,0) [0|255] "ascii" ADAS_DOMAIN
 SG_ RouteInfoChar_33 : 424|8@1+ (1,0) [0|255] "ascii" ADAS_DOMAIN
 SG_ RouteInfoChar_34 : 432|8@1+ (1,0) [0|255] "ascii" ADAS_DOMAIN
 SG_ RouteInfoChar_35 : 440|8@1+ (1,0) [0|255] "ascii" ADAS_DOMAIN
 SG_ RouteInfoChar_36 : 448|8@1+ (1,0) [0|255] "ascii" ADAS_DOMAIN
 SG_ RouteInfoChar_37 : 456|8@1+ (1,0) [0|255] "ascii" ADAS_DOMAIN
 SG_ RouteInfoChar_38 : 464|8@1+ (1,0) [0|255] "ascii" ADAS_DOMAIN
 SG_ RouteInfoChar_39 : 472|8@1+ (1,0) [0|255] "ascii" ADAS_DOMAIN
 SG_ RouteInfoChar_40 : 480|8@1+ (1,0) [0|255] "ascii" ADAS_DOMAIN
 SG_ RouteInfoChar_41 : 488|8@1+ (1,0) [0|255] "ascii" ADAS_DOMAIN
 SG_ RouteInfoChar_42 : 496|8@1+ (1,0) [0|255] "ascii" ADAS_DOMAIN
 SG_ RouteInfoChar_43 : 504|8@1+ (1,0) [0|255] "ascii" ADAS_DOMAIN
CM_ BO_ 258 "Cycle=20ms; Channel=CAN2; CAN-FD; NominalBitrate=500kbit/s; DataBitrate=500kbit/s;  Data request; receiver answers with response frame; PayloadRouteInfo='RADAR_FRONT_LONG_RANGE -> ADAS_DOMAIN' in bytes 20-63;";

BO_ 1538 RESP_002_ADAS_DOMAIN_TO_RADAR_FRONT_LONG_RANGE: 16 ADAS_DOMAIN
 SG_ CRC8 : 0|8@1+ (1,0) [0|255] "" RADAR_FRONT_LONG_RANGE
 SG_ ResponseCounter : 8|4@1+ (1,0) [0|15] "" RADAR_FRONT_LONG_RANGE
 SG_ AckState : 12|4@1+ (1,0) [0|15] "" RADAR_FRONT_LONG_RANGE
 SG_ ReceivedFrameId : 16|11@1+ (1,0) [0|2047] "" RADAR_FRONT_LONG_RANGE
 SG_ ReceivedCounter : 27|4@1+ (1,0) [0|15] "" RADAR_FRONT_LONG_RANGE
 SG_ ChecksumOk : 31|1@1+ (1,0) [0|1] "" RADAR_FRONT_LONG_RANGE
 SG_ PayloadLength : 32|8@1+ (1,0) [0|64] "byte" RADAR_FRONT_LONG_RANGE
 SG_ ErrorCode : 40|8@1+ (1,0) [0|255] "" RADAR_FRONT_LONG_RANGE
 SG_ ProcessingTimeUs : 48|16@1+ (1,0) [0|65535] "us" RADAR_FRONT_LONG_RANGE
 SG_ ResponseSequence : 64|16@1+ (1,0) [0|65535] "" RADAR_FRONT_LONG_RANGE
 SG_ ReceivedCrc : 80|8@1+ (1,0) [0|255] "" RADAR_FRONT_LONG_RANGE
 SG_ CalculatedCrc : 88|8@1+ (1,0) [0|255] "" RADAR_FRONT_LONG_RANGE
CM_ BO_ 1538 "Cycle=20ms; Channel=CAN2; CAN-FD; NominalBitrate=500kbit/s; DataBitrate=500kbit/s;  ResponseFor=0x102; ACK/NACK with CRC, DLC and counter check;";

BO_ 259 DATA_003_RADAR_REAR_CROSS_TRAFFIC_TO_ADAS_DOMAIN: 64 RADAR_REAR_CROSS_TRAFFIC
 SG_ CRC8 : 0|8@1+ (1,0) [0|255] "" ADAS_DOMAIN
 SG_ AliveCounter : 8|4@1+ (1,0) [0|15] "" ADAS_DOMAIN
 SG_ MuxState : 12|4@1+ (1,0) [0|15] "" ADAS_DOMAIN
 SG_ SIG_103_00 : 16|12@1+ (0.1,0.0) [0|4095] "rpm" ADAS_DOMAIN
 SG_ SIG_103_01 : 28|12@1+ (0.1,0.0) [0|4095] "%" ADAS_DOMAIN
 SG_ SIG_103_02 : 40|12@1+ (0.1,0.0) [0|4095] "rpm" ADAS_DOMAIN
 SG_ SIG_103_03 : 52|12@1+ (0.1,0.0) [0|4095] "A" ADAS_DOMAIN
 SG_ SIG_103_04 : 64|12@1+ (0.1,0.0) [0|4095] "A" ADAS_DOMAIN
 SG_ SIG_103_05 : 76|12@1+ (0.1,0.0) [0|4095] "obj" ADAS_DOMAIN
 SG_ SIG_103_06 : 88|12@1+ (0.1,0.0) [0|4095] "V" ADAS_DOMAIN
 SG_ SIG_103_07 : 100|12@1+ (0.1,0.0) [0|4095] "km/h" ADAS_DOMAIN
 SG_ SIG_103_08 : 112|12@1+ (0.1,0.0) [0|4095] "C" ADAS_DOMAIN
 SG_ SIG_103_09 : 124|12@1+ (0.1,0.0) [0|4095] "m" ADAS_DOMAIN
 SG_ SIG_103_10 : 136|12@1+ (0.1,0.0) [0|4095] "rpm" ADAS_DOMAIN
 SG_ SIG_103_11 : 148|12@1+ (0.1,0.0) [0|4095] "%" ADAS_DOMAIN
 SG_ RouteInfoChar_00 : 160|8@1+ (1,0) [0|255] "ascii" ADAS_DOMAIN
 SG_ RouteInfoChar_01 : 168|8@1+ (1,0) [0|255] "ascii" ADAS_DOMAIN
 SG_ RouteInfoChar_02 : 176|8@1+ (1,0) [0|255] "ascii" ADAS_DOMAIN
 SG_ RouteInfoChar_03 : 184|8@1+ (1,0) [0|255] "ascii" ADAS_DOMAIN
 SG_ RouteInfoChar_04 : 192|8@1+ (1,0) [0|255] "ascii" ADAS_DOMAIN
 SG_ RouteInfoChar_05 : 200|8@1+ (1,0) [0|255] "ascii" ADAS_DOMAIN
 SG_ RouteInfoChar_06 : 208|8@1+ (1,0) [0|255] "ascii" ADAS_DOMAIN
 SG_ RouteInfoChar_07 : 216|8@1+ (1,0) [0|255] "ascii" ADAS_DOMAIN
 SG_ RouteInfoChar_08 : 224|8@1+ (1,0) [0|255] "ascii" ADAS_DOMAIN
 SG_ RouteInfoChar_09 : 232|8@1+ (1,0) [0|255] "ascii" ADAS_DOMAIN
 SG_ RouteInfoChar_10 : 240|8@1+ (1,0) [0|255] "ascii" ADAS_DOMAIN
 SG_ RouteInfoChar_11 : 248|8@1+ (1,0) [0|255] "ascii" ADAS_DOMAIN
 SG_ RouteInfoChar_12 : 256|8@1+ (1,0) [0|255] "ascii" ADAS_DOMAIN
 SG_ RouteInfoChar_13 : 264|8@1+ (1,0) [0|255] "ascii" ADAS_DOMAIN
 SG_ RouteInfoChar_14 : 272|8@1+ (1,0) [0|255] "ascii" ADAS_DOMAIN
 SG_ RouteInfoChar_15 : 280|8@1+ (1,0) [0|255] "ascii" ADAS_DOMAIN
 SG_ RouteInfoChar_16 : 288|8@1+ (1,0) [0|255] "ascii" ADAS_DOMAIN
 SG_ RouteInfoChar_17 : 296|8@1+ (1,0) [0|255] "ascii" ADAS_DOMAIN
 SG_ RouteInfoChar_18 : 304|8@1+ (1,0) [0|255] "ascii" ADAS_DOMAIN
 SG_ RouteInfoChar_19 : 312|8@1+ (1,0) [0|255] "ascii" ADAS_DOMAIN
 SG_ RouteInfoChar_20 : 320|8@1+ (1,0) [0|255] "ascii" ADAS_DOMAIN
 SG_ RouteInfoChar_21 : 328|8@1+ (1,0) [0|255] "ascii" ADAS_DOMAIN
 SG_ RouteInfoChar_22 : 336|8@1+ (1,0) [0|255] "ascii" ADAS_DOMAIN
 SG_ RouteInfoChar_23 : 344|8@1+ (1,0) [0|255] "ascii" ADAS_DOMAIN
 SG_ RouteInfoChar_24 : 352|8@1+ (1,0) [0|255] "ascii" ADAS_DOMAIN
 SG_ RouteInfoChar_25 : 360|8@1+ (1,0) [0|255] "ascii" ADAS_DOMAIN
 SG_ RouteInfoChar_26 : 368|8@1+ (1,0) [0|255] "ascii" ADAS_DOMAIN
 SG_ RouteInfoChar_27 : 376|8@1+ (1,0) [0|255] "ascii" ADAS_DOMAIN
 SG_ RouteInfoChar_28 : 384|8@1+ (1,0) [0|255] "ascii" ADAS_DOMAIN
 SG_ RouteInfoChar_29 : 392|8@1+ (1,0) [0|255] "ascii" ADAS_DOMAIN
 SG_ RouteInfoChar_30 : 400|8@1+ (1,0) [0|255] "ascii" ADAS_DOMAIN
 SG_ RouteInfoChar_31 : 408|8@1+ (1,0) [0|255] "ascii" ADAS_DOMAIN
 SG_ RouteInfoChar_32 : 416|8@1+ (1,0) [0|255] "ascii" ADAS_DOMAIN
 SG_ RouteInfoChar_33 : 424|8@1+ (1,0) [0|255] "ascii" ADAS_DOMAIN
 SG_ RouteInfoChar_34 : 432|8@1+ (1,0) [0|255] "ascii" ADAS_DOMAIN
 SG_ RouteInfoChar_35 : 440|8@1+ (1,0) [0|255] "ascii" ADAS_DOMAIN
 SG_ RouteInfoChar_36 : 448|8@1+ (1,0) [0|255] "ascii" ADAS_DOMAIN
 SG_ RouteInfoChar_37 : 456|8@1+ (1,0) [0|255] "ascii" ADAS_DOMAIN
 SG_ RouteInfoChar_38 : 464|8@1+ (1,0) [0|255] "ascii" ADAS_DOMAIN
 SG_ RouteInfoChar_39 : 472|8@1+ (1,0) [0|255] "ascii" ADAS_DOMAIN
 SG_ RouteInfoChar_40 : 480|8@1+ (1,0) [0|255] "ascii" ADAS_DOMAIN
 SG_ RouteInfoChar_41 : 488|8@1+ (1,0) [0|255] "ascii" ADAS_DOMAIN
 SG_ RouteInfoChar_42 : 496|8@1+ (1,0) [0|255] "ascii" ADAS_DOMAIN
 SG_ RouteInfoChar_43 : 504|8@1+ (1,0) [0|255] "ascii" ADAS_DOMAIN
CM_ BO_ 259 "Cycle=50ms; Channel=CAN3; CAN-FD; NominalBitrate=500kbit/s; DataBitrate=500kbit/s;  Data request; receiver answers with response frame; PayloadRouteInfo='RADAR_REAR_CROSS_TRAFFIC -> ADAS_DOMAIN' in bytes 20-63;";

BO_ 1539 RESP_003_ADAS_DOMAIN_TO_RADAR_REAR_CROSS_TRAFFIC: 16 ADAS_DOMAIN
 SG_ CRC8 : 0|8@1+ (1,0) [0|255] "" RADAR_REAR_CROSS_TRAFFIC
 SG_ ResponseCounter : 8|4@1+ (1,0) [0|15] "" RADAR_REAR_CROSS_TRAFFIC
 SG_ AckState : 12|4@1+ (1,0) [0|15] "" RADAR_REAR_CROSS_TRAFFIC
 SG_ ReceivedFrameId : 16|11@1+ (1,0) [0|2047] "" RADAR_REAR_CROSS_TRAFFIC
 SG_ ReceivedCounter : 27|4@1+ (1,0) [0|15] "" RADAR_REAR_CROSS_TRAFFIC
 SG_ ChecksumOk : 31|1@1+ (1,0) [0|1] "" RADAR_REAR_CROSS_TRAFFIC
 SG_ PayloadLength : 32|8@1+ (1,0) [0|64] "byte" RADAR_REAR_CROSS_TRAFFIC
 SG_ ErrorCode : 40|8@1+ (1,0) [0|255] "" RADAR_REAR_CROSS_TRAFFIC
 SG_ ProcessingTimeUs : 48|16@1+ (1,0) [0|65535] "us" RADAR_REAR_CROSS_TRAFFIC
 SG_ ResponseSequence : 64|16@1+ (1,0) [0|65535] "" RADAR_REAR_CROSS_TRAFFIC
 SG_ ReceivedCrc : 80|8@1+ (1,0) [0|255] "" RADAR_REAR_CROSS_TRAFFIC
 SG_ CalculatedCrc : 88|8@1+ (1,0) [0|255] "" RADAR_REAR_CROSS_TRAFFIC
CM_ BO_ 1539 "Cycle=50ms; Channel=CAN3; CAN-FD; NominalBitrate=500kbit/s; DataBitrate=500kbit/s;  ResponseFor=0x103; ACK/NACK with CRC, DLC and counter check;";

BO_ 260 DATA_004_ULTRASONIC_LEFT_CLUSTER_TO_PARK_ASSIST: 64 ULTRASONIC_LEFT_CLUSTER
 SG_ CRC8 : 0|8@1+ (1,0) [0|255] "" PARK_ASSIST
 SG_ AliveCounter : 8|4@1+ (1,0) [0|15] "" PARK_ASSIST
 SG_ MuxState : 12|4@1+ (1,0) [0|15] "" PARK_ASSIST
 SG_ SIG_104_00 : 16|12@1+ (0.1,0.0) [0|4095] "rpm" PARK_ASSIST
 SG_ SIG_104_01 : 28|12@1+ (0.1,0.0) [0|4095] "m" PARK_ASSIST
 SG_ SIG_104_02 : 40|12@1+ (0.1,0.0) [0|4095] "V" PARK_ASSIST
 SG_ SIG_104_03 : 52|12@1+ (0.1,0.0) [0|4095] "obj" PARK_ASSIST
 SG_ SIG_104_04 : 64|12@1+ (0.1,0.0) [0|4095] "A" PARK_ASSIST
 SG_ SIG_104_05 : 76|12@1+ (0.1,0.0) [0|4095] "obj" PARK_ASSIST
 SG_ SIG_104_06 : 88|12@1+ (0.1,0.0) [0|4095] "Nm" PARK_ASSIST
 SG_ SIG_104_07 : 100|12@1+ (0.1,0.0) [0|4095] "rpm" PARK_ASSIST
 SG_ SIG_104_08 : 112|12@1+ (0.1,0.0) [0|4095] "km/h" PARK_ASSIST
 SG_ SIG_104_09 : 124|12@1+ (0.1,0.0) [0|4095] "Nm" PARK_ASSIST
 SG_ SIG_104_10 : 136|12@1+ (0.1,0.0) [0|4095] "V" PARK_ASSIST
 SG_ SIG_104_11 : 148|12@1+ (0.1,0.0) [0|4095] "rpm" PARK_ASSIST
 SG_ RouteInfoChar_00 : 160|8@1+ (1,0) [0|255] "ascii" PARK_ASSIST
 SG_ RouteInfoChar_01 : 168|8@1+ (1,0) [0|255] "ascii" PARK_ASSIST
 SG_ RouteInfoChar_02 : 176|8@1+ (1,0) [0|255] "ascii" PARK_ASSIST
 SG_ RouteInfoChar_03 : 184|8@1+ (1,0) [0|255] "ascii" PARK_ASSIST
 SG_ RouteInfoChar_04 : 192|8@1+ (1,0) [0|255] "ascii" PARK_ASSIST
 SG_ RouteInfoChar_05 : 200|8@1+ (1,0) [0|255] "ascii" PARK_ASSIST
 SG_ RouteInfoChar_06 : 208|8@1+ (1,0) [0|255] "ascii" PARK_ASSIST
 SG_ RouteInfoChar_07 : 216|8@1+ (1,0) [0|255] "ascii" PARK_ASSIST
 SG_ RouteInfoChar_08 : 224|8@1+ (1,0) [0|255] "ascii" PARK_ASSIST
 SG_ RouteInfoChar_09 : 232|8@1+ (1,0) [0|255] "ascii" PARK_ASSIST
 SG_ RouteInfoChar_10 : 240|8@1+ (1,0) [0|255] "ascii" PARK_ASSIST
 SG_ RouteInfoChar_11 : 248|8@1+ (1,0) [0|255] "ascii" PARK_ASSIST
 SG_ RouteInfoChar_12 : 256|8@1+ (1,0) [0|255] "ascii" PARK_ASSIST
 SG_ RouteInfoChar_13 : 264|8@1+ (1,0) [0|255] "ascii" PARK_ASSIST
 SG_ RouteInfoChar_14 : 272|8@1+ (1,0) [0|255] "ascii" PARK_ASSIST
 SG_ RouteInfoChar_15 : 280|8@1+ (1,0) [0|255] "ascii" PARK_ASSIST
 SG_ RouteInfoChar_16 : 288|8@1+ (1,0) [0|255] "ascii" PARK_ASSIST
 SG_ RouteInfoChar_17 : 296|8@1+ (1,0) [0|255] "ascii" PARK_ASSIST
 SG_ RouteInfoChar_18 : 304|8@1+ (1,0) [0|255] "ascii" PARK_ASSIST
 SG_ RouteInfoChar_19 : 312|8@1+ (1,0) [0|255] "ascii" PARK_ASSIST
 SG_ RouteInfoChar_20 : 320|8@1+ (1,0) [0|255] "ascii" PARK_ASSIST
 SG_ RouteInfoChar_21 : 328|8@1+ (1,0) [0|255] "ascii" PARK_ASSIST
 SG_ RouteInfoChar_22 : 336|8@1+ (1,0) [0|255] "ascii" PARK_ASSIST
 SG_ RouteInfoChar_23 : 344|8@1+ (1,0) [0|255] "ascii" PARK_ASSIST
 SG_ RouteInfoChar_24 : 352|8@1+ (1,0) [0|255] "ascii" PARK_ASSIST
 SG_ RouteInfoChar_25 : 360|8@1+ (1,0) [0|255] "ascii" PARK_ASSIST
 SG_ RouteInfoChar_26 : 368|8@1+ (1,0) [0|255] "ascii" PARK_ASSIST
 SG_ RouteInfoChar_27 : 376|8@1+ (1,0) [0|255] "ascii" PARK_ASSIST
 SG_ RouteInfoChar_28 : 384|8@1+ (1,0) [0|255] "ascii" PARK_ASSIST
 SG_ RouteInfoChar_29 : 392|8@1+ (1,0) [0|255] "ascii" PARK_ASSIST
 SG_ RouteInfoChar_30 : 400|8@1+ (1,0) [0|255] "ascii" PARK_ASSIST
 SG_ RouteInfoChar_31 : 408|8@1+ (1,0) [0|255] "ascii" PARK_ASSIST
 SG_ RouteInfoChar_32 : 416|8@1+ (1,0) [0|255] "ascii" PARK_ASSIST
 SG_ RouteInfoChar_33 : 424|8@1+ (1,0) [0|255] "ascii" PARK_ASSIST
 SG_ RouteInfoChar_34 : 432|8@1+ (1,0) [0|255] "ascii" PARK_ASSIST
 SG_ RouteInfoChar_35 : 440|8@1+ (1,0) [0|255] "ascii" PARK_ASSIST
 SG_ RouteInfoChar_36 : 448|8@1+ (1,0) [0|255] "ascii" PARK_ASSIST
 SG_ RouteInfoChar_37 : 456|8@1+ (1,0) [0|255] "ascii" PARK_ASSIST
 SG_ RouteInfoChar_38 : 464|8@1+ (1,0) [0|255] "ascii" PARK_ASSIST
 SG_ RouteInfoChar_39 : 472|8@1+ (1,0) [0|255] "ascii" PARK_ASSIST
 SG_ RouteInfoChar_40 : 480|8@1+ (1,0) [0|255] "ascii" PARK_ASSIST
 SG_ RouteInfoChar_41 : 488|8@1+ (1,0) [0|255] "ascii" PARK_ASSIST
 SG_ RouteInfoChar_42 : 496|8@1+ (1,0) [0|255] "ascii" PARK_ASSIST
 SG_ RouteInfoChar_43 : 504|8@1+ (1,0) [0|255] "ascii" PARK_ASSIST
CM_ BO_ 260 "Cycle=40ms; Channel=CAN4; CAN-FD; NominalBitrate=500kbit/s; DataBitrate=500kbit/s;  Data request; receiver answers with response frame; PayloadRouteInfo='ULTRASONIC_LEFT_CLUSTER -> PARK_ASSIST' in bytes 20-63;";

BO_ 1540 RESP_004_PARK_ASSIST_TO_ULTRASONIC_LEFT_CLUSTER: 16 PARK_ASSIST
 SG_ CRC8 : 0|8@1+ (1,0) [0|255] "" ULTRASONIC_LEFT_CLUSTER
 SG_ ResponseCounter : 8|4@1+ (1,0) [0|15] "" ULTRASONIC_LEFT_CLUSTER
 SG_ AckState : 12|4@1+ (1,0) [0|15] "" ULTRASONIC_LEFT_CLUSTER
 SG_ ReceivedFrameId : 16|11@1+ (1,0) [0|2047] "" ULTRASONIC_LEFT_CLUSTER
 SG_ ReceivedCounter : 27|4@1+ (1,0) [0|15] "" ULTRASONIC_LEFT_CLUSTER
 SG_ ChecksumOk : 31|1@1+ (1,0) [0|1] "" ULTRASONIC_LEFT_CLUSTER
 SG_ PayloadLength : 32|8@1+ (1,0) [0|64] "byte" ULTRASONIC_LEFT_CLUSTER
 SG_ ErrorCode : 40|8@1+ (1,0) [0|255] "" ULTRASONIC_LEFT_CLUSTER
 SG_ ProcessingTimeUs : 48|16@1+ (1,0) [0|65535] "us" ULTRASONIC_LEFT_CLUSTER
 SG_ ResponseSequence : 64|16@1+ (1,0) [0|65535] "" ULTRASONIC_LEFT_CLUSTER
 SG_ ReceivedCrc : 80|8@1+ (1,0) [0|255] "" ULTRASONIC_LEFT_CLUSTER
 SG_ CalculatedCrc : 88|8@1+ (1,0) [0|255] "" ULTRASONIC_LEFT_CLUSTER
CM_ BO_ 1540 "Cycle=40ms; Channel=CAN4; CAN-FD; NominalBitrate=500kbit/s; DataBitrate=500kbit/s;  ResponseFor=0x104; ACK/NACK with CRC, DLC and counter check;";

BO_ 261 DATA_005_ULTRASONIC_RIGHT_CLUSTER_TO_PARK_ASSIST: 64 ULTRASONIC_RIGHT_CLUSTER
 SG_ CRC8 : 0|8@1+ (1,0) [0|255] "" PARK_ASSIST
 SG_ AliveCounter : 8|4@1+ (1,0) [0|15] "" PARK_ASSIST
 SG_ MuxState : 12|4@1+ (1,0) [0|15] "" PARK_ASSIST
 SG_ SIG_105_00 : 16|12@1+ (0.1,0.0) [0|4095] "Nm" PARK_ASSIST
 SG_ SIG_105_01 : 28|12@1+ (0.1,0.0) [0|4095] "rpm" PARK_ASSIST
 SG_ SIG_105_02 : 40|12@1+ (0.1,0.0) [0|4095] "%" PARK_ASSIST
 SG_ SIG_105_03 : 52|12@1+ (0.1,0.0) [0|4095] "V" PARK_ASSIST
 SG_ SIG_105_04 : 64|12@1+ (0.1,0.0) [0|4095] "C" PARK_ASSIST
 SG_ SIG_105_05 : 76|12@1+ (0.1,0.0) [0|4095] "A" PARK_ASSIST
 SG_ SIG_105_06 : 88|12@1+ (0.1,0.0) [0|4095] "deg" PARK_ASSIST
 SG_ SIG_105_07 : 100|12@1+ (0.1,0.0) [0|4095] "A" PARK_ASSIST
 SG_ SIG_105_08 : 112|12@1+ (0.1,0.0) [0|4095] "A" PARK_ASSIST
 SG_ SIG_105_09 : 124|12@1+ (0.1,0.0) [0|4095] "Nm" PARK_ASSIST
 SG_ SIG_105_10 : 136|12@1+ (0.1,0.0) [0|4095] "V" PARK_ASSIST
 SG_ SIG_105_11 : 148|12@1+ (0.1,0.0) [0|4095] "rpm" PARK_ASSIST
 SG_ RouteInfoChar_00 : 160|8@1+ (1,0) [0|255] "ascii" PARK_ASSIST
 SG_ RouteInfoChar_01 : 168|8@1+ (1,0) [0|255] "ascii" PARK_ASSIST
 SG_ RouteInfoChar_02 : 176|8@1+ (1,0) [0|255] "ascii" PARK_ASSIST
 SG_ RouteInfoChar_03 : 184|8@1+ (1,0) [0|255] "ascii" PARK_ASSIST
 SG_ RouteInfoChar_04 : 192|8@1+ (1,0) [0|255] "ascii" PARK_ASSIST
 SG_ RouteInfoChar_05 : 200|8@1+ (1,0) [0|255] "ascii" PARK_ASSIST
 SG_ RouteInfoChar_06 : 208|8@1+ (1,0) [0|255] "ascii" PARK_ASSIST
 SG_ RouteInfoChar_07 : 216|8@1+ (1,0) [0|255] "ascii" PARK_ASSIST
 SG_ RouteInfoChar_08 : 224|8@1+ (1,0) [0|255] "ascii" PARK_ASSIST
 SG_ RouteInfoChar_09 : 232|8@1+ (1,0) [0|255] "ascii" PARK_ASSIST
 SG_ RouteInfoChar_10 : 240|8@1+ (1,0) [0|255] "ascii" PARK_ASSIST
 SG_ RouteInfoChar_11 : 248|8@1+ (1,0) [0|255] "ascii" PARK_ASSIST
 SG_ RouteInfoChar_12 : 256|8@1+ (1,0) [0|255] "ascii" PARK_ASSIST
 SG_ RouteInfoChar_13 : 264|8@1+ (1,0) [0|255] "ascii" PARK_ASSIST
 SG_ RouteInfoChar_14 : 272|8@1+ (1,0) [0|255] "ascii" PARK_ASSIST
 SG_ RouteInfoChar_15 : 280|8@1+ (1,0) [0|255] "ascii" PARK_ASSIST
 SG_ RouteInfoChar_16 : 288|8@1+ (1,0) [0|255] "ascii" PARK_ASSIST
 SG_ RouteInfoChar_17 : 296|8@1+ (1,0) [0|255] "ascii" PARK_ASSIST
 SG_ RouteInfoChar_18 : 304|8@1+ (1,0) [0|255] "ascii" PARK_ASSIST
 SG_ RouteInfoChar_19 : 312|8@1+ (1,0) [0|255] "ascii" PARK_ASSIST
 SG_ RouteInfoChar_20 : 320|8@1+ (1,0) [0|255] "ascii" PARK_ASSIST
 SG_ RouteInfoChar_21 : 328|8@1+ (1,0) [0|255] "ascii" PARK_ASSIST
 SG_ RouteInfoChar_22 : 336|8@1+ (1,0) [0|255] "ascii" PARK_ASSIST
 SG_ RouteInfoChar_23 : 344|8@1+ (1,0) [0|255] "ascii" PARK_ASSIST
 SG_ RouteInfoChar_24 : 352|8@1+ (1,0) [0|255] "ascii" PARK_ASSIST
 SG_ RouteInfoChar_25 : 360|8@1+ (1,0) [0|255] "ascii" PARK_ASSIST
 SG_ RouteInfoChar_26 : 368|8@1+ (1,0) [0|255] "ascii" PARK_ASSIST
 SG_ RouteInfoChar_27 : 376|8@1+ (1,0) [0|255] "ascii" PARK_ASSIST
 SG_ RouteInfoChar_28 : 384|8@1+ (1,0) [0|255] "ascii" PARK_ASSIST
 SG_ RouteInfoChar_29 : 392|8@1+ (1,0) [0|255] "ascii" PARK_ASSIST
 SG_ RouteInfoChar_30 : 400|8@1+ (1,0) [0|255] "ascii" PARK_ASSIST
 SG_ RouteInfoChar_31 : 408|8@1+ (1,0) [0|255] "ascii" PARK_ASSIST
 SG_ RouteInfoChar_32 : 416|8@1+ (1,0) [0|255] "ascii" PARK_ASSIST
 SG_ RouteInfoChar_33 : 424|8@1+ (1,0) [0|255] "ascii" PARK_ASSIST
 SG_ RouteInfoChar_34 : 432|8@1+ (1,0) [0|255] "ascii" PARK_ASSIST
 SG_ RouteInfoChar_35 : 440|8@1+ (1,0) [0|255] "ascii" PARK_ASSIST
 SG_ RouteInfoChar_36 : 448|8@1+ (1,0) [0|255] "ascii" PARK_ASSIST
 SG_ RouteInfoChar_37 : 456|8@1+ (1,0) [0|255] "ascii" PARK_ASSIST
 SG_ RouteInfoChar_38 : 464|8@1+ (1,0) [0|255] "ascii" PARK_ASSIST
 SG_ RouteInfoChar_39 : 472|8@1+ (1,0) [0|255] "ascii" PARK_ASSIST
 SG_ RouteInfoChar_40 : 480|8@1+ (1,0) [0|255] "ascii" PARK_ASSIST
 SG_ RouteInfoChar_41 : 488|8@1+ (1,0) [0|255] "ascii" PARK_ASSIST
 SG_ RouteInfoChar_42 : 496|8@1+ (1,0) [0|255] "ascii" PARK_ASSIST
 SG_ RouteInfoChar_43 : 504|8@1+ (1,0) [0|255] "ascii" PARK_ASSIST
CM_ BO_ 261 "Cycle=40ms; Channel=CAN5; CAN-FD; NominalBitrate=500kbit/s; DataBitrate=500kbit/s;  Data request; receiver answers with response frame; PayloadRouteInfo='ULTRASONIC_RIGHT_CLUSTER -> PARK_ASSIST' in bytes 20-63;";

BO_ 1541 RESP_005_PARK_ASSIST_TO_ULTRASONIC_RIGHT_CLUSTER: 16 PARK_ASSIST
 SG_ CRC8 : 0|8@1+ (1,0) [0|255] "" ULTRASONIC_RIGHT_CLUSTER
 SG_ ResponseCounter : 8|4@1+ (1,0) [0|15] "" ULTRASONIC_RIGHT_CLUSTER
 SG_ AckState : 12|4@1+ (1,0) [0|15] "" ULTRASONIC_RIGHT_CLUSTER
 SG_ ReceivedFrameId : 16|11@1+ (1,0) [0|2047] "" ULTRASONIC_RIGHT_CLUSTER
 SG_ ReceivedCounter : 27|4@1+ (1,0) [0|15] "" ULTRASONIC_RIGHT_CLUSTER
 SG_ ChecksumOk : 31|1@1+ (1,0) [0|1] "" ULTRASONIC_RIGHT_CLUSTER
 SG_ PayloadLength : 32|8@1+ (1,0) [0|64] "byte" ULTRASONIC_RIGHT_CLUSTER
 SG_ ErrorCode : 40|8@1+ (1,0) [0|255] "" ULTRASONIC_RIGHT_CLUSTER
 SG_ ProcessingTimeUs : 48|16@1+ (1,0) [0|65535] "us" ULTRASONIC_RIGHT_CLUSTER
 SG_ ResponseSequence : 64|16@1+ (1,0) [0|65535] "" ULTRASONIC_RIGHT_CLUSTER
 SG_ ReceivedCrc : 80|8@1+ (1,0) [0|255] "" ULTRASONIC_RIGHT_CLUSTER
 SG_ CalculatedCrc : 88|8@1+ (1,0) [0|255] "" ULTRASONIC_RIGHT_CLUSTER
CM_ BO_ 1541 "Cycle=40ms; Channel=CAN5; CAN-FD; NominalBitrate=500kbit/s; DataBitrate=500kbit/s;  ResponseFor=0x105; ACK/NACK with CRC, DLC and counter check;";

BO_ 262 DATA_006_IMU_YAW_RATE_SENSOR_TO_ADAS_DOMAIN: 64 IMU_YAW_RATE_SENSOR
 SG_ CRC8 : 0|8@1+ (1,0) [0|255] "" ADAS_DOMAIN
 SG_ AliveCounter : 8|4@1+ (1,0) [0|15] "" ADAS_DOMAIN
 SG_ MuxState : 12|4@1+ (1,0) [0|15] "" ADAS_DOMAIN
 SG_ SIG_106_00 : 16|12@1+ (0.1,0.0) [0|4095] "obj" ADAS_DOMAIN
 SG_ SIG_106_01 : 28|12@1+ (0.1,0.0) [0|4095] "deg" ADAS_DOMAIN
 SG_ SIG_106_02 : 40|12@1+ (0.1,0.0) [0|4095] "m" ADAS_DOMAIN
 SG_ SIG_106_03 : 52|12@1+ (0.1,0.0) [0|4095] "Nm" ADAS_DOMAIN
 SG_ SIG_106_04 : 64|12@1+ (0.1,0.0) [0|4095] "deg" ADAS_DOMAIN
 SG_ SIG_106_05 : 76|12@1+ (0.1,0.0) [0|4095] "C" ADAS_DOMAIN
 SG_ SIG_106_06 : 88|12@1+ (0.1,0.0) [0|4095] "%" ADAS_DOMAIN
 SG_ SIG_106_07 : 100|12@1+ (0.1,0.0) [0|4095] "V" ADAS_DOMAIN
 SG_ SIG_106_08 : 112|12@1+ (0.1,0.0) [0|4095] "m" ADAS_DOMAIN
 SG_ SIG_106_09 : 124|12@1+ (0.1,0.0) [0|4095] "Nm" ADAS_DOMAIN
 SG_ SIG_106_10 : 136|12@1+ (0.1,0.0) [0|4095] "A" ADAS_DOMAIN
 SG_ SIG_106_11 : 148|12@1+ (0.1,0.0) [0|4095] "km/h" ADAS_DOMAIN
 SG_ RouteInfoChar_00 : 160|8@1+ (1,0) [0|255] "ascii" ADAS_DOMAIN
 SG_ RouteInfoChar_01 : 168|8@1+ (1,0) [0|255] "ascii" ADAS_DOMAIN
 SG_ RouteInfoChar_02 : 176|8@1+ (1,0) [0|255] "ascii" ADAS_DOMAIN
 SG_ RouteInfoChar_03 : 184|8@1+ (1,0) [0|255] "ascii" ADAS_DOMAIN
 SG_ RouteInfoChar_04 : 192|8@1+ (1,0) [0|255] "ascii" ADAS_DOMAIN
 SG_ RouteInfoChar_05 : 200|8@1+ (1,0) [0|255] "ascii" ADAS_DOMAIN
 SG_ RouteInfoChar_06 : 208|8@1+ (1,0) [0|255] "ascii" ADAS_DOMAIN
 SG_ RouteInfoChar_07 : 216|8@1+ (1,0) [0|255] "ascii" ADAS_DOMAIN
 SG_ RouteInfoChar_08 : 224|8@1+ (1,0) [0|255] "ascii" ADAS_DOMAIN
 SG_ RouteInfoChar_09 : 232|8@1+ (1,0) [0|255] "ascii" ADAS_DOMAIN
 SG_ RouteInfoChar_10 : 240|8@1+ (1,0) [0|255] "ascii" ADAS_DOMAIN
 SG_ RouteInfoChar_11 : 248|8@1+ (1,0) [0|255] "ascii" ADAS_DOMAIN
 SG_ RouteInfoChar_12 : 256|8@1+ (1,0) [0|255] "ascii" ADAS_DOMAIN
 SG_ RouteInfoChar_13 : 264|8@1+ (1,0) [0|255] "ascii" ADAS_DOMAIN
 SG_ RouteInfoChar_14 : 272|8@1+ (1,0) [0|255] "ascii" ADAS_DOMAIN
 SG_ RouteInfoChar_15 : 280|8@1+ (1,0) [0|255] "ascii" ADAS_DOMAIN
 SG_ RouteInfoChar_16 : 288|8@1+ (1,0) [0|255] "ascii" ADAS_DOMAIN
 SG_ RouteInfoChar_17 : 296|8@1+ (1,0) [0|255] "ascii" ADAS_DOMAIN
 SG_ RouteInfoChar_18 : 304|8@1+ (1,0) [0|255] "ascii" ADAS_DOMAIN
 SG_ RouteInfoChar_19 : 312|8@1+ (1,0) [0|255] "ascii" ADAS_DOMAIN
 SG_ RouteInfoChar_20 : 320|8@1+ (1,0) [0|255] "ascii" ADAS_DOMAIN
 SG_ RouteInfoChar_21 : 328|8@1+ (1,0) [0|255] "ascii" ADAS_DOMAIN
 SG_ RouteInfoChar_22 : 336|8@1+ (1,0) [0|255] "ascii" ADAS_DOMAIN
 SG_ RouteInfoChar_23 : 344|8@1+ (1,0) [0|255] "ascii" ADAS_DOMAIN
 SG_ RouteInfoChar_24 : 352|8@1+ (1,0) [0|255] "ascii" ADAS_DOMAIN
 SG_ RouteInfoChar_25 : 360|8@1+ (1,0) [0|255] "ascii" ADAS_DOMAIN
 SG_ RouteInfoChar_26 : 368|8@1+ (1,0) [0|255] "ascii" ADAS_DOMAIN
 SG_ RouteInfoChar_27 : 376|8@1+ (1,0) [0|255] "ascii" ADAS_DOMAIN
 SG_ RouteInfoChar_28 : 384|8@1+ (1,0) [0|255] "ascii" ADAS_DOMAIN
 SG_ RouteInfoChar_29 : 392|8@1+ (1,0) [0|255] "ascii" ADAS_DOMAIN
 SG_ RouteInfoChar_30 : 400|8@1+ (1,0) [0|255] "ascii" ADAS_DOMAIN
 SG_ RouteInfoChar_31 : 408|8@1+ (1,0) [0|255] "ascii" ADAS_DOMAIN
 SG_ RouteInfoChar_32 : 416|8@1+ (1,0) [0|255] "ascii" ADAS_DOMAIN
 SG_ RouteInfoChar_33 : 424|8@1+ (1,0) [0|255] "ascii" ADAS_DOMAIN
 SG_ RouteInfoChar_34 : 432|8@1+ (1,0) [0|255] "ascii" ADAS_DOMAIN
 SG_ RouteInfoChar_35 : 440|8@1+ (1,0) [0|255] "ascii" ADAS_DOMAIN
 SG_ RouteInfoChar_36 : 448|8@1+ (1,0) [0|255] "ascii" ADAS_DOMAIN
 SG_ RouteInfoChar_37 : 456|8@1+ (1,0) [0|255] "ascii" ADAS_DOMAIN
 SG_ RouteInfoChar_38 : 464|8@1+ (1,0) [0|255] "ascii" ADAS_DOMAIN
 SG_ RouteInfoChar_39 : 472|8@1+ (1,0) [0|255] "ascii" ADAS_DOMAIN
 SG_ RouteInfoChar_40 : 480|8@1+ (1,0) [0|255] "ascii" ADAS_DOMAIN
 SG_ RouteInfoChar_41 : 488|8@1+ (1,0) [0|255] "ascii" ADAS_DOMAIN
 SG_ RouteInfoChar_42 : 496|8@1+ (1,0) [0|255] "ascii" ADAS_DOMAIN
 SG_ RouteInfoChar_43 : 504|8@1+ (1,0) [0|255] "ascii" ADAS_DOMAIN
CM_ BO_ 262 "Cycle=10ms; Channel=CAN6; CAN-FD; NominalBitrate=500kbit/s; DataBitrate=500kbit/s;  Data request; receiver answers with response frame; PayloadRouteInfo='IMU_YAW_RATE_SENSOR -> ADAS_DOMAIN' in bytes 20-63;";

BO_ 1542 RESP_006_ADAS_DOMAIN_TO_IMU_YAW_RATE_SENSOR: 16 ADAS_DOMAIN
 SG_ CRC8 : 0|8@1+ (1,0) [0|255] "" IMU_YAW_RATE_SENSOR
 SG_ ResponseCounter : 8|4@1+ (1,0) [0|15] "" IMU_YAW_RATE_SENSOR
 SG_ AckState : 12|4@1+ (1,0) [0|15] "" IMU_YAW_RATE_SENSOR
 SG_ ReceivedFrameId : 16|11@1+ (1,0) [0|2047] "" IMU_YAW_RATE_SENSOR
 SG_ ReceivedCounter : 27|4@1+ (1,0) [0|15] "" IMU_YAW_RATE_SENSOR
 SG_ ChecksumOk : 31|1@1+ (1,0) [0|1] "" IMU_YAW_RATE_SENSOR
 SG_ PayloadLength : 32|8@1+ (1,0) [0|64] "byte" IMU_YAW_RATE_SENSOR
 SG_ ErrorCode : 40|8@1+ (1,0) [0|255] "" IMU_YAW_RATE_SENSOR
 SG_ ProcessingTimeUs : 48|16@1+ (1,0) [0|65535] "us" IMU_YAW_RATE_SENSOR
 SG_ ResponseSequence : 64|16@1+ (1,0) [0|65535] "" IMU_YAW_RATE_SENSOR
 SG_ ReceivedCrc : 80|8@1+ (1,0) [0|255] "" IMU_YAW_RATE_SENSOR
 SG_ CalculatedCrc : 88|8@1+ (1,0) [0|255] "" IMU_YAW_RATE_SENSOR
CM_ BO_ 1542 "Cycle=10ms; Channel=CAN6; CAN-FD; NominalBitrate=500kbit/s; DataBitrate=500kbit/s;  ResponseFor=0x106; ACK/NACK with CRC, DLC and counter check;";

BO_ 263 DATA_007_WHEEL_SPEED_FRONT_LEFT_TO_BRAKE_CONTROLLER: 64 WHEEL_SPEED_FRONT_LEFT
 SG_ CRC8 : 0|8@1+ (1,0) [0|255] "" BRAKE_CONTROLLER
 SG_ AliveCounter : 8|4@1+ (1,0) [0|15] "" BRAKE_CONTROLLER
 SG_ MuxState : 12|4@1+ (1,0) [0|15] "" BRAKE_CONTROLLER
 SG_ SIG_107_00 : 16|12@1+ (0.1,0.0) [0|4095] "Nm" BRAKE_CONTROLLER
 SG_ SIG_107_01 : 28|12@1+ (0.1,0.0) [0|4095] "km/h" BRAKE_CONTROLLER
 SG_ SIG_107_02 : 40|12@1+ (0.1,0.0) [0|4095] "A" BRAKE_CONTROLLER
 SG_ SIG_107_03 : 52|12@1+ (0.1,0.0) [0|4095] "%" BRAKE_CONTROLLER
 SG_ SIG_107_04 : 64|12@1+ (0.1,0.0) [0|4095] "V" BRAKE_CONTROLLER
 SG_ SIG_107_05 : 76|12@1+ (0.1,0.0) [0|4095] "rpm" BRAKE_CONTROLLER
 SG_ SIG_107_06 : 88|12@1+ (0.1,0.0) [0|4095] "Nm" BRAKE_CONTROLLER
 SG_ SIG_107_07 : 100|12@1+ (0.1,0.0) [0|4095] "obj" BRAKE_CONTROLLER
 SG_ SIG_107_08 : 112|12@1+ (0.1,0.0) [0|4095] "A" BRAKE_CONTROLLER
 SG_ SIG_107_09 : 124|12@1+ (0.1,0.0) [0|4095] "Nm" BRAKE_CONTROLLER
 SG_ SIG_107_10 : 136|12@1+ (0.1,0.0) [0|4095] "C" BRAKE_CONTROLLER
 SG_ SIG_107_11 : 148|12@1+ (0.1,0.0) [0|4095] "%" BRAKE_CONTROLLER
 SG_ RouteInfoChar_00 : 160|8@1+ (1,0) [0|255] "ascii" BRAKE_CONTROLLER
 SG_ RouteInfoChar_01 : 168|8@1+ (1,0) [0|255] "ascii" BRAKE_CONTROLLER
 SG_ RouteInfoChar_02 : 176|8@1+ (1,0) [0|255] "ascii" BRAKE_CONTROLLER
 SG_ RouteInfoChar_03 : 184|8@1+ (1,0) [0|255] "ascii" BRAKE_CONTROLLER
 SG_ RouteInfoChar_04 : 192|8@1+ (1,0) [0|255] "ascii" BRAKE_CONTROLLER
 SG_ RouteInfoChar_05 : 200|8@1+ (1,0) [0|255] "ascii" BRAKE_CONTROLLER
 SG_ RouteInfoChar_06 : 208|8@1+ (1,0) [0|255] "ascii" BRAKE_CONTROLLER
 SG_ RouteInfoChar_07 : 216|8@1+ (1,0) [0|255] "ascii" BRAKE_CONTROLLER
 SG_ RouteInfoChar_08 : 224|8@1+ (1,0) [0|255] "ascii" BRAKE_CONTROLLER
 SG_ RouteInfoChar_09 : 232|8@1+ (1,0) [0|255] "ascii" BRAKE_CONTROLLER
 SG_ RouteInfoChar_10 : 240|8@1+ (1,0) [0|255] "ascii" BRAKE_CONTROLLER
 SG_ RouteInfoChar_11 : 248|8@1+ (1,0) [0|255] "ascii" BRAKE_CONTROLLER
 SG_ RouteInfoChar_12 : 256|8@1+ (1,0) [0|255] "ascii" BRAKE_CONTROLLER
 SG_ RouteInfoChar_13 : 264|8@1+ (1,0) [0|255] "ascii" BRAKE_CONTROLLER
 SG_ RouteInfoChar_14 : 272|8@1+ (1,0) [0|255] "ascii" BRAKE_CONTROLLER
 SG_ RouteInfoChar_15 : 280|8@1+ (1,0) [0|255] "ascii" BRAKE_CONTROLLER
 SG_ RouteInfoChar_16 : 288|8@1+ (1,0) [0|255] "ascii" BRAKE_CONTROLLER
 SG_ RouteInfoChar_17 : 296|8@1+ (1,0) [0|255] "ascii" BRAKE_CONTROLLER
 SG_ RouteInfoChar_18 : 304|8@1+ (1,0) [0|255] "ascii" BRAKE_CONTROLLER
 SG_ RouteInfoChar_19 : 312|8@1+ (1,0) [0|255] "ascii" BRAKE_CONTROLLER
 SG_ RouteInfoChar_20 : 320|8@1+ (1,0) [0|255] "ascii" BRAKE_CONTROLLER
 SG_ RouteInfoChar_21 : 328|8@1+ (1,0) [0|255] "ascii" BRAKE_CONTROLLER
 SG_ RouteInfoChar_22 : 336|8@1+ (1,0) [0|255] "ascii" BRAKE_CONTROLLER
 SG_ RouteInfoChar_23 : 344|8@1+ (1,0) [0|255] "ascii" BRAKE_CONTROLLER
 SG_ RouteInfoChar_24 : 352|8@1+ (1,0) [0|255] "ascii" BRAKE_CONTROLLER
 SG_ RouteInfoChar_25 : 360|8@1+ (1,0) [0|255] "ascii" BRAKE_CONTROLLER
 SG_ RouteInfoChar_26 : 368|8@1+ (1,0) [0|255] "ascii" BRAKE_CONTROLLER
 SG_ RouteInfoChar_27 : 376|8@1+ (1,0) [0|255] "ascii" BRAKE_CONTROLLER
 SG_ RouteInfoChar_28 : 384|8@1+ (1,0) [0|255] "ascii" BRAKE_CONTROLLER
 SG_ RouteInfoChar_29 : 392|8@1+ (1,0) [0|255] "ascii" BRAKE_CONTROLLER
 SG_ RouteInfoChar_30 : 400|8@1+ (1,0) [0|255] "ascii" BRAKE_CONTROLLER
 SG_ RouteInfoChar_31 : 408|8@1+ (1,0) [0|255] "ascii" BRAKE_CONTROLLER
 SG_ RouteInfoChar_32 : 416|8@1+ (1,0) [0|255] "ascii" BRAKE_CONTROLLER
 SG_ RouteInfoChar_33 : 424|8@1+ (1,0) [0|255] "ascii" BRAKE_CONTROLLER
 SG_ RouteInfoChar_34 : 432|8@1+ (1,0) [0|255] "ascii" BRAKE_CONTROLLER
 SG_ RouteInfoChar_35 : 440|8@1+ (1,0) [0|255] "ascii" BRAKE_CONTROLLER
 SG_ RouteInfoChar_36 : 448|8@1+ (1,0) [0|255] "ascii" BRAKE_CONTROLLER
 SG_ RouteInfoChar_37 : 456|8@1+ (1,0) [0|255] "ascii" BRAKE_CONTROLLER
 SG_ RouteInfoChar_38 : 464|8@1+ (1,0) [0|255] "ascii" BRAKE_CONTROLLER
 SG_ RouteInfoChar_39 : 472|8@1+ (1,0) [0|255] "ascii" BRAKE_CONTROLLER
 SG_ RouteInfoChar_40 : 480|8@1+ (1,0) [0|255] "ascii" BRAKE_CONTROLLER
 SG_ RouteInfoChar_41 : 488|8@1+ (1,0) [0|255] "ascii" BRAKE_CONTROLLER
 SG_ RouteInfoChar_42 : 496|8@1+ (1,0) [0|255] "ascii" BRAKE_CONTROLLER
 SG_ RouteInfoChar_43 : 504|8@1+ (1,0) [0|255] "ascii" BRAKE_CONTROLLER
CM_ BO_ 263 "Cycle=10ms; Channel=CAN7; CAN-FD; NominalBitrate=500kbit/s; DataBitrate=500kbit/s;  Data request; receiver answers with response frame; PayloadRouteInfo='WHEEL_SPEED_FRONT_LEFT -> BRAKE_CONTROLLER' in bytes 20-63;";

BO_ 1543 RESP_007_BRAKE_CONTROLLER_TO_WHEEL_SPEED_FRONT_LEFT: 16 BRAKE_CONTROLLER
 SG_ CRC8 : 0|8@1+ (1,0) [0|255] "" WHEEL_SPEED_FRONT_LEFT
 SG_ ResponseCounter : 8|4@1+ (1,0) [0|15] "" WHEEL_SPEED_FRONT_LEFT
 SG_ AckState : 12|4@1+ (1,0) [0|15] "" WHEEL_SPEED_FRONT_LEFT
 SG_ ReceivedFrameId : 16|11@1+ (1,0) [0|2047] "" WHEEL_SPEED_FRONT_LEFT
 SG_ ReceivedCounter : 27|4@1+ (1,0) [0|15] "" WHEEL_SPEED_FRONT_LEFT
 SG_ ChecksumOk : 31|1@1+ (1,0) [0|1] "" WHEEL_SPEED_FRONT_LEFT
 SG_ PayloadLength : 32|8@1+ (1,0) [0|64] "byte" WHEEL_SPEED_FRONT_LEFT
 SG_ ErrorCode : 40|8@1+ (1,0) [0|255] "" WHEEL_SPEED_FRONT_LEFT
 SG_ ProcessingTimeUs : 48|16@1+ (1,0) [0|65535] "us" WHEEL_SPEED_FRONT_LEFT
 SG_ ResponseSequence : 64|16@1+ (1,0) [0|65535] "" WHEEL_SPEED_FRONT_LEFT
 SG_ ReceivedCrc : 80|8@1+ (1,0) [0|255] "" WHEEL_SPEED_FRONT_LEFT
 SG_ CalculatedCrc : 88|8@1+ (1,0) [0|255] "" WHEEL_SPEED_FRONT_LEFT
CM_ BO_ 1543 "Cycle=10ms; Channel=CAN7; CAN-FD; NominalBitrate=500kbit/s; DataBitrate=500kbit/s;  ResponseFor=0x107; ACK/NACK with CRC, DLC and counter check;";

BO_ 264 DATA_008_BRAKE_CONTROLLER_TO_ADAS_DOMAIN: 64 BRAKE_CONTROLLER
 SG_ CRC8 : 0|8@1+ (1,0) [0|255] "" ADAS_DOMAIN
 SG_ AliveCounter : 8|4@1+ (1,0) [0|15] "" ADAS_DOMAIN
 SG_ MuxState : 12|4@1+ (1,0) [0|15] "" ADAS_DOMAIN
 SG_ SIG_108_00 : 16|12@1+ (0.1,0.0) [0|4095] "C" ADAS_DOMAIN
 SG_ SIG_108_01 : 28|12@1+ (0.1,0.0) [0|4095] "deg" ADAS_DOMAIN
 SG_ SIG_108_02 : 40|12@1+ (0.1,0.0) [0|4095] "V" ADAS_DOMAIN
 SG_ SIG_108_03 : 52|12@1+ (0.1,0.0) [0|4095] "deg" ADAS_DOMAIN
 SG_ SIG_108_04 : 64|12@1+ (0.1,0.0) [0|4095] "Nm" ADAS_DOMAIN
 SG_ SIG_108_05 : 76|12@1+ (0.1,0.0) [0|4095] "m" ADAS_DOMAIN
 SG_ SIG_108_06 : 88|12@1+ (0.1,0.0) [0|4095] "m" ADAS_DOMAIN
 SG_ SIG_108_07 : 100|12@1+ (0.1,0.0) [0|4095] "V" ADAS_DOMAIN
 SG_ SIG_108_08 : 112|12@1+ (0.1,0.0) [0|4095] "obj" ADAS_DOMAIN
 SG_ SIG_108_09 : 124|12@1+ (0.1,0.0) [0|4095] "%" ADAS_DOMAIN
 SG_ SIG_108_10 : 136|12@1+ (0.1,0.0) [0|4095] "obj" ADAS_DOMAIN
 SG_ SIG_108_11 : 148|12@1+ (0.1,0.0) [0|4095] "%" ADAS_DOMAIN
 SG_ RouteInfoChar_00 : 160|8@1+ (1,0) [0|255] "ascii" ADAS_DOMAIN
 SG_ RouteInfoChar_01 : 168|8@1+ (1,0) [0|255] "ascii" ADAS_DOMAIN
 SG_ RouteInfoChar_02 : 176|8@1+ (1,0) [0|255] "ascii" ADAS_DOMAIN
 SG_ RouteInfoChar_03 : 184|8@1+ (1,0) [0|255] "ascii" ADAS_DOMAIN
 SG_ RouteInfoChar_04 : 192|8@1+ (1,0) [0|255] "ascii" ADAS_DOMAIN
 SG_ RouteInfoChar_05 : 200|8@1+ (1,0) [0|255] "ascii" ADAS_DOMAIN
 SG_ RouteInfoChar_06 : 208|8@1+ (1,0) [0|255] "ascii" ADAS_DOMAIN
 SG_ RouteInfoChar_07 : 216|8@1+ (1,0) [0|255] "ascii" ADAS_DOMAIN
 SG_ RouteInfoChar_08 : 224|8@1+ (1,0) [0|255] "ascii" ADAS_DOMAIN
 SG_ RouteInfoChar_09 : 232|8@1+ (1,0) [0|255] "ascii" ADAS_DOMAIN
 SG_ RouteInfoChar_10 : 240|8@1+ (1,0) [0|255] "ascii" ADAS_DOMAIN
 SG_ RouteInfoChar_11 : 248|8@1+ (1,0) [0|255] "ascii" ADAS_DOMAIN
 SG_ RouteInfoChar_12 : 256|8@1+ (1,0) [0|255] "ascii" ADAS_DOMAIN
 SG_ RouteInfoChar_13 : 264|8@1+ (1,0) [0|255] "ascii" ADAS_DOMAIN
 SG_ RouteInfoChar_14 : 272|8@1+ (1,0) [0|255] "ascii" ADAS_DOMAIN
 SG_ RouteInfoChar_15 : 280|8@1+ (1,0) [0|255] "ascii" ADAS_DOMAIN
 SG_ RouteInfoChar_16 : 288|8@1+ (1,0) [0|255] "ascii" ADAS_DOMAIN
 SG_ RouteInfoChar_17 : 296|8@1+ (1,0) [0|255] "ascii" ADAS_DOMAIN
 SG_ RouteInfoChar_18 : 304|8@1+ (1,0) [0|255] "ascii" ADAS_DOMAIN
 SG_ RouteInfoChar_19 : 312|8@1+ (1,0) [0|255] "ascii" ADAS_DOMAIN
 SG_ RouteInfoChar_20 : 320|8@1+ (1,0) [0|255] "ascii" ADAS_DOMAIN
 SG_ RouteInfoChar_21 : 328|8@1+ (1,0) [0|255] "ascii" ADAS_DOMAIN
 SG_ RouteInfoChar_22 : 336|8@1+ (1,0) [0|255] "ascii" ADAS_DOMAIN
 SG_ RouteInfoChar_23 : 344|8@1+ (1,0) [0|255] "ascii" ADAS_DOMAIN
 SG_ RouteInfoChar_24 : 352|8@1+ (1,0) [0|255] "ascii" ADAS_DOMAIN
 SG_ RouteInfoChar_25 : 360|8@1+ (1,0) [0|255] "ascii" ADAS_DOMAIN
 SG_ RouteInfoChar_26 : 368|8@1+ (1,0) [0|255] "ascii" ADAS_DOMAIN
 SG_ RouteInfoChar_27 : 376|8@1+ (1,0) [0|255] "ascii" ADAS_DOMAIN
 SG_ RouteInfoChar_28 : 384|8@1+ (1,0) [0|255] "ascii" ADAS_DOMAIN
 SG_ RouteInfoChar_29 : 392|8@1+ (1,0) [0|255] "ascii" ADAS_DOMAIN
 SG_ RouteInfoChar_30 : 400|8@1+ (1,0) [0|255] "ascii" ADAS_DOMAIN
 SG_ RouteInfoChar_31 : 408|8@1+ (1,0) [0|255] "ascii" ADAS_DOMAIN
 SG_ RouteInfoChar_32 : 416|8@1+ (1,0) [0|255] "ascii" ADAS_DOMAIN
 SG_ RouteInfoChar_33 : 424|8@1+ (1,0) [0|255] "ascii" ADAS_DOMAIN
 SG_ RouteInfoChar_34 : 432|8@1+ (1,0) [0|255] "ascii" ADAS_DOMAIN
 SG_ RouteInfoChar_35 : 440|8@1+ (1,0) [0|255] "ascii" ADAS_DOMAIN
 SG_ RouteInfoChar_36 : 448|8@1+ (1,0) [0|255] "ascii" ADAS_DOMAIN
 SG_ RouteInfoChar_37 : 456|8@1+ (1,0) [0|255] "ascii" ADAS_DOMAIN
 SG_ RouteInfoChar_38 : 464|8@1+ (1,0) [0|255] "ascii" ADAS_DOMAIN
 SG_ RouteInfoChar_39 : 472|8@1+ (1,0) [0|255] "ascii" ADAS_DOMAIN
 SG_ RouteInfoChar_40 : 480|8@1+ (1,0) [0|255] "ascii" ADAS_DOMAIN
 SG_ RouteInfoChar_41 : 488|8@1+ (1,0) [0|255] "ascii" ADAS_DOMAIN
 SG_ RouteInfoChar_42 : 496|8@1+ (1,0) [0|255] "ascii" ADAS_DOMAIN
 SG_ RouteInfoChar_43 : 504|8@1+ (1,0) [0|255] "ascii" ADAS_DOMAIN
CM_ BO_ 264 "Cycle=20ms; Channel=CAN8; CAN-FD; NominalBitrate=500kbit/s; DataBitrate=500kbit/s;  Data request; receiver answers with response frame; PayloadRouteInfo='BRAKE_CONTROLLER -> ADAS_DOMAIN' in bytes 20-63;";

BO_ 1544 RESP_008_ADAS_DOMAIN_TO_BRAKE_CONTROLLER: 16 ADAS_DOMAIN
 SG_ CRC8 : 0|8@1+ (1,0) [0|255] "" BRAKE_CONTROLLER
 SG_ ResponseCounter : 8|4@1+ (1,0) [0|15] "" BRAKE_CONTROLLER
 SG_ AckState : 12|4@1+ (1,0) [0|15] "" BRAKE_CONTROLLER
 SG_ ReceivedFrameId : 16|11@1+ (1,0) [0|2047] "" BRAKE_CONTROLLER
 SG_ ReceivedCounter : 27|4@1+ (1,0) [0|15] "" BRAKE_CONTROLLER
 SG_ ChecksumOk : 31|1@1+ (1,0) [0|1] "" BRAKE_CONTROLLER
 SG_ PayloadLength : 32|8@1+ (1,0) [0|64] "byte" BRAKE_CONTROLLER
 SG_ ErrorCode : 40|8@1+ (1,0) [0|255] "" BRAKE_CONTROLLER
 SG_ ProcessingTimeUs : 48|16@1+ (1,0) [0|65535] "us" BRAKE_CONTROLLER
 SG_ ResponseSequence : 64|16@1+ (1,0) [0|65535] "" BRAKE_CONTROLLER
 SG_ ReceivedCrc : 80|8@1+ (1,0) [0|255] "" BRAKE_CONTROLLER
 SG_ CalculatedCrc : 88|8@1+ (1,0) [0|255] "" BRAKE_CONTROLLER
CM_ BO_ 1544 "Cycle=20ms; Channel=CAN8; CAN-FD; NominalBitrate=500kbit/s; DataBitrate=500kbit/s;  ResponseFor=0x108; ACK/NACK with CRC, DLC and counter check;";

BO_ 265 DATA_009_ADAS_DOMAIN_TO_VEHICLE_MOTION_CONTROLLER: 64 ADAS_DOMAIN
 SG_ CRC8 : 0|8@1+ (1,0) [0|255] "" VEHICLE_MOTION_CONTROLLER
 SG_ AliveCounter : 8|4@1+ (1,0) [0|15] "" VEHICLE_MOTION_CONTROLLER
 SG_ MuxState : 12|4@1+ (1,0) [0|15] "" VEHICLE_MOTION_CONTROLLER
 SG_ SIG_109_00 : 16|12@1+ (0.1,0.0) [0|4095] "A" VEHICLE_MOTION_CONTROLLER
 SG_ SIG_109_01 : 28|12@1+ (0.1,0.0) [0|4095] "Nm" VEHICLE_MOTION_CONTROLLER
 SG_ SIG_109_02 : 40|12@1+ (0.1,0.0) [0|4095] "deg" VEHICLE_MOTION_CONTROLLER
 SG_ SIG_109_03 : 52|12@1+ (0.1,0.0) [0|4095] "m" VEHICLE_MOTION_CONTROLLER
 SG_ SIG_109_04 : 64|12@1+ (0.1,0.0) [0|4095] "C" VEHICLE_MOTION_CONTROLLER
 SG_ SIG_109_05 : 76|12@1+ (0.1,0.0) [0|4095] "rpm" VEHICLE_MOTION_CONTROLLER
 SG_ SIG_109_06 : 88|12@1+ (0.1,0.0) [0|4095] "km/h" VEHICLE_MOTION_CONTROLLER
 SG_ SIG_109_07 : 100|12@1+ (0.1,0.0) [0|4095] "rpm" VEHICLE_MOTION_CONTROLLER
 SG_ SIG_109_08 : 112|12@1+ (0.1,0.0) [0|4095] "deg" VEHICLE_MOTION_CONTROLLER
 SG_ SIG_109_09 : 124|12@1+ (0.1,0.0) [0|4095] "deg" VEHICLE_MOTION_CONTROLLER
 SG_ SIG_109_10 : 136|12@1+ (0.1,0.0) [0|4095] "%" VEHICLE_MOTION_CONTROLLER
 SG_ SIG_109_11 : 148|12@1+ (0.1,0.0) [0|4095] "obj" VEHICLE_MOTION_CONTROLLER
 SG_ RouteInfoChar_00 : 160|8@1+ (1,0) [0|255] "ascii" VEHICLE_MOTION_CONTROLLER
 SG_ RouteInfoChar_01 : 168|8@1+ (1,0) [0|255] "ascii" VEHICLE_MOTION_CONTROLLER
 SG_ RouteInfoChar_02 : 176|8@1+ (1,0) [0|255] "ascii" VEHICLE_MOTION_CONTROLLER
 SG_ RouteInfoChar_03 : 184|8@1+ (1,0) [0|255] "ascii" VEHICLE_MOTION_CONTROLLER
 SG_ RouteInfoChar_04 : 192|8@1+ (1,0) [0|255] "ascii" VEHICLE_MOTION_CONTROLLER
 SG_ RouteInfoChar_05 : 200|8@1+ (1,0) [0|255] "ascii" VEHICLE_MOTION_CONTROLLER
 SG_ RouteInfoChar_06 : 208|8@1+ (1,0) [0|255] "ascii" VEHICLE_MOTION_CONTROLLER
 SG_ RouteInfoChar_07 : 216|8@1+ (1,0) [0|255] "ascii" VEHICLE_MOTION_CONTROLLER
 SG_ RouteInfoChar_08 : 224|8@1+ (1,0) [0|255] "ascii" VEHICLE_MOTION_CONTROLLER
 SG_ RouteInfoChar_09 : 232|8@1+ (1,0) [0|255] "ascii" VEHICLE_MOTION_CONTROLLER
 SG_ RouteInfoChar_10 : 240|8@1+ (1,0) [0|255] "ascii" VEHICLE_MOTION_CONTROLLER
 SG_ RouteInfoChar_11 : 248|8@1+ (1,0) [0|255] "ascii" VEHICLE_MOTION_CONTROLLER
 SG_ RouteInfoChar_12 : 256|8@1+ (1,0) [0|255] "ascii" VEHICLE_MOTION_CONTROLLER
 SG_ RouteInfoChar_13 : 264|8@1+ (1,0) [0|255] "ascii" VEHICLE_MOTION_CONTROLLER
 SG_ RouteInfoChar_14 : 272|8@1+ (1,0) [0|255] "ascii" VEHICLE_MOTION_CONTROLLER
 SG_ RouteInfoChar_15 : 280|8@1+ (1,0) [0|255] "ascii" VEHICLE_MOTION_CONTROLLER
 SG_ RouteInfoChar_16 : 288|8@1+ (1,0) [0|255] "ascii" VEHICLE_MOTION_CONTROLLER
 SG_ RouteInfoChar_17 : 296|8@1+ (1,0) [0|255] "ascii" VEHICLE_MOTION_CONTROLLER
 SG_ RouteInfoChar_18 : 304|8@1+ (1,0) [0|255] "ascii" VEHICLE_MOTION_CONTROLLER
 SG_ RouteInfoChar_19 : 312|8@1+ (1,0) [0|255] "ascii" VEHICLE_MOTION_CONTROLLER
 SG_ RouteInfoChar_20 : 320|8@1+ (1,0) [0|255] "ascii" VEHICLE_MOTION_CONTROLLER
 SG_ RouteInfoChar_21 : 328|8@1+ (1,0) [0|255] "ascii" VEHICLE_MOTION_CONTROLLER
 SG_ RouteInfoChar_22 : 336|8@1+ (1,0) [0|255] "ascii" VEHICLE_MOTION_CONTROLLER
 SG_ RouteInfoChar_23 : 344|8@1+ (1,0) [0|255] "ascii" VEHICLE_MOTION_CONTROLLER
 SG_ RouteInfoChar_24 : 352|8@1+ (1,0) [0|255] "ascii" VEHICLE_MOTION_CONTROLLER
 SG_ RouteInfoChar_25 : 360|8@1+ (1,0) [0|255] "ascii" VEHICLE_MOTION_CONTROLLER
 SG_ RouteInfoChar_26 : 368|8@1+ (1,0) [0|255] "ascii" VEHICLE_MOTION_CONTROLLER
 SG_ RouteInfoChar_27 : 376|8@1+ (1,0) [0|255] "ascii" VEHICLE_MOTION_CONTROLLER
 SG_ RouteInfoChar_28 : 384|8@1+ (1,0) [0|255] "ascii" VEHICLE_MOTION_CONTROLLER
 SG_ RouteInfoChar_29 : 392|8@1+ (1,0) [0|255] "ascii" VEHICLE_MOTION_CONTROLLER
 SG_ RouteInfoChar_30 : 400|8@1+ (1,0) [0|255] "ascii" VEHICLE_MOTION_CONTROLLER
 SG_ RouteInfoChar_31 : 408|8@1+ (1,0) [0|255] "ascii" VEHICLE_MOTION_CONTROLLER
 SG_ RouteInfoChar_32 : 416|8@1+ (1,0) [0|255] "ascii" VEHICLE_MOTION_CONTROLLER
 SG_ RouteInfoChar_33 : 424|8@1+ (1,0) [0|255] "ascii" VEHICLE_MOTION_CONTROLLER
 SG_ RouteInfoChar_34 : 432|8@1+ (1,0) [0|255] "ascii" VEHICLE_MOTION_CONTROLLER
 SG_ RouteInfoChar_35 : 440|8@1+ (1,0) [0|255] "ascii" VEHICLE_MOTION_CONTROLLER
 SG_ RouteInfoChar_36 : 448|8@1+ (1,0) [0|255] "ascii" VEHICLE_MOTION_CONTROLLER
 SG_ RouteInfoChar_37 : 456|8@1+ (1,0) [0|255] "ascii" VEHICLE_MOTION_CONTROLLER
 SG_ RouteInfoChar_38 : 464|8@1+ (1,0) [0|255] "ascii" VEHICLE_MOTION_CONTROLLER
 SG_ RouteInfoChar_39 : 472|8@1+ (1,0) [0|255] "ascii" VEHICLE_MOTION_CONTROLLER
 SG_ RouteInfoChar_40 : 480|8@1+ (1,0) [0|255] "ascii" VEHICLE_MOTION_CONTROLLER
 SG_ RouteInfoChar_41 : 488|8@1+ (1,0) [0|255] "ascii" VEHICLE_MOTION_CONTROLLER
 SG_ RouteInfoChar_42 : 496|8@1+ (1,0) [0|255] "ascii" VEHICLE_MOTION_CONTROLLER
 SG_ RouteInfoChar_43 : 504|8@1+ (1,0) [0|255] "ascii" VEHICLE_MOTION_CONTROLLER
CM_ BO_ 265 "Cycle=20ms; Channel=CAN9; CAN-FD; NominalBitrate=500kbit/s; DataBitrate=500kbit/s;  Data request; receiver answers with response frame; PayloadRouteInfo='ADAS_DOMAIN -> VEHICLE_MOTION_CONTROLLER' in bytes 20-63;";

BO_ 1545 RESP_009_VEHICLE_MOTION_CONTROLLER_TO_ADAS_DOMAIN: 16 VEHICLE_MOTION_CONTROLLER
 SG_ CRC8 : 0|8@1+ (1,0) [0|255] "" ADAS_DOMAIN
 SG_ ResponseCounter : 8|4@1+ (1,0) [0|15] "" ADAS_DOMAIN
 SG_ AckState : 12|4@1+ (1,0) [0|15] "" ADAS_DOMAIN
 SG_ ReceivedFrameId : 16|11@1+ (1,0) [0|2047] "" ADAS_DOMAIN
 SG_ ReceivedCounter : 27|4@1+ (1,0) [0|15] "" ADAS_DOMAIN
 SG_ ChecksumOk : 31|1@1+ (1,0) [0|1] "" ADAS_DOMAIN
 SG_ PayloadLength : 32|8@1+ (1,0) [0|64] "byte" ADAS_DOMAIN
 SG_ ErrorCode : 40|8@1+ (1,0) [0|255] "" ADAS_DOMAIN
 SG_ ProcessingTimeUs : 48|16@1+ (1,0) [0|65535] "us" ADAS_DOMAIN
 SG_ ResponseSequence : 64|16@1+ (1,0) [0|65535] "" ADAS_DOMAIN
 SG_ ReceivedCrc : 80|8@1+ (1,0) [0|255] "" ADAS_DOMAIN
 SG_ CalculatedCrc : 88|8@1+ (1,0) [0|255] "" ADAS_DOMAIN
CM_ BO_ 1545 "Cycle=20ms; Channel=CAN9; CAN-FD; NominalBitrate=500kbit/s; DataBitrate=500kbit/s;  ResponseFor=0x109; ACK/NACK with CRC, DLC and counter check;";

BO_ 266 DATA_010_LIDAR_FRONT_TO_ADAS_DOMAIN: 64 LIDAR_FRONT
 SG_ CRC8 : 0|8@1+ (1,0) [0|255] "" ADAS_DOMAIN
 SG_ AliveCounter : 8|4@1+ (1,0) [0|15] "" ADAS_DOMAIN
 SG_ MuxState : 12|4@1+ (1,0) [0|15] "" ADAS_DOMAIN
 SG_ SIG_10A_00 : 16|12@1+ (0.1,0.0) [0|4095] "rpm" ADAS_DOMAIN
 SG_ SIG_10A_01 : 28|12@1+ (0.1,0.0) [0|4095] "%" ADAS_DOMAIN
 SG_ SIG_10A_02 : 40|12@1+ (0.1,0.0) [0|4095] "%" ADAS_DOMAIN
 SG_ SIG_10A_03 : 52|12@1+ (0.1,0.0) [0|4095] "obj" ADAS_DOMAIN
 SG_ SIG_10A_04 : 64|12@1+ (0.1,0.0) [0|4095] "C" ADAS_DOMAIN
 SG_ SIG_10A_05 : 76|12@1+ (0.1,0.0) [0|4095] "m" ADAS_DOMAIN
 SG_ SIG_10A_06 : 88|12@1+ (0.1,0.0) [0|4095] "V" ADAS_DOMAIN
 SG_ SIG_10A_07 : 100|12@1+ (0.1,0.0) [0|4095] "m" ADAS_DOMAIN
 SG_ SIG_10A_08 : 112|12@1+ (0.1,0.0) [0|4095] "km/h" ADAS_DOMAIN
 SG_ SIG_10A_09 : 124|12@1+ (0.1,0.0) [0|4095] "rpm" ADAS_DOMAIN
 SG_ SIG_10A_10 : 136|12@1+ (0.1,0.0) [0|4095] "m" ADAS_DOMAIN
 SG_ SIG_10A_11 : 148|12@1+ (0.1,0.0) [0|4095] "V" ADAS_DOMAIN
 SG_ RouteInfoChar_00 : 160|8@1+ (1,0) [0|255] "ascii" ADAS_DOMAIN
 SG_ RouteInfoChar_01 : 168|8@1+ (1,0) [0|255] "ascii" ADAS_DOMAIN
 SG_ RouteInfoChar_02 : 176|8@1+ (1,0) [0|255] "ascii" ADAS_DOMAIN
 SG_ RouteInfoChar_03 : 184|8@1+ (1,0) [0|255] "ascii" ADAS_DOMAIN
 SG_ RouteInfoChar_04 : 192|8@1+ (1,0) [0|255] "ascii" ADAS_DOMAIN
 SG_ RouteInfoChar_05 : 200|8@1+ (1,0) [0|255] "ascii" ADAS_DOMAIN
 SG_ RouteInfoChar_06 : 208|8@1+ (1,0) [0|255] "ascii" ADAS_DOMAIN
 SG_ RouteInfoChar_07 : 216|8@1+ (1,0) [0|255] "ascii" ADAS_DOMAIN
 SG_ RouteInfoChar_08 : 224|8@1+ (1,0) [0|255] "ascii" ADAS_DOMAIN
 SG_ RouteInfoChar_09 : 232|8@1+ (1,0) [0|255] "ascii" ADAS_DOMAIN
 SG_ RouteInfoChar_10 : 240|8@1+ (1,0) [0|255] "ascii" ADAS_DOMAIN
 SG_ RouteInfoChar_11 : 248|8@1+ (1,0) [0|255] "ascii" ADAS_DOMAIN
 SG_ RouteInfoChar_12 : 256|8@1+ (1,0) [0|255] "ascii" ADAS_DOMAIN
 SG_ RouteInfoChar_13 : 264|8@1+ (1,0) [0|255] "ascii" ADAS_DOMAIN
 SG_ RouteInfoChar_14 : 272|8@1+ (1,0) [0|255] "ascii" ADAS_DOMAIN
 SG_ RouteInfoChar_15 : 280|8@1+ (1,0) [0|255] "ascii" ADAS_DOMAIN
 SG_ RouteInfoChar_16 : 288|8@1+ (1,0) [0|255] "ascii" ADAS_DOMAIN
 SG_ RouteInfoChar_17 : 296|8@1+ (1,0) [0|255] "ascii" ADAS_DOMAIN
 SG_ RouteInfoChar_18 : 304|8@1+ (1,0) [0|255] "ascii" ADAS_DOMAIN
 SG_ RouteInfoChar_19 : 312|8@1+ (1,0) [0|255] "ascii" ADAS_DOMAIN
 SG_ RouteInfoChar_20 : 320|8@1+ (1,0) [0|255] "ascii" ADAS_DOMAIN
 SG_ RouteInfoChar_21 : 328|8@1+ (1,0) [0|255] "ascii" ADAS_DOMAIN
 SG_ RouteInfoChar_22 : 336|8@1+ (1,0) [0|255] "ascii" ADAS_DOMAIN
 SG_ RouteInfoChar_23 : 344|8@1+ (1,0) [0|255] "ascii" ADAS_DOMAIN
 SG_ RouteInfoChar_24 : 352|8@1+ (1,0) [0|255] "ascii" ADAS_DOMAIN
 SG_ RouteInfoChar_25 : 360|8@1+ (1,0) [0|255] "ascii" ADAS_DOMAIN
 SG_ RouteInfoChar_26 : 368|8@1+ (1,0) [0|255] "ascii" ADAS_DOMAIN
 SG_ RouteInfoChar_27 : 376|8@1+ (1,0) [0|255] "ascii" ADAS_DOMAIN
 SG_ RouteInfoChar_28 : 384|8@1+ (1,0) [0|255] "ascii" ADAS_DOMAIN
 SG_ RouteInfoChar_29 : 392|8@1+ (1,0) [0|255] "ascii" ADAS_DOMAIN
 SG_ RouteInfoChar_30 : 400|8@1+ (1,0) [0|255] "ascii" ADAS_DOMAIN
 SG_ RouteInfoChar_31 : 408|8@1+ (1,0) [0|255] "ascii" ADAS_DOMAIN
 SG_ RouteInfoChar_32 : 416|8@1+ (1,0) [0|255] "ascii" ADAS_DOMAIN
 SG_ RouteInfoChar_33 : 424|8@1+ (1,0) [0|255] "ascii" ADAS_DOMAIN
 SG_ RouteInfoChar_34 : 432|8@1+ (1,0) [0|255] "ascii" ADAS_DOMAIN
 SG_ RouteInfoChar_35 : 440|8@1+ (1,0) [0|255] "ascii" ADAS_DOMAIN
 SG_ RouteInfoChar_36 : 448|8@1+ (1,0) [0|255] "ascii" ADAS_DOMAIN
 SG_ RouteInfoChar_37 : 456|8@1+ (1,0) [0|255] "ascii" ADAS_DOMAIN
 SG_ RouteInfoChar_38 : 464|8@1+ (1,0) [0|255] "ascii" ADAS_DOMAIN
 SG_ RouteInfoChar_39 : 472|8@1+ (1,0) [0|255] "ascii" ADAS_DOMAIN
 SG_ RouteInfoChar_40 : 480|8@1+ (1,0) [0|255] "ascii" ADAS_DOMAIN
 SG_ RouteInfoChar_41 : 488|8@1+ (1,0) [0|255] "ascii" ADAS_DOMAIN
 SG_ RouteInfoChar_42 : 496|8@1+ (1,0) [0|255] "ascii" ADAS_DOMAIN
 SG_ RouteInfoChar_43 : 504|8@1+ (1,0) [0|255] "ascii" ADAS_DOMAIN
CM_ BO_ 266 "Cycle=20ms; Channel=CAN10; CAN-FD; NominalBitrate=500kbit/s; DataBitrate=500kbit/s;  Data request; receiver answers with response frame; PayloadRouteInfo='LIDAR_FRONT -> ADAS_DOMAIN' in bytes 20-63; Gateway to CAN11";

BO_ 1546 RESP_010_ADAS_DOMAIN_TO_LIDAR_FRONT: 16 ADAS_DOMAIN
 SG_ CRC8 : 0|8@1+ (1,0) [0|255] "" LIDAR_FRONT
 SG_ ResponseCounter : 8|4@1+ (1,0) [0|15] "" LIDAR_FRONT
 SG_ AckState : 12|4@1+ (1,0) [0|15] "" LIDAR_FRONT
 SG_ ReceivedFrameId : 16|11@1+ (1,0) [0|2047] "" LIDAR_FRONT
 SG_ ReceivedCounter : 27|4@1+ (1,0) [0|15] "" LIDAR_FRONT
 SG_ ChecksumOk : 31|1@1+ (1,0) [0|1] "" LIDAR_FRONT
 SG_ PayloadLength : 32|8@1+ (1,0) [0|64] "byte" LIDAR_FRONT
 SG_ ErrorCode : 40|8@1+ (1,0) [0|255] "" LIDAR_FRONT
 SG_ ProcessingTimeUs : 48|16@1+ (1,0) [0|65535] "us" LIDAR_FRONT
 SG_ ResponseSequence : 64|16@1+ (1,0) [0|65535] "" LIDAR_FRONT
 SG_ ReceivedCrc : 80|8@1+ (1,0) [0|255] "" LIDAR_FRONT
 SG_ CalculatedCrc : 88|8@1+ (1,0) [0|255] "" LIDAR_FRONT
CM_ BO_ 1546 "Cycle=20ms; Channel=CAN10; CAN-FD; NominalBitrate=500kbit/s; DataBitrate=500kbit/s;  ResponseFor=0x10A; ACK/NACK with CRC, DLC and counter check;";

BO_ 267 DATA_011_CAMERA_FRONT_WIDE_TO_ADAS_DOMAIN: 64 CAMERA_FRONT_WIDE
 SG_ CRC8 : 0|8@1+ (1,0) [0|255] "" ADAS_DOMAIN
 SG_ AliveCounter : 8|4@1+ (1,0) [0|15] "" ADAS_DOMAIN
 SG_ MuxState : 12|4@1+ (1,0) [0|15] "" ADAS_DOMAIN
 SG_ SIG_10B_00 : 16|12@1+ (0.1,0.0) [0|4095] "A" ADAS_DOMAIN
 SG_ SIG_10B_01 : 28|12@1+ (0.1,0.0) [0|4095] "rpm" ADAS_DOMAIN
 SG_ SIG_10B_02 : 40|12@1+ (0.1,0.0) [0|4095] "V" ADAS_DOMAIN
 SG_ SIG_10B_03 : 52|12@1+ (0.1,0.0) [0|4095] "%" ADAS_DOMAIN
 SG_ SIG_10B_04 : 64|12@1+ (0.1,0.0) [0|4095] "deg" ADAS_DOMAIN
 SG_ SIG_10B_05 : 76|12@1+ (0.1,0.0) [0|4095] "C" ADAS_DOMAIN
 SG_ SIG_10B_06 : 88|12@1+ (0.1,0.0) [0|4095] "km/h" ADAS_DOMAIN
 SG_ SIG_10B_07 : 100|12@1+ (0.1,0.0) [0|4095] "V" ADAS_DOMAIN
 SG_ SIG_10B_08 : 112|12@1+ (0.1,0.0) [0|4095] "m" ADAS_DOMAIN
 SG_ SIG_10B_09 : 124|12@1+ (0.1,0.0) [0|4095] "deg" ADAS_DOMAIN
 SG_ SIG_10B_10 : 136|12@1+ (0.1,0.0) [0|4095] "m" ADAS_DOMAIN
 SG_ SIG_10B_11 : 148|12@1+ (0.1,0.0) [0|4095] "rpm" ADAS_DOMAIN
 SG_ RouteInfoChar_00 : 160|8@1+ (1,0) [0|255] "ascii" ADAS_DOMAIN
 SG_ RouteInfoChar_01 : 168|8@1+ (1,0) [0|255] "ascii" ADAS_DOMAIN
 SG_ RouteInfoChar_02 : 176|8@1+ (1,0) [0|255] "ascii" ADAS_DOMAIN
 SG_ RouteInfoChar_03 : 184|8@1+ (1,0) [0|255] "ascii" ADAS_DOMAIN
 SG_ RouteInfoChar_04 : 192|8@1+ (1,0) [0|255] "ascii" ADAS_DOMAIN
 SG_ RouteInfoChar_05 : 200|8@1+ (1,0) [0|255] "ascii" ADAS_DOMAIN
 SG_ RouteInfoChar_06 : 208|8@1+ (1,0) [0|255] "ascii" ADAS_DOMAIN
 SG_ RouteInfoChar_07 : 216|8@1+ (1,0) [0|255] "ascii" ADAS_DOMAIN
 SG_ RouteInfoChar_08 : 224|8@1+ (1,0) [0|255] "ascii" ADAS_DOMAIN
 SG_ RouteInfoChar_09 : 232|8@1+ (1,0) [0|255] "ascii" ADAS_DOMAIN
 SG_ RouteInfoChar_10 : 240|8@1+ (1,0) [0|255] "ascii" ADAS_DOMAIN
 SG_ RouteInfoChar_11 : 248|8@1+ (1,0) [0|255] "ascii" ADAS_DOMAIN
 SG_ RouteInfoChar_12 : 256|8@1+ (1,0) [0|255] "ascii" ADAS_DOMAIN
 SG_ RouteInfoChar_13 : 264|8@1+ (1,0) [0|255] "ascii" ADAS_DOMAIN
 SG_ RouteInfoChar_14 : 272|8@1+ (1,0) [0|255] "ascii" ADAS_DOMAIN
 SG_ RouteInfoChar_15 : 280|8@1+ (1,0) [0|255] "ascii" ADAS_DOMAIN
 SG_ RouteInfoChar_16 : 288|8@1+ (1,0) [0|255] "ascii" ADAS_DOMAIN
 SG_ RouteInfoChar_17 : 296|8@1+ (1,0) [0|255] "ascii" ADAS_DOMAIN
 SG_ RouteInfoChar_18 : 304|8@1+ (1,0) [0|255] "ascii" ADAS_DOMAIN
 SG_ RouteInfoChar_19 : 312|8@1+ (1,0) [0|255] "ascii" ADAS_DOMAIN
 SG_ RouteInfoChar_20 : 320|8@1+ (1,0) [0|255] "ascii" ADAS_DOMAIN
 SG_ RouteInfoChar_21 : 328|8@1+ (1,0) [0|255] "ascii" ADAS_DOMAIN
 SG_ RouteInfoChar_22 : 336|8@1+ (1,0) [0|255] "ascii" ADAS_DOMAIN
 SG_ RouteInfoChar_23 : 344|8@1+ (1,0) [0|255] "ascii" ADAS_DOMAIN
 SG_ RouteInfoChar_24 : 352|8@1+ (1,0) [0|255] "ascii" ADAS_DOMAIN
 SG_ RouteInfoChar_25 : 360|8@1+ (1,0) [0|255] "ascii" ADAS_DOMAIN
 SG_ RouteInfoChar_26 : 368|8@1+ (1,0) [0|255] "ascii" ADAS_DOMAIN
 SG_ RouteInfoChar_27 : 376|8@1+ (1,0) [0|255] "ascii" ADAS_DOMAIN
 SG_ RouteInfoChar_28 : 384|8@1+ (1,0) [0|255] "ascii" ADAS_DOMAIN
 SG_ RouteInfoChar_29 : 392|8@1+ (1,0) [0|255] "ascii" ADAS_DOMAIN
 SG_ RouteInfoChar_30 : 400|8@1+ (1,0) [0|255] "ascii" ADAS_DOMAIN
 SG_ RouteInfoChar_31 : 408|8@1+ (1,0) [0|255] "ascii" ADAS_DOMAIN
 SG_ RouteInfoChar_32 : 416|8@1+ (1,0) [0|255] "ascii" ADAS_DOMAIN
 SG_ RouteInfoChar_33 : 424|8@1+ (1,0) [0|255] "ascii" ADAS_DOMAIN
 SG_ RouteInfoChar_34 : 432|8@1+ (1,0) [0|255] "ascii" ADAS_DOMAIN
 SG_ RouteInfoChar_35 : 440|8@1+ (1,0) [0|255] "ascii" ADAS_DOMAIN
 SG_ RouteInfoChar_36 : 448|8@1+ (1,0) [0|255] "ascii" ADAS_DOMAIN
 SG_ RouteInfoChar_37 : 456|8@1+ (1,0) [0|255] "ascii" ADAS_DOMAIN
 SG_ RouteInfoChar_38 : 464|8@1+ (1,0) [0|255] "ascii" ADAS_DOMAIN
 SG_ RouteInfoChar_39 : 472|8@1+ (1,0) [0|255] "ascii" ADAS_DOMAIN
 SG_ RouteInfoChar_40 : 480|8@1+ (1,0) [0|255] "ascii" ADAS_DOMAIN
 SG_ RouteInfoChar_41 : 488|8@1+ (1,0) [0|255] "ascii" ADAS_DOMAIN
 SG_ RouteInfoChar_42 : 496|8@1+ (1,0) [0|255] "ascii" ADAS_DOMAIN
 SG_ RouteInfoChar_43 : 504|8@1+ (1,0) [0|255] "ascii" ADAS_DOMAIN
CM_ BO_ 267 "Cycle=33ms; Channel=CAN11; CAN-FD; NominalBitrate=500kbit/s; DataBitrate=500kbit/s;  Data request; receiver answers with response frame; PayloadRouteInfo='CAMERA_FRONT_WIDE -> ADAS_DOMAIN' in bytes 20-63;";

BO_ 1547 RESP_011_ADAS_DOMAIN_TO_CAMERA_FRONT_WIDE: 16 ADAS_DOMAIN
 SG_ CRC8 : 0|8@1+ (1,0) [0|255] "" CAMERA_FRONT_WIDE
 SG_ ResponseCounter : 8|4@1+ (1,0) [0|15] "" CAMERA_FRONT_WIDE
 SG_ AckState : 12|4@1+ (1,0) [0|15] "" CAMERA_FRONT_WIDE
 SG_ ReceivedFrameId : 16|11@1+ (1,0) [0|2047] "" CAMERA_FRONT_WIDE
 SG_ ReceivedCounter : 27|4@1+ (1,0) [0|15] "" CAMERA_FRONT_WIDE
 SG_ ChecksumOk : 31|1@1+ (1,0) [0|1] "" CAMERA_FRONT_WIDE
 SG_ PayloadLength : 32|8@1+ (1,0) [0|64] "byte" CAMERA_FRONT_WIDE
 SG_ ErrorCode : 40|8@1+ (1,0) [0|255] "" CAMERA_FRONT_WIDE
 SG_ ProcessingTimeUs : 48|16@1+ (1,0) [0|65535] "us" CAMERA_FRONT_WIDE
 SG_ ResponseSequence : 64|16@1+ (1,0) [0|65535] "" CAMERA_FRONT_WIDE
 SG_ ReceivedCrc : 80|8@1+ (1,0) [0|255] "" CAMERA_FRONT_WIDE
 SG_ CalculatedCrc : 88|8@1+ (1,0) [0|255] "" CAMERA_FRONT_WIDE
CM_ BO_ 1547 "Cycle=33ms; Channel=CAN11; CAN-FD; NominalBitrate=500kbit/s; DataBitrate=500kbit/s;  ResponseFor=0x10B; ACK/NACK with CRC, DLC and counter check;";

BO_ 268 DATA_012_RADAR_FRONT_LONG_RANGE_TO_ADAS_DOMAIN: 64 RADAR_FRONT_LONG_RANGE
 SG_ CRC8 : 0|8@1+ (1,0) [0|255] "" ADAS_DOMAIN
 SG_ AliveCounter : 8|4@1+ (1,0) [0|15] "" ADAS_DOMAIN
 SG_ MuxState : 12|4@1+ (1,0) [0|15] "" ADAS_DOMAIN
 SG_ SIG_10C_00 : 16|12@1+ (0.1,0.0) [0|4095] "V" ADAS_DOMAIN
 SG_ SIG_10C_01 : 28|12@1+ (0.1,0.0) [0|4095] "m" ADAS_DOMAIN
 SG_ SIG_10C_02 : 40|12@1+ (0.1,0.0) [0|4095] "obj" ADAS_DOMAIN
 SG_ SIG_10C_03 : 52|12@1+ (0.1,0.0) [0|4095] "Nm" ADAS_DOMAIN
 SG_ SIG_10C_04 : 64|12@1+ (0.1,0.0) [0|4095] "deg" ADAS_DOMAIN
 SG_ SIG_10C_05 : 76|12@1+ (0.1,0.0) [0|4095] "A" ADAS_DOMAIN
 SG_ SIG_10C_06 : 88|12@1+ (0.1,0.0) [0|4095] "deg" ADAS_DOMAIN
 SG_ SIG_10C_07 : 100|12@1+ (0.1,0.0) [0|4095] "m" ADAS_DOMAIN
 SG_ SIG_10C_08 : 112|12@1+ (0.1,0.0) [0|4095] "m" ADAS_DOMAIN
 SG_ SIG_10C_09 : 124|12@1+ (0.1,0.0) [0|4095] "km/h" ADAS_DOMAIN
 SG_ SIG_10C_10 : 136|12@1+ (0.1,0.0) [0|4095] "obj" ADAS_DOMAIN
 SG_ SIG_10C_11 : 148|12@1+ (0.1,0.0) [0|4095] "A" ADAS_DOMAIN
 SG_ RouteInfoChar_00 : 160|8@1+ (1,0) [0|255] "ascii" ADAS_DOMAIN
 SG_ RouteInfoChar_01 : 168|8@1+ (1,0) [0|255] "ascii" ADAS_DOMAIN
 SG_ RouteInfoChar_02 : 176|8@1+ (1,0) [0|255] "ascii" ADAS_DOMAIN
 SG_ RouteInfoChar_03 : 184|8@1+ (1,0) [0|255] "ascii" ADAS_DOMAIN
 SG_ RouteInfoChar_04 : 192|8@1+ (1,0) [0|255] "ascii" ADAS_DOMAIN
 SG_ RouteInfoChar_05 : 200|8@1+ (1,0) [0|255] "ascii" ADAS_DOMAIN
 SG_ RouteInfoChar_06 : 208|8@1+ (1,0) [0|255] "ascii" ADAS_DOMAIN
 SG_ RouteInfoChar_07 : 216|8@1+ (1,0) [0|255] "ascii" ADAS_DOMAIN
 SG_ RouteInfoChar_08 : 224|8@1+ (1,0) [0|255] "ascii" ADAS_DOMAIN
 SG_ RouteInfoChar_09 : 232|8@1+ (1,0) [0|255] "ascii" ADAS_DOMAIN
 SG_ RouteInfoChar_10 : 240|8@1+ (1,0) [0|255] "ascii" ADAS_DOMAIN
 SG_ RouteInfoChar_11 : 248|8@1+ (1,0) [0|255] "ascii" ADAS_DOMAIN
 SG_ RouteInfoChar_12 : 256|8@1+ (1,0) [0|255] "ascii" ADAS_DOMAIN
 SG_ RouteInfoChar_13 : 264|8@1+ (1,0) [0|255] "ascii" ADAS_DOMAIN
 SG_ RouteInfoChar_14 : 272|8@1+ (1,0) [0|255] "ascii" ADAS_DOMAIN
 SG_ RouteInfoChar_15 : 280|8@1+ (1,0) [0|255] "ascii" ADAS_DOMAIN
 SG_ RouteInfoChar_16 : 288|8@1+ (1,0) [0|255] "ascii" ADAS_DOMAIN
 SG_ RouteInfoChar_17 : 296|8@1+ (1,0) [0|255] "ascii" ADAS_DOMAIN
 SG_ RouteInfoChar_18 : 304|8@1+ (1,0) [0|255] "ascii" ADAS_DOMAIN
 SG_ RouteInfoChar_19 : 312|8@1+ (1,0) [0|255] "ascii" ADAS_DOMAIN
 SG_ RouteInfoChar_20 : 320|8@1+ (1,0) [0|255] "ascii" ADAS_DOMAIN
 SG_ RouteInfoChar_21 : 328|8@1+ (1,0) [0|255] "ascii" ADAS_DOMAIN
 SG_ RouteInfoChar_22 : 336|8@1+ (1,0) [0|255] "ascii" ADAS_DOMAIN
 SG_ RouteInfoChar_23 : 344|8@1+ (1,0) [0|255] "ascii" ADAS_DOMAIN
 SG_ RouteInfoChar_24 : 352|8@1+ (1,0) [0|255] "ascii" ADAS_DOMAIN
 SG_ RouteInfoChar_25 : 360|8@1+ (1,0) [0|255] "ascii" ADAS_DOMAIN
 SG_ RouteInfoChar_26 : 368|8@1+ (1,0) [0|255] "ascii" ADAS_DOMAIN
 SG_ RouteInfoChar_27 : 376|8@1+ (1,0) [0|255] "ascii" ADAS_DOMAIN
 SG_ RouteInfoChar_28 : 384|8@1+ (1,0) [0|255] "ascii" ADAS_DOMAIN
 SG_ RouteInfoChar_29 : 392|8@1+ (1,0) [0|255] "ascii" ADAS_DOMAIN
 SG_ RouteInfoChar_30 : 400|8@1+ (1,0) [0|255] "ascii" ADAS_DOMAIN
 SG_ RouteInfoChar_31 : 408|8@1+ (1,0) [0|255] "ascii" ADAS_DOMAIN
 SG_ RouteInfoChar_32 : 416|8@1+ (1,0) [0|255] "ascii" ADAS_DOMAIN
 SG_ RouteInfoChar_33 : 424|8@1+ (1,0) [0|255] "ascii" ADAS_DOMAIN
 SG_ RouteInfoChar_34 : 432|8@1+ (1,0) [0|255] "ascii" ADAS_DOMAIN
 SG_ RouteInfoChar_35 : 440|8@1+ (1,0) [0|255] "ascii" ADAS_DOMAIN
 SG_ RouteInfoChar_36 : 448|8@1+ (1,0) [0|255] "ascii" ADAS_DOMAIN
 SG_ RouteInfoChar_37 : 456|8@1+ (1,0) [0|255] "ascii" ADAS_DOMAIN
 SG_ RouteInfoChar_38 : 464|8@1+ (1,0) [0|255] "ascii" ADAS_DOMAIN
 SG_ RouteInfoChar_39 : 472|8@1+ (1,0) [0|255] "ascii" ADAS_DOMAIN
 SG_ RouteInfoChar_40 : 480|8@1+ (1,0) [0|255] "ascii" ADAS_DOMAIN
 SG_ RouteInfoChar_41 : 488|8@1+ (1,0) [0|255] "ascii" ADAS_DOMAIN
 SG_ RouteInfoChar_42 : 496|8@1+ (1,0) [0|255] "ascii" ADAS_DOMAIN
 SG_ RouteInfoChar_43 : 504|8@1+ (1,0) [0|255] "ascii" ADAS_DOMAIN
CM_ BO_ 268 "Cycle=20ms; Channel=CAN12; CAN-FD; NominalBitrate=500kbit/s; DataBitrate=500kbit/s;  Data request; receiver answers with response frame; PayloadRouteInfo='RADAR_FRONT_LONG_RANGE -> ADAS_DOMAIN' in bytes 20-63;";

BO_ 1548 RESP_012_ADAS_DOMAIN_TO_RADAR_FRONT_LONG_RANGE: 16 ADAS_DOMAIN
 SG_ CRC8 : 0|8@1+ (1,0) [0|255] "" RADAR_FRONT_LONG_RANGE
 SG_ ResponseCounter : 8|4@1+ (1,0) [0|15] "" RADAR_FRONT_LONG_RANGE
 SG_ AckState : 12|4@1+ (1,0) [0|15] "" RADAR_FRONT_LONG_RANGE
 SG_ ReceivedFrameId : 16|11@1+ (1,0) [0|2047] "" RADAR_FRONT_LONG_RANGE
 SG_ ReceivedCounter : 27|4@1+ (1,0) [0|15] "" RADAR_FRONT_LONG_RANGE
 SG_ ChecksumOk : 31|1@1+ (1,0) [0|1] "" RADAR_FRONT_LONG_RANGE
 SG_ PayloadLength : 32|8@1+ (1,0) [0|64] "byte" RADAR_FRONT_LONG_RANGE
 SG_ ErrorCode : 40|8@1+ (1,0) [0|255] "" RADAR_FRONT_LONG_RANGE
 SG_ ProcessingTimeUs : 48|16@1+ (1,0) [0|65535] "us" RADAR_FRONT_LONG_RANGE
 SG_ ResponseSequence : 64|16@1+ (1,0) [0|65535] "" RADAR_FRONT_LONG_RANGE
 SG_ ReceivedCrc : 80|8@1+ (1,0) [0|255] "" RADAR_FRONT_LONG_RANGE
 SG_ CalculatedCrc : 88|8@1+ (1,0) [0|255] "" RADAR_FRONT_LONG_RANGE
CM_ BO_ 1548 "Cycle=20ms; Channel=CAN12; CAN-FD; NominalBitrate=500kbit/s; DataBitrate=500kbit/s;  ResponseFor=0x10C; ACK/NACK with CRC, DLC and counter check;";

BO_ 269 DATA_013_RADAR_REAR_CROSS_TRAFFIC_TO_ADAS_DOMAIN: 64 RADAR_REAR_CROSS_TRAFFIC
 SG_ CRC8 : 0|8@1+ (1,0) [0|255] "" ADAS_DOMAIN
 SG_ AliveCounter : 8|4@1+ (1,0) [0|15] "" ADAS_DOMAIN
 SG_ MuxState : 12|4@1+ (1,0) [0|15] "" ADAS_DOMAIN
 SG_ SIG_10D_00 : 16|12@1+ (0.1,0.0) [0|4095] "C" ADAS_DOMAIN
 SG_ SIG_10D_01 : 28|12@1+ (0.1,0.0) [0|4095] "km/h" ADAS_DOMAIN
 SG_ SIG_10D_02 : 40|12@1+ (0.1,0.0) [0|4095] "rpm" ADAS_DOMAIN
 SG_ SIG_10D_03 : 52|12@1+ (0.1,0.0) [0|4095] "A" ADAS_DOMAIN
 SG_ SIG_10D_04 : 64|12@1+ (0.1,0.0) [0|4095] "V" ADAS_DOMAIN
 SG_ SIG_10D_05 : 76|12@1+ (0.1,0.0) [0|4095] "Nm" ADAS_DOMAIN
 SG_ SIG_10D_06 : 88|12@1+ (0.1,0.0) [0|4095] "km/h" ADAS_DOMAIN
 SG_ SIG_10D_07 : 100|12@1+ (0.1,0.0) [0|4095] "Nm" ADAS_DOMAIN
 SG_ SIG_10D_08 : 112|12@1+ (0.1,0.0) [0|4095] "obj" ADAS_DOMAIN
 SG_ SIG_10D_09 : 124|12@1+ (0.1,0.0) [0|4095] "rpm" ADAS_DOMAIN
 SG_ SIG_10D_10 : 136|12@1+ (0.1,0.0) [0|4095] "rpm" ADAS_DOMAIN
 SG_ SIG_10D_11 : 148|12@1+ (0.1,0.0) [0|4095] "C" ADAS_DOMAIN
 SG_ RouteInfoChar_00 : 160|8@1+ (1,0) [0|255] "ascii" ADAS_DOMAIN
 SG_ RouteInfoChar_01 : 168|8@1+ (1,0) [0|255] "ascii" ADAS_DOMAIN
 SG_ RouteInfoChar_02 : 176|8@1+ (1,0) [0|255] "ascii" ADAS_DOMAIN
 SG_ RouteInfoChar_03 : 184|8@1+ (1,0) [0|255] "ascii" ADAS_DOMAIN
 SG_ RouteInfoChar_04 : 192|8@1+ (1,0) [0|255] "ascii" ADAS_DOMAIN
 SG_ RouteInfoChar_05 : 200|8@1+ (1,0) [0|255] "ascii" ADAS_DOMAIN
 SG_ RouteInfoChar_06 : 208|8@1+ (1,0) [0|255] "ascii" ADAS_DOMAIN
 SG_ RouteInfoChar_07 : 216|8@1+ (1,0) [0|255] "ascii" ADAS_DOMAIN
 SG_ RouteInfoChar_08 : 224|8@1+ (1,0) [0|255] "ascii" ADAS_DOMAIN
 SG_ RouteInfoChar_09 : 232|8@1+ (1,0) [0|255] "ascii" ADAS_DOMAIN
 SG_ RouteInfoChar_10 : 240|8@1+ (1,0) [0|255] "ascii" ADAS_DOMAIN
 SG_ RouteInfoChar_11 : 248|8@1+ (1,0) [0|255] "ascii" ADAS_DOMAIN
 SG_ RouteInfoChar_12 : 256|8@1+ (1,0) [0|255] "ascii" ADAS_DOMAIN
 SG_ RouteInfoChar_13 : 264|8@1+ (1,0) [0|255] "ascii" ADAS_DOMAIN
 SG_ RouteInfoChar_14 : 272|8@1+ (1,0) [0|255] "ascii" ADAS_DOMAIN
 SG_ RouteInfoChar_15 : 280|8@1+ (1,0) [0|255] "ascii" ADAS_DOMAIN
 SG_ RouteInfoChar_16 : 288|8@1+ (1,0) [0|255] "ascii" ADAS_DOMAIN
 SG_ RouteInfoChar_17 : 296|8@1+ (1,0) [0|255] "ascii" ADAS_DOMAIN
 SG_ RouteInfoChar_18 : 304|8@1+ (1,0) [0|255] "ascii" ADAS_DOMAIN
 SG_ RouteInfoChar_19 : 312|8@1+ (1,0) [0|255] "ascii" ADAS_DOMAIN
 SG_ RouteInfoChar_20 : 320|8@1+ (1,0) [0|255] "ascii" ADAS_DOMAIN
 SG_ RouteInfoChar_21 : 328|8@1+ (1,0) [0|255] "ascii" ADAS_DOMAIN
 SG_ RouteInfoChar_22 : 336|8@1+ (1,0) [0|255] "ascii" ADAS_DOMAIN
 SG_ RouteInfoChar_23 : 344|8@1+ (1,0) [0|255] "ascii" ADAS_DOMAIN
 SG_ RouteInfoChar_24 : 352|8@1+ (1,0) [0|255] "ascii" ADAS_DOMAIN
 SG_ RouteInfoChar_25 : 360|8@1+ (1,0) [0|255] "ascii" ADAS_DOMAIN
 SG_ RouteInfoChar_26 : 368|8@1+ (1,0) [0|255] "ascii" ADAS_DOMAIN
 SG_ RouteInfoChar_27 : 376|8@1+ (1,0) [0|255] "ascii" ADAS_DOMAIN
 SG_ RouteInfoChar_28 : 384|8@1+ (1,0) [0|255] "ascii" ADAS_DOMAIN
 SG_ RouteInfoChar_29 : 392|8@1+ (1,0) [0|255] "ascii" ADAS_DOMAIN
 SG_ RouteInfoChar_30 : 400|8@1+ (1,0) [0|255] "ascii" ADAS_DOMAIN
 SG_ RouteInfoChar_31 : 408|8@1+ (1,0) [0|255] "ascii" ADAS_DOMAIN
 SG_ RouteInfoChar_32 : 416|8@1+ (1,0) [0|255] "ascii" ADAS_DOMAIN
 SG_ RouteInfoChar_33 : 424|8@1+ (1,0) [0|255] "ascii" ADAS_DOMAIN
 SG_ RouteInfoChar_34 : 432|8@1+ (1,0) [0|255] "ascii" ADAS_DOMAIN
 SG_ RouteInfoChar_35 : 440|8@1+ (1,0) [0|255] "ascii" ADAS_DOMAIN
 SG_ RouteInfoChar_36 : 448|8@1+ (1,0) [0|255] "ascii" ADAS_DOMAIN
 SG_ RouteInfoChar_37 : 456|8@1+ (1,0) [0|255] "ascii" ADAS_DOMAIN
 SG_ RouteInfoChar_38 : 464|8@1+ (1,0) [0|255] "ascii" ADAS_DOMAIN
 SG_ RouteInfoChar_39 : 472|8@1+ (1,0) [0|255] "ascii" ADAS_DOMAIN
 SG_ RouteInfoChar_40 : 480|8@1+ (1,0) [0|255] "ascii" ADAS_DOMAIN
 SG_ RouteInfoChar_41 : 488|8@1+ (1,0) [0|255] "ascii" ADAS_DOMAIN
 SG_ RouteInfoChar_42 : 496|8@1+ (1,0) [0|255] "ascii" ADAS_DOMAIN
 SG_ RouteInfoChar_43 : 504|8@1+ (1,0) [0|255] "ascii" ADAS_DOMAIN
CM_ BO_ 269 "Cycle=50ms; Channel=CAN13; CAN-FD; NominalBitrate=500kbit/s; DataBitrate=500kbit/s;  Data request; receiver answers with response frame; PayloadRouteInfo='RADAR_REAR_CROSS_TRAFFIC -> ADAS_DOMAIN' in bytes 20-63;";

BO_ 1549 RESP_013_ADAS_DOMAIN_TO_RADAR_REAR_CROSS_TRAFFIC: 16 ADAS_DOMAIN
 SG_ CRC8 : 0|8@1+ (1,0) [0|255] "" RADAR_REAR_CROSS_TRAFFIC
 SG_ ResponseCounter : 8|4@1+ (1,0) [0|15] "" RADAR_REAR_CROSS_TRAFFIC
 SG_ AckState : 12|4@1+ (1,0) [0|15] "" RADAR_REAR_CROSS_TRAFFIC
 SG_ ReceivedFrameId : 16|11@1+ (1,0) [0|2047] "" RADAR_REAR_CROSS_TRAFFIC
 SG_ ReceivedCounter : 27|4@1+ (1,0) [0|15] "" RADAR_REAR_CROSS_TRAFFIC
 SG_ ChecksumOk : 31|1@1+ (1,0) [0|1] "" RADAR_REAR_CROSS_TRAFFIC
 SG_ PayloadLength : 32|8@1+ (1,0) [0|64] "byte" RADAR_REAR_CROSS_TRAFFIC
 SG_ ErrorCode : 40|8@1+ (1,0) [0|255] "" RADAR_REAR_CROSS_TRAFFIC
 SG_ ProcessingTimeUs : 48|16@1+ (1,0) [0|65535] "us" RADAR_REAR_CROSS_TRAFFIC
 SG_ ResponseSequence : 64|16@1+ (1,0) [0|65535] "" RADAR_REAR_CROSS_TRAFFIC
 SG_ ReceivedCrc : 80|8@1+ (1,0) [0|255] "" RADAR_REAR_CROSS_TRAFFIC
 SG_ CalculatedCrc : 88|8@1+ (1,0) [0|255] "" RADAR_REAR_CROSS_TRAFFIC
CM_ BO_ 1549 "Cycle=50ms; Channel=CAN13; CAN-FD; NominalBitrate=500kbit/s; DataBitrate=500kbit/s;  ResponseFor=0x10D; ACK/NACK with CRC, DLC and counter check;";

BO_ 270 DATA_014_ULTRASONIC_LEFT_CLUSTER_TO_PARK_ASSIST: 64 ULTRASONIC_LEFT_CLUSTER
 SG_ CRC8 : 0|8@1+ (1,0) [0|255] "" PARK_ASSIST
 SG_ AliveCounter : 8|4@1+ (1,0) [0|15] "" PARK_ASSIST
 SG_ MuxState : 12|4@1+ (1,0) [0|15] "" PARK_ASSIST
 SG_ SIG_10E_00 : 16|12@1+ (0.1,0.0) [0|4095] "rpm" PARK_ASSIST
 SG_ SIG_10E_01 : 28|12@1+ (0.1,0.0) [0|4095] "m" PARK_ASSIST
 SG_ SIG_10E_02 : 40|12@1+ (0.1,0.0) [0|4095] "deg" PARK_ASSIST
 SG_ SIG_10E_03 : 52|12@1+ (0.1,0.0) [0|4095] "deg" PARK_ASSIST
 SG_ SIG_10E_04 : 64|12@1+ (0.1,0.0) [0|4095] "C" PARK_ASSIST
 SG_ SIG_10E_05 : 76|12@1+ (0.1,0.0) [0|4095] "m" PARK_ASSIST
 SG_ SIG_10E_06 : 88|12@1+ (0.1,0.0) [0|4095] "deg" PARK_ASSIST
 SG_ SIG_10E_07 : 100|12@1+ (0.1,0.0) [0|4095] "V" PARK_ASSIST
 SG_ SIG_10E_08 : 112|12@1+ (0.1,0.0) [0|4095] "m" PARK_ASSIST
 SG_ SIG_10E_09 : 124|12@1+ (0.1,0.0) [0|4095] "obj" PARK_ASSIST
 SG_ SIG_10E_10 : 136|12@1+ (0.1,0.0) [0|4095] "%" PARK_ASSIST
 SG_ SIG_10E_11 : 148|12@1+ (0.1,0.0) [0|4095] "Nm" PARK_ASSIST
 SG_ RouteInfoChar_00 : 160|8@1+ (1,0) [0|255] "ascii" PARK_ASSIST
 SG_ RouteInfoChar_01 : 168|8@1+ (1,0) [0|255] "ascii" PARK_ASSIST
 SG_ RouteInfoChar_02 : 176|8@1+ (1,0) [0|255] "ascii" PARK_ASSIST
 SG_ RouteInfoChar_03 : 184|8@1+ (1,0) [0|255] "ascii" PARK_ASSIST
 SG_ RouteInfoChar_04 : 192|8@1+ (1,0) [0|255] "ascii" PARK_ASSIST
 SG_ RouteInfoChar_05 : 200|8@1+ (1,0) [0|255] "ascii" PARK_ASSIST
 SG_ RouteInfoChar_06 : 208|8@1+ (1,0) [0|255] "ascii" PARK_ASSIST
 SG_ RouteInfoChar_07 : 216|8@1+ (1,0) [0|255] "ascii" PARK_ASSIST
 SG_ RouteInfoChar_08 : 224|8@1+ (1,0) [0|255] "ascii" PARK_ASSIST
 SG_ RouteInfoChar_09 : 232|8@1+ (1,0) [0|255] "ascii" PARK_ASSIST
 SG_ RouteInfoChar_10 : 240|8@1+ (1,0) [0|255] "ascii" PARK_ASSIST
 SG_ RouteInfoChar_11 : 248|8@1+ (1,0) [0|255] "ascii" PARK_ASSIST
 SG_ RouteInfoChar_12 : 256|8@1+ (1,0) [0|255] "ascii" PARK_ASSIST
 SG_ RouteInfoChar_13 : 264|8@1+ (1,0) [0|255] "ascii" PARK_ASSIST
 SG_ RouteInfoChar_14 : 272|8@1+ (1,0) [0|255] "ascii" PARK_ASSIST
 SG_ RouteInfoChar_15 : 280|8@1+ (1,0) [0|255] "ascii" PARK_ASSIST
 SG_ RouteInfoChar_16 : 288|8@1+ (1,0) [0|255] "ascii" PARK_ASSIST
 SG_ RouteInfoChar_17 : 296|8@1+ (1,0) [0|255] "ascii" PARK_ASSIST
 SG_ RouteInfoChar_18 : 304|8@1+ (1,0) [0|255] "ascii" PARK_ASSIST
 SG_ RouteInfoChar_19 : 312|8@1+ (1,0) [0|255] "ascii" PARK_ASSIST
 SG_ RouteInfoChar_20 : 320|8@1+ (1,0) [0|255] "ascii" PARK_ASSIST
 SG_ RouteInfoChar_21 : 328|8@1+ (1,0) [0|255] "ascii" PARK_ASSIST
 SG_ RouteInfoChar_22 : 336|8@1+ (1,0) [0|255] "ascii" PARK_ASSIST
 SG_ RouteInfoChar_23 : 344|8@1+ (1,0) [0|255] "ascii" PARK_ASSIST
 SG_ RouteInfoChar_24 : 352|8@1+ (1,0) [0|255] "ascii" PARK_ASSIST
 SG_ RouteInfoChar_25 : 360|8@1+ (1,0) [0|255] "ascii" PARK_ASSIST
 SG_ RouteInfoChar_26 : 368|8@1+ (1,0) [0|255] "ascii" PARK_ASSIST
 SG_ RouteInfoChar_27 : 376|8@1+ (1,0) [0|255] "ascii" PARK_ASSIST
 SG_ RouteInfoChar_28 : 384|8@1+ (1,0) [0|255] "ascii" PARK_ASSIST
 SG_ RouteInfoChar_29 : 392|8@1+ (1,0) [0|255] "ascii" PARK_ASSIST
 SG_ RouteInfoChar_30 : 400|8@1+ (1,0) [0|255] "ascii" PARK_ASSIST
 SG_ RouteInfoChar_31 : 408|8@1+ (1,0) [0|255] "ascii" PARK_ASSIST
 SG_ RouteInfoChar_32 : 416|8@1+ (1,0) [0|255] "ascii" PARK_ASSIST
 SG_ RouteInfoChar_33 : 424|8@1+ (1,0) [0|255] "ascii" PARK_ASSIST
 SG_ RouteInfoChar_34 : 432|8@1+ (1,0) [0|255] "ascii" PARK_ASSIST
 SG_ RouteInfoChar_35 : 440|8@1+ (1,0) [0|255] "ascii" PARK_ASSIST
 SG_ RouteInfoChar_36 : 448|8@1+ (1,0) [0|255] "ascii" PARK_ASSIST
 SG_ RouteInfoChar_37 : 456|8@1+ (1,0) [0|255] "ascii" PARK_ASSIST
 SG_ RouteInfoChar_38 : 464|8@1+ (1,0) [0|255] "ascii" PARK_ASSIST
 SG_ RouteInfoChar_39 : 472|8@1+ (1,0) [0|255] "ascii" PARK_ASSIST
 SG_ RouteInfoChar_40 : 480|8@1+ (1,0) [0|255] "ascii" PARK_ASSIST
 SG_ RouteInfoChar_41 : 488|8@1+ (1,0) [0|255] "ascii" PARK_ASSIST
 SG_ RouteInfoChar_42 : 496|8@1+ (1,0) [0|255] "ascii" PARK_ASSIST
 SG_ RouteInfoChar_43 : 504|8@1+ (1,0) [0|255] "ascii" PARK_ASSIST
CM_ BO_ 270 "Cycle=40ms; Channel=CAN14; CAN-FD; NominalBitrate=500kbit/s; DataBitrate=500kbit/s;  Data request; receiver answers with response frame; PayloadRouteInfo='ULTRASONIC_LEFT_CLUSTER -> PARK_ASSIST' in bytes 20-63;";

BO_ 1550 RESP_014_PARK_ASSIST_TO_ULTRASONIC_LEFT_CLUSTER: 16 PARK_ASSIST
 SG_ CRC8 : 0|8@1+ (1,0) [0|255] "" ULTRASONIC_LEFT_CLUSTER
 SG_ ResponseCounter : 8|4@1+ (1,0) [0|15] "" ULTRASONIC_LEFT_CLUSTER
 SG_ AckState : 12|4@1+ (1,0) [0|15] "" ULTRASONIC_LEFT_CLUSTER
 SG_ ReceivedFrameId : 16|11@1+ (1,0) [0|2047] "" ULTRASONIC_LEFT_CLUSTER
 SG_ ReceivedCounter : 27|4@1+ (1,0) [0|15] "" ULTRASONIC_LEFT_CLUSTER
 SG_ ChecksumOk : 31|1@1+ (1,0) [0|1] "" ULTRASONIC_LEFT_CLUSTER
 SG_ PayloadLength : 32|8@1+ (1,0) [0|64] "byte" ULTRASONIC_LEFT_CLUSTER
 SG_ ErrorCode : 40|8@1+ (1,0) [0|255] "" ULTRASONIC_LEFT_CLUSTER
 SG_ ProcessingTimeUs : 48|16@1+ (1,0) [0|65535] "us" ULTRASONIC_LEFT_CLUSTER
 SG_ ResponseSequence : 64|16@1+ (1,0) [0|65535] "" ULTRASONIC_LEFT_CLUSTER
 SG_ ReceivedCrc : 80|8@1+ (1,0) [0|255] "" ULTRASONIC_LEFT_CLUSTER
 SG_ CalculatedCrc : 88|8@1+ (1,0) [0|255] "" ULTRASONIC_LEFT_CLUSTER
CM_ BO_ 1550 "Cycle=40ms; Channel=CAN14; CAN-FD; NominalBitrate=500kbit/s; DataBitrate=500kbit/s;  ResponseFor=0x10E; ACK/NACK with CRC, DLC and counter check;";

BO_ 271 DATA_015_ULTRASONIC_RIGHT_CLUSTER_TO_PARK_ASSIST: 64 ULTRASONIC_RIGHT_CLUSTER
 SG_ CRC8 : 0|8@1+ (1,0) [0|255] "" PARK_ASSIST
 SG_ AliveCounter : 8|4@1+ (1,0) [0|15] "" PARK_ASSIST
 SG_ MuxState : 12|4@1+ (1,0) [0|15] "" PARK_ASSIST
 SG_ SIG_10F_00 : 16|12@1+ (0.1,0.0) [0|4095] "m" PARK_ASSIST
 SG_ SIG_10F_01 : 28|12@1+ (0.1,0.0) [0|4095] "Nm" PARK_ASSIST
 SG_ SIG_10F_02 : 40|12@1+ (0.1,0.0) [0|4095] "V" PARK_ASSIST
 SG_ SIG_10F_03 : 52|12@1+ (0.1,0.0) [0|4095] "%" PARK_ASSIST
 SG_ SIG_10F_04 : 64|12@1+ (0.1,0.0) [0|4095] "A" PARK_ASSIST
 SG_ SIG_10F_05 : 76|12@1+ (0.1,0.0) [0|4095] "C" PARK_ASSIST
 SG_ SIG_10F_06 : 88|12@1+ (0.1,0.0) [0|4095] "m" PARK_ASSIST
 SG_ SIG_10F_07 : 100|12@1+ (0.1,0.0) [0|4095] "C" PARK_ASSIST
 SG_ SIG_10F_08 : 112|12@1+ (0.1,0.0) [0|4095] "rpm" PARK_ASSIST
 SG_ SIG_10F_09 : 124|12@1+ (0.1,0.0) [0|4095] "Nm" PARK_ASSIST
 SG_ SIG_10F_10 : 136|12@1+ (0.1,0.0) [0|4095] "Nm" PARK_ASSIST
 SG_ SIG_10F_11 : 148|12@1+ (0.1,0.0) [0|4095] "rpm" PARK_ASSIST
 SG_ RouteInfoChar_00 : 160|8@1+ (1,0) [0|255] "ascii" PARK_ASSIST
 SG_ RouteInfoChar_01 : 168|8@1+ (1,0) [0|255] "ascii" PARK_ASSIST
 SG_ RouteInfoChar_02 : 176|8@1+ (1,0) [0|255] "ascii" PARK_ASSIST
 SG_ RouteInfoChar_03 : 184|8@1+ (1,0) [0|255] "ascii" PARK_ASSIST
 SG_ RouteInfoChar_04 : 192|8@1+ (1,0) [0|255] "ascii" PARK_ASSIST
 SG_ RouteInfoChar_05 : 200|8@1+ (1,0) [0|255] "ascii" PARK_ASSIST
 SG_ RouteInfoChar_06 : 208|8@1+ (1,0) [0|255] "ascii" PARK_ASSIST
 SG_ RouteInfoChar_07 : 216|8@1+ (1,0) [0|255] "ascii" PARK_ASSIST
 SG_ RouteInfoChar_08 : 224|8@1+ (1,0) [0|255] "ascii" PARK_ASSIST
 SG_ RouteInfoChar_09 : 232|8@1+ (1,0) [0|255] "ascii" PARK_ASSIST
 SG_ RouteInfoChar_10 : 240|8@1+ (1,0) [0|255] "ascii" PARK_ASSIST
 SG_ RouteInfoChar_11 : 248|8@1+ (1,0) [0|255] "ascii" PARK_ASSIST
 SG_ RouteInfoChar_12 : 256|8@1+ (1,0) [0|255] "ascii" PARK_ASSIST
 SG_ RouteInfoChar_13 : 264|8@1+ (1,0) [0|255] "ascii" PARK_ASSIST
 SG_ RouteInfoChar_14 : 272|8@1+ (1,0) [0|255] "ascii" PARK_ASSIST
 SG_ RouteInfoChar_15 : 280|8@1+ (1,0) [0|255] "ascii" PARK_ASSIST
 SG_ RouteInfoChar_16 : 288|8@1+ (1,0) [0|255] "ascii" PARK_ASSIST
 SG_ RouteInfoChar_17 : 296|8@1+ (1,0) [0|255] "ascii" PARK_ASSIST
 SG_ RouteInfoChar_18 : 304|8@1+ (1,0) [0|255] "ascii" PARK_ASSIST
 SG_ RouteInfoChar_19 : 312|8@1+ (1,0) [0|255] "ascii" PARK_ASSIST
 SG_ RouteInfoChar_20 : 320|8@1+ (1,0) [0|255] "ascii" PARK_ASSIST
 SG_ RouteInfoChar_21 : 328|8@1+ (1,0) [0|255] "ascii" PARK_ASSIST
 SG_ RouteInfoChar_22 : 336|8@1+ (1,0) [0|255] "ascii" PARK_ASSIST
 SG_ RouteInfoChar_23 : 344|8@1+ (1,0) [0|255] "ascii" PARK_ASSIST
 SG_ RouteInfoChar_24 : 352|8@1+ (1,0) [0|255] "ascii" PARK_ASSIST
 SG_ RouteInfoChar_25 : 360|8@1+ (1,0) [0|255] "ascii" PARK_ASSIST
 SG_ RouteInfoChar_26 : 368|8@1+ (1,0) [0|255] "ascii" PARK_ASSIST
 SG_ RouteInfoChar_27 : 376|8@1+ (1,0) [0|255] "ascii" PARK_ASSIST
 SG_ RouteInfoChar_28 : 384|8@1+ (1,0) [0|255] "ascii" PARK_ASSIST
 SG_ RouteInfoChar_29 : 392|8@1+ (1,0) [0|255] "ascii" PARK_ASSIST
 SG_ RouteInfoChar_30 : 400|8@1+ (1,0) [0|255] "ascii" PARK_ASSIST
 SG_ RouteInfoChar_31 : 408|8@1+ (1,0) [0|255] "ascii" PARK_ASSIST
 SG_ RouteInfoChar_32 : 416|8@1+ (1,0) [0|255] "ascii" PARK_ASSIST
 SG_ RouteInfoChar_33 : 424|8@1+ (1,0) [0|255] "ascii" PARK_ASSIST
 SG_ RouteInfoChar_34 : 432|8@1+ (1,0) [0|255] "ascii" PARK_ASSIST
 SG_ RouteInfoChar_35 : 440|8@1+ (1,0) [0|255] "ascii" PARK_ASSIST
 SG_ RouteInfoChar_36 : 448|8@1+ (1,0) [0|255] "ascii" PARK_ASSIST
 SG_ RouteInfoChar_37 : 456|8@1+ (1,0) [0|255] "ascii" PARK_ASSIST
 SG_ RouteInfoChar_38 : 464|8@1+ (1,0) [0|255] "ascii" PARK_ASSIST
 SG_ RouteInfoChar_39 : 472|8@1+ (1,0) [0|255] "ascii" PARK_ASSIST
 SG_ RouteInfoChar_40 : 480|8@1+ (1,0) [0|255] "ascii" PARK_ASSIST
 SG_ RouteInfoChar_41 : 488|8@1+ (1,0) [0|255] "ascii" PARK_ASSIST
 SG_ RouteInfoChar_42 : 496|8@1+ (1,0) [0|255] "ascii" PARK_ASSIST
 SG_ RouteInfoChar_43 : 504|8@1+ (1,0) [0|255] "ascii" PARK_ASSIST
CM_ BO_ 271 "Cycle=40ms; Channel=CAN15; CAN-FD; NominalBitrate=500kbit/s; DataBitrate=500kbit/s;  Data request; receiver answers with response frame; PayloadRouteInfo='ULTRASONIC_RIGHT_CLUSTER -> PARK_ASSIST' in bytes 20-63;";

BO_ 1551 RESP_015_PARK_ASSIST_TO_ULTRASONIC_RIGHT_CLUSTER: 16 PARK_ASSIST
 SG_ CRC8 : 0|8@1+ (1,0) [0|255] "" ULTRASONIC_RIGHT_CLUSTER
 SG_ ResponseCounter : 8|4@1+ (1,0) [0|15] "" ULTRASONIC_RIGHT_CLUSTER
 SG_ AckState : 12|4@1+ (1,0) [0|15] "" ULTRASONIC_RIGHT_CLUSTER
 SG_ ReceivedFrameId : 16|11@1+ (1,0) [0|2047] "" ULTRASONIC_RIGHT_CLUSTER
 SG_ ReceivedCounter : 27|4@1+ (1,0) [0|15] "" ULTRASONIC_RIGHT_CLUSTER
 SG_ ChecksumOk : 31|1@1+ (1,0) [0|1] "" ULTRASONIC_RIGHT_CLUSTER
 SG_ PayloadLength : 32|8@1+ (1,0) [0|64] "byte" ULTRASONIC_RIGHT_CLUSTER
 SG_ ErrorCode : 40|8@1+ (1,0) [0|255] "" ULTRASONIC_RIGHT_CLUSTER
 SG_ ProcessingTimeUs : 48|16@1+ (1,0) [0|65535] "us" ULTRASONIC_RIGHT_CLUSTER
 SG_ ResponseSequence : 64|16@1+ (1,0) [0|65535] "" ULTRASONIC_RIGHT_CLUSTER
 SG_ ReceivedCrc : 80|8@1+ (1,0) [0|255] "" ULTRASONIC_RIGHT_CLUSTER
 SG_ CalculatedCrc : 88|8@1+ (1,0) [0|255] "" ULTRASONIC_RIGHT_CLUSTER
CM_ BO_ 1551 "Cycle=40ms; Channel=CAN15; CAN-FD; NominalBitrate=500kbit/s; DataBitrate=500kbit/s;  ResponseFor=0x10F; ACK/NACK with CRC, DLC and counter check;";
