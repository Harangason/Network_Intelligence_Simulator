VERSION "Realistic CAN Trace Generator"

NS_ :

BS_:

BU_: ADAS_DOMAIN BRAKE_CONTROLLER CAMERA_FRONT_WIDE IMU_YAW_RATE_SENSOR LIDAR_FRONT PARK_ASSIST RADAR_FRONT_LONG_RANGE RADAR_REAR_CROSS_TRAFFIC ULTRASONIC_LEFT_CLUSTER ULTRASONIC_RIGHT_CLUSTER VEHICLE_MOTION_CONTROLLER WHEEL_SPEED_FRONT_LEFT

BO_ 356 DATA_034_ULTRASONIC_LEFT_DISTANCE: 64 ULTRASONIC_LEFT_CLUSTER
 SG_ CRC8 : 0|8@1+ (1,0) [0|255] "" PARK_ASSIST
 SG_ AliveCounter : 8|4@1+ (1,0) [0|15] "" PARK_ASSIST
 SG_ MuxState : 12|4@1+ (1,0) [0|15] "" PARK_ASSIST
 SG_ SIG_164_00 : 16|12@1+ (0.1,0.0) [0|4095] "%" PARK_ASSIST
 SG_ SIG_164_01 : 28|12@1+ (0.1,0.0) [0|4095] "Nm" PARK_ASSIST
 SG_ SIG_164_02 : 40|12@1+ (0.1,0.0) [0|4095] "V" PARK_ASSIST
 SG_ SIG_164_03 : 52|12@1+ (0.1,0.0) [0|4095] "deg" PARK_ASSIST
 SG_ SIG_164_04 : 64|12@1+ (0.1,0.0) [0|4095] "rpm" PARK_ASSIST
 SG_ SIG_164_05 : 76|12@1+ (0.1,0.0) [0|4095] "%" PARK_ASSIST
 SG_ SIG_164_06 : 88|12@1+ (0.1,0.0) [0|4095] "km/h" PARK_ASSIST
 SG_ SIG_164_07 : 100|12@1+ (0.1,0.0) [0|4095] "C" PARK_ASSIST
 SG_ SIG_164_08 : 112|12@1+ (0.1,0.0) [0|4095] "Nm" PARK_ASSIST
 SG_ SIG_164_09 : 124|12@1+ (0.1,0.0) [0|4095] "Nm" PARK_ASSIST
 SG_ SIG_164_10 : 136|12@1+ (0.1,0.0) [0|4095] "C" PARK_ASSIST
 SG_ SIG_164_11 : 148|12@1+ (0.1,0.0) [0|4095] "A" PARK_ASSIST
 SG_ RouteInfoChar_00 : 160|8@1+ (1,0) [0|255] "ascii" PARK_ASSIST
 SG_ RouteInfoChar_01 : 168|8@1+ (1,0) [0|255] "ascii" PARK_ASSIST
 SG_ RouteInfoChar_02 : 176|8@1+ (1,0) [0|255] "ascii" PARK_ASSIST
 SG_ RouteInfoChar_03 : 184|8@1+ (1,0) [0|255] "ascii" PARK_ASSIST
 SG_ RouteInfoChar_04 : 192|8@1+ (1,0) [0|255] "ascii" PARK_ASSIST
 SG_ RouteInfoChar_05 : 200|8@1+ (1,0) [0|255] "ascii" PARK_ASSIST
 SG_ RouteInfoChar_06 : 208|8@1+ (1,0) [0|255] "ascii" PARK_ASSIST
 SG_ RouteInfoChar_07 : 216|8@1+ (1,0) [0|255] "ascii" PARK_ASSIST
 SG_ RouteInfoChar_08 : 224|8@1+ (1,0) [0|255] "ascii" PARK_ASSIST
 SG_ RouteInfoChar_09 : 232|8@1+ (1,0) [0|255] "ascii" PARK_ASSIST
 SG_ RouteInfoChar_10 : 240|8@1+ (1,0) [0|255] "ascii" PARK_ASSIST
 SG_ RouteInfoChar_11 : 248|8@1+ (1,0) [0|255] "ascii" PARK_ASSIST
 SG_ RouteInfoChar_12 : 256|8@1+ (1,0) [0|255] "ascii" PARK_ASSIST
 SG_ RouteInfoChar_13 : 264|8@1+ (1,0) [0|255] "ascii" PARK_ASSIST
 SG_ RouteInfoChar_14 : 272|8@1+ (1,0) [0|255] "ascii" PARK_ASSIST
 SG_ RouteInfoChar_15 : 280|8@1+ (1,0) [0|255] "ascii" PARK_ASSIST
 SG_ RouteInfoChar_16 : 288|8@1+ (1,0) [0|255] "ascii" PARK_ASSIST
 SG_ RouteInfoChar_17 : 296|8@1+ (1,0) [0|255] "ascii" PARK_ASSIST
 SG_ RouteInfoChar_18 : 304|8@1+ (1,0) [0|255] "ascii" PARK_ASSIST
 SG_ RouteInfoChar_19 : 312|8@1+ (1,0) [0|255] "ascii" PARK_ASSIST
 SG_ RouteInfoChar_20 : 320|8@1+ (1,0) [0|255] "ascii" PARK_ASSIST
 SG_ RouteInfoChar_21 : 328|8@1+ (1,0) [0|255] "ascii" PARK_ASSIST
 SG_ RouteInfoChar_22 : 336|8@1+ (1,0) [0|255] "ascii" PARK_ASSIST
 SG_ RouteInfoChar_23 : 344|8@1+ (1,0) [0|255] "ascii" PARK_ASSIST
 SG_ RouteInfoChar_24 : 352|8@1+ (1,0) [0|255] "ascii" PARK_ASSIST
 SG_ RouteInfoChar_25 : 360|8@1+ (1,0) [0|255] "ascii" PARK_ASSIST
 SG_ RouteInfoChar_26 : 368|8@1+ (1,0) [0|255] "ascii" PARK_ASSIST
 SG_ RouteInfoChar_27 : 376|8@1+ (1,0) [0|255] "ascii" PARK_ASSIST
 SG_ RouteInfoChar_28 : 384|8@1+ (1,0) [0|255] "ascii" PARK_ASSIST
 SG_ RouteInfoChar_29 : 392|8@1+ (1,0) [0|255] "ascii" PARK_ASSIST
 SG_ RouteInfoChar_30 : 400|8@1+ (1,0) [0|255] "ascii" PARK_ASSIST
 SG_ RouteInfoChar_31 : 408|8@1+ (1,0) [0|255] "ascii" PARK_ASSIST
 SG_ RouteInfoChar_32 : 416|8@1+ (1,0) [0|255] "ascii" PARK_ASSIST
 SG_ RouteInfoChar_33 : 424|8@1+ (1,0) [0|255] "ascii" PARK_ASSIST
 SG_ RouteInfoChar_34 : 432|8@1+ (1,0) [0|255] "ascii" PARK_ASSIST
 SG_ RouteInfoChar_35 : 440|8@1+ (1,0) [0|255] "ascii" PARK_ASSIST
 SG_ RouteInfoChar_36 : 448|8@1+ (1,0) [0|255] "ascii" PARK_ASSIST
 SG_ RouteInfoChar_37 : 456|8@1+ (1,0) [0|255] "ascii" PARK_ASSIST
 SG_ RouteInfoChar_38 : 464|8@1+ (1,0) [0|255] "ascii" PARK_ASSIST
 SG_ RouteInfoChar_39 : 472|8@1+ (1,0) [0|255] "ascii" PARK_ASSIST
 SG_ RouteInfoChar_40 : 480|8@1+ (1,0) [0|255] "ascii" PARK_ASSIST
 SG_ RouteInfoChar_41 : 488|8@1+ (1,0) [0|255] "ascii" PARK_ASSIST
 SG_ RouteInfoChar_42 : 496|8@1+ (1,0) [0|255] "ascii" PARK_ASSIST
 SG_ RouteInfoChar_43 : 504|8@1+ (1,0) [0|255] "ascii" PARK_ASSIST

CM_ BO_ 356 "Cycle=40ms; Channel=CAN4; CAN-FD; NominalBitrate=500kbit/s; DataBitrate=5000kbit/s;  Data request; receiver answers with response frame; PayloadRouteInfo='ULTRASONIC_LEFT_CLUSTER -> PARK_ASSIST' in bytes 20-63;";

BO_ 1570 RESP_034_PARK_ASSIST_TO_ULTRASONIC_LEFT_CLUSTER: 16 PARK_ASSIST
 SG_ CRC8 : 0|8@1+ (1,0) [0|255] "" ULTRASONIC_LEFT_CLUSTER
 SG_ ResponseCounter : 8|4@1+ (1,0) [0|15] "" ULTRASONIC_LEFT_CLUSTER
 SG_ AckState : 12|4@1+ (1,0) [0|15] "" ULTRASONIC_LEFT_CLUSTER
 SG_ ReceivedFrameId : 16|11@1+ (1,0) [0|2047] "" ULTRASONIC_LEFT_CLUSTER
 SG_ ReceivedCounter : 27|4@1+ (1,0) [0|15] "" ULTRASONIC_LEFT_CLUSTER
 SG_ ChecksumOk : 31|1@1+ (1,0) [0|1] "" ULTRASONIC_LEFT_CLUSTER
 SG_ PayloadLength : 32|8@1+ (1,0) [0|64] "byte" ULTRASONIC_LEFT_CLUSTER
 SG_ ErrorCode : 40|8@1+ (1,0) [0|255] "" ULTRASONIC_LEFT_CLUSTER
 SG_ ProcessingTimeUs : 48|16@1+ (1,0) [0|65535] "us" ULTRASONIC_LEFT_CLUSTER
 SG_ ResponseSequence : 64|16@1+ (1,0) [0|65535] "" ULTRASONIC_LEFT_CLUSTER
 SG_ ReceivedCrc : 80|8@1+ (1,0) [0|255] "" ULTRASONIC_LEFT_CLUSTER
 SG_ CalculatedCrc : 88|8@1+ (1,0) [0|255] "" ULTRASONIC_LEFT_CLUSTER

CM_ BO_ 1570 "Cycle=40ms; Channel=CAN4; CAN-FD; NominalBitrate=500kbit/s; DataBitrate=5000kbit/s;  ResponseFor=0x164; ACK/NACK with CRC, DLC and counter check;";

BO_ 357 DATA_035_ULTRASONIC_RIGHT_DISTANCE: 64 ULTRASONIC_RIGHT_CLUSTER
 SG_ CRC8 : 0|8@1+ (1,0) [0|255] "" PARK_ASSIST
 SG_ AliveCounter : 8|4@1+ (1,0) [0|15] "" PARK_ASSIST
 SG_ MuxState : 12|4@1+ (1,0) [0|15] "" PARK_ASSIST
 SG_ SIG_165_00 : 16|12@1+ (0.1,0.0) [0|4095] "V" PARK_ASSIST
 SG_ SIG_165_01 : 28|12@1+ (0.1,0.0) [0|4095] "Nm" PARK_ASSIST
 SG_ SIG_165_02 : 40|12@1+ (0.1,0.0) [0|4095] "Nm" PARK_ASSIST
 SG_ SIG_165_03 : 52|12@1+ (0.1,0.0) [0|4095] "km/h" PARK_ASSIST
 SG_ SIG_165_04 : 64|12@1+ (0.1,0.0) [0|4095] "Nm" PARK_ASSIST
 SG_ SIG_165_05 : 76|12@1+ (0.1,0.0) [0|4095] "%" PARK_ASSIST
 SG_ SIG_165_06 : 88|12@1+ (0.1,0.0) [0|4095] "A" PARK_ASSIST
 SG_ SIG_165_07 : 100|12@1+ (0.1,0.0) [0|4095] "V" PARK_ASSIST
 SG_ SIG_165_08 : 112|12@1+ (0.1,0.0) [0|4095] "rpm" PARK_ASSIST
 SG_ SIG_165_09 : 124|12@1+ (0.1,0.0) [0|4095] "V" PARK_ASSIST
 SG_ SIG_165_10 : 136|12@1+ (0.1,0.0) [0|4095] "A" PARK_ASSIST
 SG_ SIG_165_11 : 148|12@1+ (0.1,0.0) [0|4095] "m" PARK_ASSIST
 SG_ RouteInfoChar_00 : 160|8@1+ (1,0) [0|255] "ascii" PARK_ASSIST
 SG_ RouteInfoChar_01 : 168|8@1+ (1,0) [0|255] "ascii" PARK_ASSIST
 SG_ RouteInfoChar_02 : 176|8@1+ (1,0) [0|255] "ascii" PARK_ASSIST
 SG_ RouteInfoChar_03 : 184|8@1+ (1,0) [0|255] "ascii" PARK_ASSIST
 SG_ RouteInfoChar_04 : 192|8@1+ (1,0) [0|255] "ascii" PARK_ASSIST
 SG_ RouteInfoChar_05 : 200|8@1+ (1,0) [0|255] "ascii" PARK_ASSIST
 SG_ RouteInfoChar_06 : 208|8@1+ (1,0) [0|255] "ascii" PARK_ASSIST
 SG_ RouteInfoChar_07 : 216|8@1+ (1,0) [0|255] "ascii" PARK_ASSIST
 SG_ RouteInfoChar_08 : 224|8@1+ (1,0) [0|255] "ascii" PARK_ASSIST
 SG_ RouteInfoChar_09 : 232|8@1+ (1,0) [0|255] "ascii" PARK_ASSIST
 SG_ RouteInfoChar_10 : 240|8@1+ (1,0) [0|255] "ascii" PARK_ASSIST
 SG_ RouteInfoChar_11 : 248|8@1+ (1,0) [0|255] "ascii" PARK_ASSIST
 SG_ RouteInfoChar_12 : 256|8@1+ (1,0) [0|255] "ascii" PARK_ASSIST
 SG_ RouteInfoChar_13 : 264|8@1+ (1,0) [0|255] "ascii" PARK_ASSIST
 SG_ RouteInfoChar_14 : 272|8@1+ (1,0) [0|255] "ascii" PARK_ASSIST
 SG_ RouteInfoChar_15 : 280|8@1+ (1,0) [0|255] "ascii" PARK_ASSIST
 SG_ RouteInfoChar_16 : 288|8@1+ (1,0) [0|255] "ascii" PARK_ASSIST
 SG_ RouteInfoChar_17 : 296|8@1+ (1,0) [0|255] "ascii" PARK_ASSIST
 SG_ RouteInfoChar_18 : 304|8@1+ (1,0) [0|255] "ascii" PARK_ASSIST
 SG_ RouteInfoChar_19 : 312|8@1+ (1,0) [0|255] "ascii" PARK_ASSIST
 SG_ RouteInfoChar_20 : 320|8@1+ (1,0) [0|255] "ascii" PARK_ASSIST
 SG_ RouteInfoChar_21 : 328|8@1+ (1,0) [0|255] "ascii" PARK_ASSIST
 SG_ RouteInfoChar_22 : 336|8@1+ (1,0) [0|255] "ascii" PARK_ASSIST
 SG_ RouteInfoChar_23 : 344|8@1+ (1,0) [0|255] "ascii" PARK_ASSIST
 SG_ RouteInfoChar_24 : 352|8@1+ (1,0) [0|255] "ascii" PARK_ASSIST
 SG_ RouteInfoChar_25 : 360|8@1+ (1,0) [0|255] "ascii" PARK_ASSIST
 SG_ RouteInfoChar_26 : 368|8@1+ (1,0) [0|255] "ascii" PARK_ASSIST
 SG_ RouteInfoChar_27 : 376|8@1+ (1,0) [0|255] "ascii" PARK_ASSIST
 SG_ RouteInfoChar_28 : 384|8@1+ (1,0) [0|255] "ascii" PARK_ASSIST
 SG_ RouteInfoChar_29 : 392|8@1+ (1,0) [0|255] "ascii" PARK_ASSIST
 SG_ RouteInfoChar_30 : 400|8@1+ (1,0) [0|255] "ascii" PARK_ASSIST
 SG_ RouteInfoChar_31 : 408|8@1+ (1,0) [0|255] "ascii" PARK_ASSIST
 SG_ RouteInfoChar_32 : 416|8@1+ (1,0) [0|255] "ascii" PARK_ASSIST
 SG_ RouteInfoChar_33 : 424|8@1+ (1,0) [0|255] "ascii" PARK_ASSIST
 SG_ RouteInfoChar_34 : 432|8@1+ (1,0) [0|255] "ascii" PARK_ASSIST
 SG_ RouteInfoChar_35 : 440|8@1+ (1,0) [0|255] "ascii" PARK_ASSIST
 SG_ RouteInfoChar_36 : 448|8@1+ (1,0) [0|255] "ascii" PARK_ASSIST
 SG_ RouteInfoChar_37 : 456|8@1+ (1,0) [0|255] "ascii" PARK_ASSIST
 SG_ RouteInfoChar_38 : 464|8@1+ (1,0) [0|255] "ascii" PARK_ASSIST
 SG_ RouteInfoChar_39 : 472|8@1+ (1,0) [0|255] "ascii" PARK_ASSIST
 SG_ RouteInfoChar_40 : 480|8@1+ (1,0) [0|255] "ascii" PARK_ASSIST
 SG_ RouteInfoChar_41 : 488|8@1+ (1,0) [0|255] "ascii" PARK_ASSIST
 SG_ RouteInfoChar_42 : 496|8@1+ (1,0) [0|255] "ascii" PARK_ASSIST
 SG_ RouteInfoChar_43 : 504|8@1+ (1,0) [0|255] "ascii" PARK_ASSIST

CM_ BO_ 357 "Cycle=40ms; Channel=CAN5; CAN-FD; NominalBitrate=500kbit/s; DataBitrate=5000kbit/s;  Data request; receiver answers with response frame; PayloadRouteInfo='ULTRASONIC_RIGHT_CLUSTER -> PARK_ASSIST' in bytes 20-63;";

BO_ 1571 RESP_035_PARK_ASSIST_TO_ULTRASONIC_RIGHT_CLUSTER: 16 PARK_ASSIST
 SG_ CRC8 : 0|8@1+ (1,0) [0|255] "" ULTRASONIC_RIGHT_CLUSTER
 SG_ ResponseCounter : 8|4@1+ (1,0) [0|15] "" ULTRASONIC_RIGHT_CLUSTER
 SG_ AckState : 12|4@1+ (1,0) [0|15] "" ULTRASONIC_RIGHT_CLUSTER
 SG_ ReceivedFrameId : 16|11@1+ (1,0) [0|2047] "" ULTRASONIC_RIGHT_CLUSTER
 SG_ ReceivedCounter : 27|4@1+ (1,0) [0|15] "" ULTRASONIC_RIGHT_CLUSTER
 SG_ ChecksumOk : 31|1@1+ (1,0) [0|1] "" ULTRASONIC_RIGHT_CLUSTER
 SG_ PayloadLength : 32|8@1+ (1,0) [0|64] "byte" ULTRASONIC_RIGHT_CLUSTER
 SG_ ErrorCode : 40|8@1+ (1,0) [0|255] "" ULTRASONIC_RIGHT_CLUSTER
 SG_ ProcessingTimeUs : 48|16@1+ (1,0) [0|65535] "us" ULTRASONIC_RIGHT_CLUSTER
 SG_ ResponseSequence : 64|16@1+ (1,0) [0|65535] "" ULTRASONIC_RIGHT_CLUSTER
 SG_ ReceivedCrc : 80|8@1+ (1,0) [0|255] "" ULTRASONIC_RIGHT_CLUSTER
 SG_ CalculatedCrc : 88|8@1+ (1,0) [0|255] "" ULTRASONIC_RIGHT_CLUSTER

CM_ BO_ 1571 "Cycle=40ms; Channel=CAN5; CAN-FD; NominalBitrate=500kbit/s; DataBitrate=5000kbit/s;  ResponseFor=0x165; ACK/NACK with CRC, DLC and counter check;";

BO_ 358 DATA_036_IMU_DYNAMICS: 64 IMU_YAW_RATE_SENSOR
 SG_ CRC8 : 0|8@1+ (1,0) [0|255] "" ADAS_DOMAIN
 SG_ AliveCounter : 8|4@1+ (1,0) [0|15] "" ADAS_DOMAIN
 SG_ MuxState : 12|4@1+ (1,0) [0|15] "" ADAS_DOMAIN
 SG_ SIG_166_00 : 16|12@1+ (0.1,0.0) [0|4095] "%" ADAS_DOMAIN
 SG_ SIG_166_01 : 28|12@1+ (0.1,0.0) [0|4095] "m" ADAS_DOMAIN
 SG_ SIG_166_02 : 40|12@1+ (0.1,0.0) [0|4095] "A" ADAS_DOMAIN
 SG_ SIG_166_03 : 52|12@1+ (0.1,0.0) [0|4095] "km/h" ADAS_DOMAIN
 SG_ SIG_166_04 : 64|12@1+ (0.1,0.0) [0|4095] "rpm" ADAS_DOMAIN
 SG_ SIG_166_05 : 76|12@1+ (0.1,0.0) [0|4095] "V" ADAS_DOMAIN
 SG_ SIG_166_06 : 88|12@1+ (0.1,0.0) [0|4095] "deg" ADAS_DOMAIN
 SG_ SIG_166_07 : 100|12@1+ (0.1,0.0) [0|4095] "obj" ADAS_DOMAIN
 SG_ SIG_166_08 : 112|12@1+ (0.1,0.0) [0|4095] "V" ADAS_DOMAIN
 SG_ SIG_166_09 : 124|12@1+ (0.1,0.0) [0|4095] "km/h" ADAS_DOMAIN
 SG_ SIG_166_10 : 136|12@1+ (0.1,0.0) [0|4095] "rpm" ADAS_DOMAIN
 SG_ SIG_166_11 : 148|12@1+ (0.1,0.0) [0|4095] "obj" ADAS_DOMAIN
 SG_ RouteInfoChar_00 : 160|8@1+ (1,0) [0|255] "ascii" ADAS_DOMAIN
 SG_ RouteInfoChar_01 : 168|8@1+ (1,0) [0|255] "ascii" ADAS_DOMAIN
 SG_ RouteInfoChar_02 : 176|8@1+ (1,0) [0|255] "ascii" ADAS_DOMAIN
 SG_ RouteInfoChar_03 : 184|8@1+ (1,0) [0|255] "ascii" ADAS_DOMAIN
 SG_ RouteInfoChar_04 : 192|8@1+ (1,0) [0|255] "ascii" ADAS_DOMAIN
 SG_ RouteInfoChar_05 : 200|8@1+ (1,0) [0|255] "ascii" ADAS_DOMAIN
 SG_ RouteInfoChar_06 : 208|8@1+ (1,0) [0|255] "ascii" ADAS_DOMAIN
 SG_ RouteInfoChar_07 : 216|8@1+ (1,0) [0|255] "ascii" ADAS_DOMAIN
 SG_ RouteInfoChar_08 : 224|8@1+ (1,0) [0|255] "ascii" ADAS_DOMAIN
 SG_ RouteInfoChar_09 : 232|8@1+ (1,0) [0|255] "ascii" ADAS_DOMAIN
 SG_ RouteInfoChar_10 : 240|8@1+ (1,0) [0|255] "ascii" ADAS_DOMAIN
 SG_ RouteInfoChar_11 : 248|8@1+ (1,0) [0|255] "ascii" ADAS_DOMAIN
 SG_ RouteInfoChar_12 : 256|8@1+ (1,0) [0|255] "ascii" ADAS_DOMAIN
 SG_ RouteInfoChar_13 : 264|8@1+ (1,0) [0|255] "ascii" ADAS_DOMAIN
 SG_ RouteInfoChar_14 : 272|8@1+ (1,0) [0|255] "ascii" ADAS_DOMAIN
 SG_ RouteInfoChar_15 : 280|8@1+ (1,0) [0|255] "ascii" ADAS_DOMAIN
 SG_ RouteInfoChar_16 : 288|8@1+ (1,0) [0|255] "ascii" ADAS_DOMAIN
 SG_ RouteInfoChar_17 : 296|8@1+ (1,0) [0|255] "ascii" ADAS_DOMAIN
 SG_ RouteInfoChar_18 : 304|8@1+ (1,0) [0|255] "ascii" ADAS_DOMAIN
 SG_ RouteInfoChar_19 : 312|8@1+ (1,0) [0|255] "ascii" ADAS_DOMAIN
 SG_ RouteInfoChar_20 : 320|8@1+ (1,0) [0|255] "ascii" ADAS_DOMAIN
 SG_ RouteInfoChar_21 : 328|8@1+ (1,0) [0|255] "ascii" ADAS_DOMAIN
 SG_ RouteInfoChar_22 : 336|8@1+ (1,0) [0|255] "ascii" ADAS_DOMAIN
 SG_ RouteInfoChar_23 : 344|8@1+ (1,0) [0|255] "ascii" ADAS_DOMAIN
 SG_ RouteInfoChar_24 : 352|8@1+ (1,0) [0|255] "ascii" ADAS_DOMAIN
 SG_ RouteInfoChar_25 : 360|8@1+ (1,0) [0|255] "ascii" ADAS_DOMAIN
 SG_ RouteInfoChar_26 : 368|8@1+ (1,0) [0|255] "ascii" ADAS_DOMAIN
 SG_ RouteInfoChar_27 : 376|8@1+ (1,0) [0|255] "ascii" ADAS_DOMAIN
 SG_ RouteInfoChar_28 : 384|8@1+ (1,0) [0|255] "ascii" ADAS_DOMAIN
 SG_ RouteInfoChar_29 : 392|8@1+ (1,0) [0|255] "ascii" ADAS_DOMAIN
 SG_ RouteInfoChar_30 : 400|8@1+ (1,0) [0|255] "ascii" ADAS_DOMAIN
 SG_ RouteInfoChar_31 : 408|8@1+ (1,0) [0|255] "ascii" ADAS_DOMAIN
 SG_ RouteInfoChar_32 : 416|8@1+ (1,0) [0|255] "ascii" ADAS_DOMAIN
 SG_ RouteInfoChar_33 : 424|8@1+ (1,0) [0|255] "ascii" ADAS_DOMAIN
 SG_ RouteInfoChar_34 : 432|8@1+ (1,0) [0|255] "ascii" ADAS_DOMAIN
 SG_ RouteInfoChar_35 : 440|8@1+ (1,0) [0|255] "ascii" ADAS_DOMAIN
 SG_ RouteInfoChar_36 : 448|8@1+ (1,0) [0|255] "ascii" ADAS_DOMAIN
 SG_ RouteInfoChar_37 : 456|8@1+ (1,0) [0|255] "ascii" ADAS_DOMAIN
 SG_ RouteInfoChar_38 : 464|8@1+ (1,0) [0|255] "ascii" ADAS_DOMAIN
 SG_ RouteInfoChar_39 : 472|8@1+ (1,0) [0|255] "ascii" ADAS_DOMAIN
 SG_ RouteInfoChar_40 : 480|8@1+ (1,0) [0|255] "ascii" ADAS_DOMAIN
 SG_ RouteInfoChar_41 : 488|8@1+ (1,0) [0|255] "ascii" ADAS_DOMAIN
 SG_ RouteInfoChar_42 : 496|8@1+ (1,0) [0|255] "ascii" ADAS_DOMAIN
 SG_ RouteInfoChar_43 : 504|8@1+ (1,0) [0|255] "ascii" ADAS_DOMAIN

CM_ BO_ 358 "Cycle=10ms; Channel=CAN6; CAN-FD; NominalBitrate=500kbit/s; DataBitrate=5000kbit/s;  Data request; receiver answers with response frame; PayloadRouteInfo='IMU_YAW_RATE_SENSOR -> ADAS_DOMAIN' in bytes 20-63;";

BO_ 1572 RESP_036_ADAS_DOMAIN_TO_IMU_YAW_RATE_SENSOR: 16 ADAS_DOMAIN
 SG_ CRC8 : 0|8@1+ (1,0) [0|255] "" IMU_YAW_RATE_SENSOR
 SG_ ResponseCounter : 8|4@1+ (1,0) [0|15] "" IMU_YAW_RATE_SENSOR
 SG_ AckState : 12|4@1+ (1,0) [0|15] "" IMU_YAW_RATE_SENSOR
 SG_ ReceivedFrameId : 16|11@1+ (1,0) [0|2047] "" IMU_YAW_RATE_SENSOR
 SG_ ReceivedCounter : 27|4@1+ (1,0) [0|15] "" IMU_YAW_RATE_SENSOR
 SG_ ChecksumOk : 31|1@1+ (1,0) [0|1] "" IMU_YAW_RATE_SENSOR
 SG_ PayloadLength : 32|8@1+ (1,0) [0|64] "byte" IMU_YAW_RATE_SENSOR
 SG_ ErrorCode : 40|8@1+ (1,0) [0|255] "" IMU_YAW_RATE_SENSOR
 SG_ ProcessingTimeUs : 48|16@1+ (1,0) [0|65535] "us" IMU_YAW_RATE_SENSOR
 SG_ ResponseSequence : 64|16@1+ (1,0) [0|65535] "" IMU_YAW_RATE_SENSOR
 SG_ ReceivedCrc : 80|8@1+ (1,0) [0|255] "" IMU_YAW_RATE_SENSOR
 SG_ CalculatedCrc : 88|8@1+ (1,0) [0|255] "" IMU_YAW_RATE_SENSOR

CM_ BO_ 1572 "Cycle=10ms; Channel=CAN6; CAN-FD; NominalBitrate=500kbit/s; DataBitrate=5000kbit/s;  ResponseFor=0x166; ACK/NACK with CRC, DLC and counter check;";

BO_ 359 DATA_037_WHEEL_SPEED_FL: 64 WHEEL_SPEED_FRONT_LEFT
 SG_ CRC8 : 0|8@1+ (1,0) [0|255] "" BRAKE_CONTROLLER
 SG_ AliveCounter : 8|4@1+ (1,0) [0|15] "" BRAKE_CONTROLLER
 SG_ MuxState : 12|4@1+ (1,0) [0|15] "" BRAKE_CONTROLLER
 SG_ SIG_167_00 : 16|12@1+ (0.1,0.0) [0|4095] "%" BRAKE_CONTROLLER
 SG_ SIG_167_01 : 28|12@1+ (0.1,0.0) [0|4095] "A" BRAKE_CONTROLLER
 SG_ SIG_167_02 : 40|12@1+ (0.1,0.0) [0|4095] "A" BRAKE_CONTROLLER
 SG_ SIG_167_03 : 52|12@1+ (0.1,0.0) [0|4095] "%" BRAKE_CONTROLLER
 SG_ SIG_167_04 : 64|12@1+ (0.1,0.0) [0|4095] "obj" BRAKE_CONTROLLER
 SG_ SIG_167_05 : 76|12@1+ (0.1,0.0) [0|4095] "m" BRAKE_CONTROLLER
 SG_ SIG_167_06 : 88|12@1+ (0.1,0.0) [0|4095] "rpm" BRAKE_CONTROLLER
 SG_ SIG_167_07 : 100|12@1+ (0.1,0.0) [0|4095] "%" BRAKE_CONTROLLER
 SG_ SIG_167_08 : 112|12@1+ (0.1,0.0) [0|4095] "obj" BRAKE_CONTROLLER
 SG_ SIG_167_09 : 124|12@1+ (0.1,0.0) [0|4095] "Nm" BRAKE_CONTROLLER
 SG_ SIG_167_10 : 136|12@1+ (0.1,0.0) [0|4095] "V" BRAKE_CONTROLLER
 SG_ SIG_167_11 : 148|12@1+ (0.1,0.0) [0|4095] "km/h" BRAKE_CONTROLLER
 SG_ RouteInfoChar_00 : 160|8@1+ (1,0) [0|255] "ascii" BRAKE_CONTROLLER
 SG_ RouteInfoChar_01 : 168|8@1+ (1,0) [0|255] "ascii" BRAKE_CONTROLLER
 SG_ RouteInfoChar_02 : 176|8@1+ (1,0) [0|255] "ascii" BRAKE_CONTROLLER
 SG_ RouteInfoChar_03 : 184|8@1+ (1,0) [0|255] "ascii" BRAKE_CONTROLLER
 SG_ RouteInfoChar_04 : 192|8@1+ (1,0) [0|255] "ascii" BRAKE_CONTROLLER
 SG_ RouteInfoChar_05 : 200|8@1+ (1,0) [0|255] "ascii" BRAKE_CONTROLLER
 SG_ RouteInfoChar_06 : 208|8@1+ (1,0) [0|255] "ascii" BRAKE_CONTROLLER
 SG_ RouteInfoChar_07 : 216|8@1+ (1,0) [0|255] "ascii" BRAKE_CONTROLLER
 SG_ RouteInfoChar_08 : 224|8@1+ (1,0) [0|255] "ascii" BRAKE_CONTROLLER
 SG_ RouteInfoChar_09 : 232|8@1+ (1,0) [0|255] "ascii" BRAKE_CONTROLLER
 SG_ RouteInfoChar_10 : 240|8@1+ (1,0) [0|255] "ascii" BRAKE_CONTROLLER
 SG_ RouteInfoChar_11 : 248|8@1+ (1,0) [0|255] "ascii" BRAKE_CONTROLLER
 SG_ RouteInfoChar_12 : 256|8@1+ (1,0) [0|255] "ascii" BRAKE_CONTROLLER
 SG_ RouteInfoChar_13 : 264|8@1+ (1,0) [0|255] "ascii" BRAKE_CONTROLLER
 SG_ RouteInfoChar_14 : 272|8@1+ (1,0) [0|255] "ascii" BRAKE_CONTROLLER
 SG_ RouteInfoChar_15 : 280|8@1+ (1,0) [0|255] "ascii" BRAKE_CONTROLLER
 SG_ RouteInfoChar_16 : 288|8@1+ (1,0) [0|255] "ascii" BRAKE_CONTROLLER
 SG_ RouteInfoChar_17 : 296|8@1+ (1,0) [0|255] "ascii" BRAKE_CONTROLLER
 SG_ RouteInfoChar_18 : 304|8@1+ (1,0) [0|255] "ascii" BRAKE_CONTROLLER
 SG_ RouteInfoChar_19 : 312|8@1+ (1,0) [0|255] "ascii" BRAKE_CONTROLLER
 SG_ RouteInfoChar_20 : 320|8@1+ (1,0) [0|255] "ascii" BRAKE_CONTROLLER
 SG_ RouteInfoChar_21 : 328|8@1+ (1,0) [0|255] "ascii" BRAKE_CONTROLLER
 SG_ RouteInfoChar_22 : 336|8@1+ (1,0) [0|255] "ascii" BRAKE_CONTROLLER
 SG_ RouteInfoChar_23 : 344|8@1+ (1,0) [0|255] "ascii" BRAKE_CONTROLLER
 SG_ RouteInfoChar_24 : 352|8@1+ (1,0) [0|255] "ascii" BRAKE_CONTROLLER
 SG_ RouteInfoChar_25 : 360|8@1+ (1,0) [0|255] "ascii" BRAKE_CONTROLLER
 SG_ RouteInfoChar_26 : 368|8@1+ (1,0) [0|255] "ascii" BRAKE_CONTROLLER
 SG_ RouteInfoChar_27 : 376|8@1+ (1,0) [0|255] "ascii" BRAKE_CONTROLLER
 SG_ RouteInfoChar_28 : 384|8@1+ (1,0) [0|255] "ascii" BRAKE_CONTROLLER
 SG_ RouteInfoChar_29 : 392|8@1+ (1,0) [0|255] "ascii" BRAKE_CONTROLLER
 SG_ RouteInfoChar_30 : 400|8@1+ (1,0) [0|255] "ascii" BRAKE_CONTROLLER
 SG_ RouteInfoChar_31 : 408|8@1+ (1,0) [0|255] "ascii" BRAKE_CONTROLLER
 SG_ RouteInfoChar_32 : 416|8@1+ (1,0) [0|255] "ascii" BRAKE_CONTROLLER
 SG_ RouteInfoChar_33 : 424|8@1+ (1,0) [0|255] "ascii" BRAKE_CONTROLLER
 SG_ RouteInfoChar_34 : 432|8@1+ (1,0) [0|255] "ascii" BRAKE_CONTROLLER
 SG_ RouteInfoChar_35 : 440|8@1+ (1,0) [0|255] "ascii" BRAKE_CONTROLLER
 SG_ RouteInfoChar_36 : 448|8@1+ (1,0) [0|255] "ascii" BRAKE_CONTROLLER
 SG_ RouteInfoChar_37 : 456|8@1+ (1,0) [0|255] "ascii" BRAKE_CONTROLLER
 SG_ RouteInfoChar_38 : 464|8@1+ (1,0) [0|255] "ascii" BRAKE_CONTROLLER
 SG_ RouteInfoChar_39 : 472|8@1+ (1,0) [0|255] "ascii" BRAKE_CONTROLLER
 SG_ RouteInfoChar_40 : 480|8@1+ (1,0) [0|255] "ascii" BRAKE_CONTROLLER
 SG_ RouteInfoChar_41 : 488|8@1+ (1,0) [0|255] "ascii" BRAKE_CONTROLLER
 SG_ RouteInfoChar_42 : 496|8@1+ (1,0) [0|255] "ascii" BRAKE_CONTROLLER
 SG_ RouteInfoChar_43 : 504|8@1+ (1,0) [0|255] "ascii" BRAKE_CONTROLLER

CM_ BO_ 359 "Cycle=10ms; Channel=CAN7; CAN-FD; NominalBitrate=500kbit/s; DataBitrate=5000kbit/s;  Data request; receiver answers with response frame; PayloadRouteInfo='WHEEL_SPEED_FRONT_LEFT -> BRAKE_CONTROLLER' in bytes 20-63;";

BO_ 1573 RESP_037_BRAKE_CONTROLLER_TO_WHEEL_SPEED_FRONT_LEFT: 16 BRAKE_CONTROLLER
 SG_ CRC8 : 0|8@1+ (1,0) [0|255] "" WHEEL_SPEED_FRONT_LEFT
 SG_ ResponseCounter : 8|4@1+ (1,0) [0|15] "" WHEEL_SPEED_FRONT_LEFT
 SG_ AckState : 12|4@1+ (1,0) [0|15] "" WHEEL_SPEED_FRONT_LEFT
 SG_ ReceivedFrameId : 16|11@1+ (1,0) [0|2047] "" WHEEL_SPEED_FRONT_LEFT
 SG_ ReceivedCounter : 27|4@1+ (1,0) [0|15] "" WHEEL_SPEED_FRONT_LEFT
 SG_ ChecksumOk : 31|1@1+ (1,0) [0|1] "" WHEEL_SPEED_FRONT_LEFT
 SG_ PayloadLength : 32|8@1+ (1,0) [0|64] "byte" WHEEL_SPEED_FRONT_LEFT
 SG_ ErrorCode : 40|8@1+ (1,0) [0|255] "" WHEEL_SPEED_FRONT_LEFT
 SG_ ProcessingTimeUs : 48|16@1+ (1,0) [0|65535] "us" WHEEL_SPEED_FRONT_LEFT
 SG_ ResponseSequence : 64|16@1+ (1,0) [0|65535] "" WHEEL_SPEED_FRONT_LEFT
 SG_ ReceivedCrc : 80|8@1+ (1,0) [0|255] "" WHEEL_SPEED_FRONT_LEFT
 SG_ CalculatedCrc : 88|8@1+ (1,0) [0|255] "" WHEEL_SPEED_FRONT_LEFT

CM_ BO_ 1573 "Cycle=10ms; Channel=CAN7; CAN-FD; NominalBitrate=500kbit/s; DataBitrate=5000kbit/s;  ResponseFor=0x167; ACK/NACK with CRC, DLC and counter check;";

BO_ 360 DATA_038_BRAKE_STATUS: 64 BRAKE_CONTROLLER
 SG_ CRC8 : 0|8@1+ (1,0) [0|255] "" ADAS_DOMAIN
 SG_ AliveCounter : 8|4@1+ (1,0) [0|15] "" ADAS_DOMAIN
 SG_ MuxState : 12|4@1+ (1,0) [0|15] "" ADAS_DOMAIN
 SG_ SIG_168_00 : 16|12@1+ (0.1,0.0) [0|4095] "%" ADAS_DOMAIN
 SG_ SIG_168_01 : 28|12@1+ (0.1,0.0) [0|4095] "km/h" ADAS_DOMAIN
 SG_ SIG_168_02 : 40|12@1+ (0.1,0.0) [0|4095] "m" ADAS_DOMAIN
 SG_ SIG_168_03 : 52|12@1+ (0.1,0.0) [0|4095] "m" ADAS_DOMAIN
 SG_ SIG_168_04 : 64|12@1+ (0.1,0.0) [0|4095] "Nm" ADAS_DOMAIN
 SG_ SIG_168_05 : 76|12@1+ (0.1,0.0) [0|4095] "A" ADAS_DOMAIN
 SG_ SIG_168_06 : 88|12@1+ (0.1,0.0) [0|4095] "%" ADAS_DOMAIN
 SG_ SIG_168_07 : 100|12@1+ (0.1,0.0) [0|4095] "rpm" ADAS_DOMAIN
 SG_ SIG_168_08 : 112|12@1+ (0.1,0.0) [0|4095] "A" ADAS_DOMAIN
 SG_ SIG_168_09 : 124|12@1+ (0.1,0.0) [0|4095] "obj" ADAS_DOMAIN
 SG_ SIG_168_10 : 136|12@1+ (0.1,0.0) [0|4095] "A" ADAS_DOMAIN
 SG_ SIG_168_11 : 148|12@1+ (0.1,0.0) [0|4095] "rpm" ADAS_DOMAIN
 SG_ RouteInfoChar_00 : 160|8@1+ (1,0) [0|255] "ascii" ADAS_DOMAIN
 SG_ RouteInfoChar_01 : 168|8@1+ (1,0) [0|255] "ascii" ADAS_DOMAIN
 SG_ RouteInfoChar_02 : 176|8@1+ (1,0) [0|255] "ascii" ADAS_DOMAIN
 SG_ RouteInfoChar_03 : 184|8@1+ (1,0) [0|255] "ascii" ADAS_DOMAIN
 SG_ RouteInfoChar_04 : 192|8@1+ (1,0) [0|255] "ascii" ADAS_DOMAIN
 SG_ RouteInfoChar_05 : 200|8@1+ (1,0) [0|255] "ascii" ADAS_DOMAIN
 SG_ RouteInfoChar_06 : 208|8@1+ (1,0) [0|255] "ascii" ADAS_DOMAIN
 SG_ RouteInfoChar_07 : 216|8@1+ (1,0) [0|255] "ascii" ADAS_DOMAIN
 SG_ RouteInfoChar_08 : 224|8@1+ (1,0) [0|255] "ascii" ADAS_DOMAIN
 SG_ RouteInfoChar_09 : 232|8@1+ (1,0) [0|255] "ascii" ADAS_DOMAIN
 SG_ RouteInfoChar_10 : 240|8@1+ (1,0) [0|255] "ascii" ADAS_DOMAIN
 SG_ RouteInfoChar_11 : 248|8@1+ (1,0) [0|255] "ascii" ADAS_DOMAIN
 SG_ RouteInfoChar_12 : 256|8@1+ (1,0) [0|255] "ascii" ADAS_DOMAIN
 SG_ RouteInfoChar_13 : 264|8@1+ (1,0) [0|255] "ascii" ADAS_DOMAIN
 SG_ RouteInfoChar_14 : 272|8@1+ (1,0) [0|255] "ascii" ADAS_DOMAIN
 SG_ RouteInfoChar_15 : 280|8@1+ (1,0) [0|255] "ascii" ADAS_DOMAIN
 SG_ RouteInfoChar_16 : 288|8@1+ (1,0) [0|255] "ascii" ADAS_DOMAIN
 SG_ RouteInfoChar_17 : 296|8@1+ (1,0) [0|255] "ascii" ADAS_DOMAIN
 SG_ RouteInfoChar_18 : 304|8@1+ (1,0) [0|255] "ascii" ADAS_DOMAIN
 SG_ RouteInfoChar_19 : 312|8@1+ (1,0) [0|255] "ascii" ADAS_DOMAIN
 SG_ RouteInfoChar_20 : 320|8@1+ (1,0) [0|255] "ascii" ADAS_DOMAIN
 SG_ RouteInfoChar_21 : 328|8@1+ (1,0) [0|255] "ascii" ADAS_DOMAIN
 SG_ RouteInfoChar_22 : 336|8@1+ (1,0) [0|255] "ascii" ADAS_DOMAIN
 SG_ RouteInfoChar_23 : 344|8@1+ (1,0) [0|255] "ascii" ADAS_DOMAIN
 SG_ RouteInfoChar_24 : 352|8@1+ (1,0) [0|255] "ascii" ADAS_DOMAIN
 SG_ RouteInfoChar_25 : 360|8@1+ (1,0) [0|255] "ascii" ADAS_DOMAIN
 SG_ RouteInfoChar_26 : 368|8@1+ (1,0) [0|255] "ascii" ADAS_DOMAIN
 SG_ RouteInfoChar_27 : 376|8@1+ (1,0) [0|255] "ascii" ADAS_DOMAIN
 SG_ RouteInfoChar_28 : 384|8@1+ (1,0) [0|255] "ascii" ADAS_DOMAIN
 SG_ RouteInfoChar_29 : 392|8@1+ (1,0) [0|255] "ascii" ADAS_DOMAIN
 SG_ RouteInfoChar_30 : 400|8@1+ (1,0) [0|255] "ascii" ADAS_DOMAIN
 SG_ RouteInfoChar_31 : 408|8@1+ (1,0) [0|255] "ascii" ADAS_DOMAIN
 SG_ RouteInfoChar_32 : 416|8@1+ (1,0) [0|255] "ascii" ADAS_DOMAIN
 SG_ RouteInfoChar_33 : 424|8@1+ (1,0) [0|255] "ascii" ADAS_DOMAIN
 SG_ RouteInfoChar_34 : 432|8@1+ (1,0) [0|255] "ascii" ADAS_DOMAIN
 SG_ RouteInfoChar_35 : 440|8@1+ (1,0) [0|255] "ascii" ADAS_DOMAIN
 SG_ RouteInfoChar_36 : 448|8@1+ (1,0) [0|255] "ascii" ADAS_DOMAIN
 SG_ RouteInfoChar_37 : 456|8@1+ (1,0) [0|255] "ascii" ADAS_DOMAIN
 SG_ RouteInfoChar_38 : 464|8@1+ (1,0) [0|255] "ascii" ADAS_DOMAIN
 SG_ RouteInfoChar_39 : 472|8@1+ (1,0) [0|255] "ascii" ADAS_DOMAIN
 SG_ RouteInfoChar_40 : 480|8@1+ (1,0) [0|255] "ascii" ADAS_DOMAIN
 SG_ RouteInfoChar_41 : 488|8@1+ (1,0) [0|255] "ascii" ADAS_DOMAIN
 SG_ RouteInfoChar_42 : 496|8@1+ (1,0) [0|255] "ascii" ADAS_DOMAIN
 SG_ RouteInfoChar_43 : 504|8@1+ (1,0) [0|255] "ascii" ADAS_DOMAIN

CM_ BO_ 360 "Cycle=20ms; Channel=CAN8; CAN-FD; NominalBitrate=500kbit/s; DataBitrate=5000kbit/s;  Data request; receiver answers with response frame; PayloadRouteInfo='BRAKE_CONTROLLER -> ADAS_DOMAIN' in bytes 20-63;";

BO_ 1574 RESP_038_ADAS_DOMAIN_TO_BRAKE_CONTROLLER: 16 ADAS_DOMAIN
 SG_ CRC8 : 0|8@1+ (1,0) [0|255] "" BRAKE_CONTROLLER
 SG_ ResponseCounter : 8|4@1+ (1,0) [0|15] "" BRAKE_CONTROLLER
 SG_ AckState : 12|4@1+ (1,0) [0|15] "" BRAKE_CONTROLLER
 SG_ ReceivedFrameId : 16|11@1+ (1,0) [0|2047] "" BRAKE_CONTROLLER
 SG_ ReceivedCounter : 27|4@1+ (1,0) [0|15] "" BRAKE_CONTROLLER
 SG_ ChecksumOk : 31|1@1+ (1,0) [0|1] "" BRAKE_CONTROLLER
 SG_ PayloadLength : 32|8@1+ (1,0) [0|64] "byte" BRAKE_CONTROLLER
 SG_ ErrorCode : 40|8@1+ (1,0) [0|255] "" BRAKE_CONTROLLER
 SG_ ProcessingTimeUs : 48|16@1+ (1,0) [0|65535] "us" BRAKE_CONTROLLER
 SG_ ResponseSequence : 64|16@1+ (1,0) [0|65535] "" BRAKE_CONTROLLER
 SG_ ReceivedCrc : 80|8@1+ (1,0) [0|255] "" BRAKE_CONTROLLER
 SG_ CalculatedCrc : 88|8@1+ (1,0) [0|255] "" BRAKE_CONTROLLER

CM_ BO_ 1574 "Cycle=20ms; Channel=CAN8; CAN-FD; NominalBitrate=500kbit/s; DataBitrate=5000kbit/s;  ResponseFor=0x168; ACK/NACK with CRC, DLC and counter check;";

BO_ 361 DATA_039_ADAS_MOTION_REQUEST: 64 ADAS_DOMAIN
 SG_ CRC8 : 0|8@1+ (1,0) [0|255] "" VEHICLE_MOTION_CONTROLLER
 SG_ AliveCounter : 8|4@1+ (1,0) [0|15] "" VEHICLE_MOTION_CONTROLLER
 SG_ MuxState : 12|4@1+ (1,0) [0|15] "" VEHICLE_MOTION_CONTROLLER
 SG_ SIG_169_00 : 16|12@1+ (0.1,0.0) [0|4095] "V" VEHICLE_MOTION_CONTROLLER
 SG_ SIG_169_01 : 28|12@1+ (0.1,0.0) [0|4095] "m" VEHICLE_MOTION_CONTROLLER
 SG_ SIG_169_02 : 40|12@1+ (0.1,0.0) [0|4095] "V" VEHICLE_MOTION_CONTROLLER
 SG_ SIG_169_03 : 52|12@1+ (0.1,0.0) [0|4095] "%" VEHICLE_MOTION_CONTROLLER
 SG_ SIG_169_04 : 64|12@1+ (0.1,0.0) [0|4095] "A" VEHICLE_MOTION_CONTROLLER
 SG_ SIG_169_05 : 76|12@1+ (0.1,0.0) [0|4095] "%" VEHICLE_MOTION_CONTROLLER
 SG_ SIG_169_06 : 88|12@1+ (0.1,0.0) [0|4095] "V" VEHICLE_MOTION_CONTROLLER
 SG_ SIG_169_07 : 100|12@1+ (0.1,0.0) [0|4095] "m" VEHICLE_MOTION_CONTROLLER
 SG_ SIG_169_08 : 112|12@1+ (0.1,0.0) [0|4095] "deg" VEHICLE_MOTION_CONTROLLER
 SG_ SIG_169_09 : 124|12@1+ (0.1,0.0) [0|4095] "Nm" VEHICLE_MOTION_CONTROLLER
 SG_ SIG_169_10 : 136|12@1+ (0.1,0.0) [0|4095] "%" VEHICLE_MOTION_CONTROLLER
 SG_ SIG_169_11 : 148|12@1+ (0.1,0.0) [0|4095] "%" VEHICLE_MOTION_CONTROLLER
 SG_ RouteInfoChar_00 : 160|8@1+ (1,0) [0|255] "ascii" VEHICLE_MOTION_CONTROLLER
 SG_ RouteInfoChar_01 : 168|8@1+ (1,0) [0|255] "ascii" VEHICLE_MOTION_CONTROLLER
 SG_ RouteInfoChar_02 : 176|8@1+ (1,0) [0|255] "ascii" VEHICLE_MOTION_CONTROLLER
 SG_ RouteInfoChar_03 : 184|8@1+ (1,0) [0|255] "ascii" VEHICLE_MOTION_CONTROLLER
 SG_ RouteInfoChar_04 : 192|8@1+ (1,0) [0|255] "ascii" VEHICLE_MOTION_CONTROLLER
 SG_ RouteInfoChar_05 : 200|8@1+ (1,0) [0|255] "ascii" VEHICLE_MOTION_CONTROLLER
 SG_ RouteInfoChar_06 : 208|8@1+ (1,0) [0|255] "ascii" VEHICLE_MOTION_CONTROLLER
 SG_ RouteInfoChar_07 : 216|8@1+ (1,0) [0|255] "ascii" VEHICLE_MOTION_CONTROLLER
 SG_ RouteInfoChar_08 : 224|8@1+ (1,0) [0|255] "ascii" VEHICLE_MOTION_CONTROLLER
 SG_ RouteInfoChar_09 : 232|8@1+ (1,0) [0|255] "ascii" VEHICLE_MOTION_CONTROLLER
 SG_ RouteInfoChar_10 : 240|8@1+ (1,0) [0|255] "ascii" VEHICLE_MOTION_CONTROLLER
 SG_ RouteInfoChar_11 : 248|8@1+ (1,0) [0|255] "ascii" VEHICLE_MOTION_CONTROLLER
 SG_ RouteInfoChar_12 : 256|8@1+ (1,0) [0|255] "ascii" VEHICLE_MOTION_CONTROLLER
 SG_ RouteInfoChar_13 : 264|8@1+ (1,0) [0|255] "ascii" VEHICLE_MOTION_CONTROLLER
 SG_ RouteInfoChar_14 : 272|8@1+ (1,0) [0|255] "ascii" VEHICLE_MOTION_CONTROLLER
 SG_ RouteInfoChar_15 : 280|8@1+ (1,0) [0|255] "ascii" VEHICLE_MOTION_CONTROLLER
 SG_ RouteInfoChar_16 : 288|8@1+ (1,0) [0|255] "ascii" VEHICLE_MOTION_CONTROLLER
 SG_ RouteInfoChar_17 : 296|8@1+ (1,0) [0|255] "ascii" VEHICLE_MOTION_CONTROLLER
 SG_ RouteInfoChar_18 : 304|8@1+ (1,0) [0|255] "ascii" VEHICLE_MOTION_CONTROLLER
 SG_ RouteInfoChar_19 : 312|8@1+ (1,0) [0|255] "ascii" VEHICLE_MOTION_CONTROLLER
 SG_ RouteInfoChar_20 : 320|8@1+ (1,0) [0|255] "ascii" VEHICLE_MOTION_CONTROLLER
 SG_ RouteInfoChar_21 : 328|8@1+ (1,0) [0|255] "ascii" VEHICLE_MOTION_CONTROLLER
 SG_ RouteInfoChar_22 : 336|8@1+ (1,0) [0|255] "ascii" VEHICLE_MOTION_CONTROLLER
 SG_ RouteInfoChar_23 : 344|8@1+ (1,0) [0|255] "ascii" VEHICLE_MOTION_CONTROLLER
 SG_ RouteInfoChar_24 : 352|8@1+ (1,0) [0|255] "ascii" VEHICLE_MOTION_CONTROLLER
 SG_ RouteInfoChar_25 : 360|8@1+ (1,0) [0|255] "ascii" VEHICLE_MOTION_CONTROLLER
 SG_ RouteInfoChar_26 : 368|8@1+ (1,0) [0|255] "ascii" VEHICLE_MOTION_CONTROLLER
 SG_ RouteInfoChar_27 : 376|8@1+ (1,0) [0|255] "ascii" VEHICLE_MOTION_CONTROLLER
 SG_ RouteInfoChar_28 : 384|8@1+ (1,0) [0|255] "ascii" VEHICLE_MOTION_CONTROLLER
 SG_ RouteInfoChar_29 : 392|8@1+ (1,0) [0|255] "ascii" VEHICLE_MOTION_CONTROLLER
 SG_ RouteInfoChar_30 : 400|8@1+ (1,0) [0|255] "ascii" VEHICLE_MOTION_CONTROLLER
 SG_ RouteInfoChar_31 : 408|8@1+ (1,0) [0|255] "ascii" VEHICLE_MOTION_CONTROLLER
 SG_ RouteInfoChar_32 : 416|8@1+ (1,0) [0|255] "ascii" VEHICLE_MOTION_CONTROLLER
 SG_ RouteInfoChar_33 : 424|8@1+ (1,0) [0|255] "ascii" VEHICLE_MOTION_CONTROLLER
 SG_ RouteInfoChar_34 : 432|8@1+ (1,0) [0|255] "ascii" VEHICLE_MOTION_CONTROLLER
 SG_ RouteInfoChar_35 : 440|8@1+ (1,0) [0|255] "ascii" VEHICLE_MOTION_CONTROLLER
 SG_ RouteInfoChar_36 : 448|8@1+ (1,0) [0|255] "ascii" VEHICLE_MOTION_CONTROLLER
 SG_ RouteInfoChar_37 : 456|8@1+ (1,0) [0|255] "ascii" VEHICLE_MOTION_CONTROLLER
 SG_ RouteInfoChar_38 : 464|8@1+ (1,0) [0|255] "ascii" VEHICLE_MOTION_CONTROLLER
 SG_ RouteInfoChar_39 : 472|8@1+ (1,0) [0|255] "ascii" VEHICLE_MOTION_CONTROLLER
 SG_ RouteInfoChar_40 : 480|8@1+ (1,0) [0|255] "ascii" VEHICLE_MOTION_CONTROLLER
 SG_ RouteInfoChar_41 : 488|8@1+ (1,0) [0|255] "ascii" VEHICLE_MOTION_CONTROLLER
 SG_ RouteInfoChar_42 : 496|8@1+ (1,0) [0|255] "ascii" VEHICLE_MOTION_CONTROLLER
 SG_ RouteInfoChar_43 : 504|8@1+ (1,0) [0|255] "ascii" VEHICLE_MOTION_CONTROLLER

CM_ BO_ 361 "Cycle=20ms; Channel=CAN9; CAN-FD; NominalBitrate=500kbit/s; DataBitrate=5000kbit/s;  Data request; receiver answers with response frame; PayloadRouteInfo='ADAS_DOMAIN -> VEHICLE_MOTION_CONTROLLER' in bytes 20-63;";

BO_ 1575 RESP_039_VEHICLE_MOTION_CONTROLLER_TO_ADAS_DOMAIN: 16 VEHICLE_MOTION_CONTROLLER
 SG_ CRC8 : 0|8@1+ (1,0) [0|255] "" ADAS_DOMAIN
 SG_ ResponseCounter : 8|4@1+ (1,0) [0|15] "" ADAS_DOMAIN
 SG_ AckState : 12|4@1+ (1,0) [0|15] "" ADAS_DOMAIN
 SG_ ReceivedFrameId : 16|11@1+ (1,0) [0|2047] "" ADAS_DOMAIN
 SG_ ReceivedCounter : 27|4@1+ (1,0) [0|15] "" ADAS_DOMAIN
 SG_ ChecksumOk : 31|1@1+ (1,0) [0|1] "" ADAS_DOMAIN
 SG_ PayloadLength : 32|8@1+ (1,0) [0|64] "byte" ADAS_DOMAIN
 SG_ ErrorCode : 40|8@1+ (1,0) [0|255] "" ADAS_DOMAIN
 SG_ ProcessingTimeUs : 48|16@1+ (1,0) [0|65535] "us" ADAS_DOMAIN
 SG_ ResponseSequence : 64|16@1+ (1,0) [0|65535] "" ADAS_DOMAIN
 SG_ ReceivedCrc : 80|8@1+ (1,0) [0|255] "" ADAS_DOMAIN
 SG_ CalculatedCrc : 88|8@1+ (1,0) [0|255] "" ADAS_DOMAIN

CM_ BO_ 1575 "Cycle=20ms; Channel=CAN9; CAN-FD; NominalBitrate=500kbit/s; DataBitrate=5000kbit/s;  ResponseFor=0x169; ACK/NACK with CRC, DLC and counter check;";

BO_ 384 DATA_040_LIDAR_OBJECT_LIST: 64 LIDAR_FRONT
 SG_ CRC8 : 0|8@1+ (1,0) [0|255] "" ADAS_DOMAIN
 SG_ AliveCounter : 8|4@1+ (1,0) [0|15] "" ADAS_DOMAIN
 SG_ MuxState : 12|4@1+ (1,0) [0|15] "" ADAS_DOMAIN
 SG_ SIG_180_00 : 16|12@1+ (0.1,0.0) [0|4095] "deg" ADAS_DOMAIN
 SG_ SIG_180_01 : 28|12@1+ (0.1,0.0) [0|4095] "obj" ADAS_DOMAIN
 SG_ SIG_180_02 : 40|12@1+ (0.1,0.0) [0|4095] "obj" ADAS_DOMAIN
 SG_ SIG_180_03 : 52|12@1+ (0.1,0.0) [0|4095] "V" ADAS_DOMAIN
 SG_ SIG_180_04 : 64|12@1+ (0.1,0.0) [0|4095] "%" ADAS_DOMAIN
 SG_ SIG_180_05 : 76|12@1+ (0.1,0.0) [0|4095] "m" ADAS_DOMAIN
 SG_ SIG_180_06 : 88|12@1+ (0.1,0.0) [0|4095] "km/h" ADAS_DOMAIN
 SG_ SIG_180_07 : 100|12@1+ (0.1,0.0) [0|4095] "V" ADAS_DOMAIN
 SG_ SIG_180_08 : 112|12@1+ (0.1,0.0) [0|4095] "V" ADAS_DOMAIN
 SG_ SIG_180_09 : 124|12@1+ (0.1,0.0) [0|4095] "Nm" ADAS_DOMAIN
 SG_ SIG_180_10 : 136|12@1+ (0.1,0.0) [0|4095] "%" ADAS_DOMAIN
 SG_ SIG_180_11 : 148|12@1+ (0.1,0.0) [0|4095] "obj" ADAS_DOMAIN
 SG_ RouteInfoChar_00 : 160|8@1+ (1,0) [0|255] "ascii" ADAS_DOMAIN
 SG_ RouteInfoChar_01 : 168|8@1+ (1,0) [0|255] "ascii" ADAS_DOMAIN
 SG_ RouteInfoChar_02 : 176|8@1+ (1,0) [0|255] "ascii" ADAS_DOMAIN
 SG_ RouteInfoChar_03 : 184|8@1+ (1,0) [0|255] "ascii" ADAS_DOMAIN
 SG_ RouteInfoChar_04 : 192|8@1+ (1,0) [0|255] "ascii" ADAS_DOMAIN
 SG_ RouteInfoChar_05 : 200|8@1+ (1,0) [0|255] "ascii" ADAS_DOMAIN
 SG_ RouteInfoChar_06 : 208|8@1+ (1,0) [0|255] "ascii" ADAS_DOMAIN
 SG_ RouteInfoChar_07 : 216|8@1+ (1,0) [0|255] "ascii" ADAS_DOMAIN
 SG_ RouteInfoChar_08 : 224|8@1+ (1,0) [0|255] "ascii" ADAS_DOMAIN
 SG_ RouteInfoChar_09 : 232|8@1+ (1,0) [0|255] "ascii" ADAS_DOMAIN
 SG_ RouteInfoChar_10 : 240|8@1+ (1,0) [0|255] "ascii" ADAS_DOMAIN
 SG_ RouteInfoChar_11 : 248|8@1+ (1,0) [0|255] "ascii" ADAS_DOMAIN
 SG_ RouteInfoChar_12 : 256|8@1+ (1,0) [0|255] "ascii" ADAS_DOMAIN
 SG_ RouteInfoChar_13 : 264|8@1+ (1,0) [0|255] "ascii" ADAS_DOMAIN
 SG_ RouteInfoChar_14 : 272|8@1+ (1,0) [0|255] "ascii" ADAS_DOMAIN
 SG_ RouteInfoChar_15 : 280|8@1+ (1,0) [0|255] "ascii" ADAS_DOMAIN
 SG_ RouteInfoChar_16 : 288|8@1+ (1,0) [0|255] "ascii" ADAS_DOMAIN
 SG_ RouteInfoChar_17 : 296|8@1+ (1,0) [0|255] "ascii" ADAS_DOMAIN
 SG_ RouteInfoChar_18 : 304|8@1+ (1,0) [0|255] "ascii" ADAS_DOMAIN
 SG_ RouteInfoChar_19 : 312|8@1+ (1,0) [0|255] "ascii" ADAS_DOMAIN
 SG_ RouteInfoChar_20 : 320|8@1+ (1,0) [0|255] "ascii" ADAS_DOMAIN
 SG_ RouteInfoChar_21 : 328|8@1+ (1,0) [0|255] "ascii" ADAS_DOMAIN
 SG_ RouteInfoChar_22 : 336|8@1+ (1,0) [0|255] "ascii" ADAS_DOMAIN
 SG_ RouteInfoChar_23 : 344|8@1+ (1,0) [0|255] "ascii" ADAS_DOMAIN
 SG_ RouteInfoChar_24 : 352|8@1+ (1,0) [0|255] "ascii" ADAS_DOMAIN
 SG_ RouteInfoChar_25 : 360|8@1+ (1,0) [0|255] "ascii" ADAS_DOMAIN
 SG_ RouteInfoChar_26 : 368|8@1+ (1,0) [0|255] "ascii" ADAS_DOMAIN
 SG_ RouteInfoChar_27 : 376|8@1+ (1,0) [0|255] "ascii" ADAS_DOMAIN
 SG_ RouteInfoChar_28 : 384|8@1+ (1,0) [0|255] "ascii" ADAS_DOMAIN
 SG_ RouteInfoChar_29 : 392|8@1+ (1,0) [0|255] "ascii" ADAS_DOMAIN
 SG_ RouteInfoChar_30 : 400|8@1+ (1,0) [0|255] "ascii" ADAS_DOMAIN
 SG_ RouteInfoChar_31 : 408|8@1+ (1,0) [0|255] "ascii" ADAS_DOMAIN
 SG_ RouteInfoChar_32 : 416|8@1+ (1,0) [0|255] "ascii" ADAS_DOMAIN
 SG_ RouteInfoChar_33 : 424|8@1+ (1,0) [0|255] "ascii" ADAS_DOMAIN
 SG_ RouteInfoChar_34 : 432|8@1+ (1,0) [0|255] "ascii" ADAS_DOMAIN
 SG_ RouteInfoChar_35 : 440|8@1+ (1,0) [0|255] "ascii" ADAS_DOMAIN
 SG_ RouteInfoChar_36 : 448|8@1+ (1,0) [0|255] "ascii" ADAS_DOMAIN
 SG_ RouteInfoChar_37 : 456|8@1+ (1,0) [0|255] "ascii" ADAS_DOMAIN
 SG_ RouteInfoChar_38 : 464|8@1+ (1,0) [0|255] "ascii" ADAS_DOMAIN
 SG_ RouteInfoChar_39 : 472|8@1+ (1,0) [0|255] "ascii" ADAS_DOMAIN
 SG_ RouteInfoChar_40 : 480|8@1+ (1,0) [0|255] "ascii" ADAS_DOMAIN
 SG_ RouteInfoChar_41 : 488|8@1+ (1,0) [0|255] "ascii" ADAS_DOMAIN
 SG_ RouteInfoChar_42 : 496|8@1+ (1,0) [0|255] "ascii" ADAS_DOMAIN
 SG_ RouteInfoChar_43 : 504|8@1+ (1,0) [0|255] "ascii" ADAS_DOMAIN

CM_ BO_ 384 "Cycle=20ms; Channel=CAN0; CAN-FD; NominalBitrate=500kbit/s; DataBitrate=5000kbit/s;  Data request; receiver answers with response frame; PayloadRouteInfo='LIDAR_FRONT -> ADAS_DOMAIN' in bytes 20-63; Gateway to CAN1";

BO_ 1576 RESP_040_ADAS_DOMAIN_TO_LIDAR_FRONT: 16 ADAS_DOMAIN
 SG_ CRC8 : 0|8@1+ (1,0) [0|255] "" LIDAR_FRONT
 SG_ ResponseCounter : 8|4@1+ (1,0) [0|15] "" LIDAR_FRONT
 SG_ AckState : 12|4@1+ (1,0) [0|15] "" LIDAR_FRONT
 SG_ ReceivedFrameId : 16|11@1+ (1,0) [0|2047] "" LIDAR_FRONT
 SG_ ReceivedCounter : 27|4@1+ (1,0) [0|15] "" LIDAR_FRONT
 SG_ ChecksumOk : 31|1@1+ (1,0) [0|1] "" LIDAR_FRONT
 SG_ PayloadLength : 32|8@1+ (1,0) [0|64] "byte" LIDAR_FRONT
 SG_ ErrorCode : 40|8@1+ (1,0) [0|255] "" LIDAR_FRONT
 SG_ ProcessingTimeUs : 48|16@1+ (1,0) [0|65535] "us" LIDAR_FRONT
 SG_ ResponseSequence : 64|16@1+ (1,0) [0|65535] "" LIDAR_FRONT
 SG_ ReceivedCrc : 80|8@1+ (1,0) [0|255] "" LIDAR_FRONT
 SG_ CalculatedCrc : 88|8@1+ (1,0) [0|255] "" LIDAR_FRONT

CM_ BO_ 1576 "Cycle=20ms; Channel=CAN0; CAN-FD; NominalBitrate=500kbit/s; DataBitrate=5000kbit/s;  ResponseFor=0x180; ACK/NACK with CRC, DLC and counter check;";

BO_ 385 DATA_041_CAMERA_LANE_MODEL: 64 CAMERA_FRONT_WIDE
 SG_ CRC8 : 0|8@1+ (1,0) [0|255] "" ADAS_DOMAIN
 SG_ AliveCounter : 8|4@1+ (1,0) [0|15] "" ADAS_DOMAIN
 SG_ MuxState : 12|4@1+ (1,0) [0|15] "" ADAS_DOMAIN
 SG_ SIG_181_00 : 16|12@1+ (0.1,0.0) [0|4095] "obj" ADAS_DOMAIN
 SG_ SIG_181_01 : 28|12@1+ (0.1,0.0) [0|4095] "A" ADAS_DOMAIN
 SG_ SIG_181_02 : 40|12@1+ (0.1,0.0) [0|4095] "C" ADAS_DOMAIN
 SG_ SIG_181_03 : 52|12@1+ (0.1,0.0) [0|4095] "C" ADAS_DOMAIN
 SG_ SIG_181_04 : 64|12@1+ (0.1,0.0) [0|4095] "C" ADAS_DOMAIN
 SG_ SIG_181_05 : 76|12@1+ (0.1,0.0) [0|4095] "Nm" ADAS_DOMAIN
 SG_ SIG_181_06 : 88|12@1+ (0.1,0.0) [0|4095] "m" ADAS_DOMAIN
 SG_ SIG_181_07 : 100|12@1+ (0.1,0.0) [0|4095] "C" ADAS_DOMAIN
 SG_ SIG_181_08 : 112|12@1+ (0.1,0.0) [0|4095] "deg" ADAS_DOMAIN
 SG_ SIG_181_09 : 124|12@1+ (0.1,0.0) [0|4095] "rpm" ADAS_DOMAIN
 SG_ SIG_181_10 : 136|12@1+ (0.1,0.0) [0|4095] "V" ADAS_DOMAIN
 SG_ SIG_181_11 : 148|12@1+ (0.1,0.0) [0|4095] "m" ADAS_DOMAIN
 SG_ RouteInfoChar_00 : 160|8@1+ (1,0) [0|255] "ascii" ADAS_DOMAIN
 SG_ RouteInfoChar_01 : 168|8@1+ (1,0) [0|255] "ascii" ADAS_DOMAIN
 SG_ RouteInfoChar_02 : 176|8@1+ (1,0) [0|255] "ascii" ADAS_DOMAIN
 SG_ RouteInfoChar_03 : 184|8@1+ (1,0) [0|255] "ascii" ADAS_DOMAIN
 SG_ RouteInfoChar_04 : 192|8@1+ (1,0) [0|255] "ascii" ADAS_DOMAIN
 SG_ RouteInfoChar_05 : 200|8@1+ (1,0) [0|255] "ascii" ADAS_DOMAIN
 SG_ RouteInfoChar_06 : 208|8@1+ (1,0) [0|255] "ascii" ADAS_DOMAIN
 SG_ RouteInfoChar_07 : 216|8@1+ (1,0) [0|255] "ascii" ADAS_DOMAIN
 SG_ RouteInfoChar_08 : 224|8@1+ (1,0) [0|255] "ascii" ADAS_DOMAIN
 SG_ RouteInfoChar_09 : 232|8@1+ (1,0) [0|255] "ascii" ADAS_DOMAIN
 SG_ RouteInfoChar_10 : 240|8@1+ (1,0) [0|255] "ascii" ADAS_DOMAIN
 SG_ RouteInfoChar_11 : 248|8@1+ (1,0) [0|255] "ascii" ADAS_DOMAIN
 SG_ RouteInfoChar_12 : 256|8@1+ (1,0) [0|255] "ascii" ADAS_DOMAIN
 SG_ RouteInfoChar_13 : 264|8@1+ (1,0) [0|255] "ascii" ADAS_DOMAIN
 SG_ RouteInfoChar_14 : 272|8@1+ (1,0) [0|255] "ascii" ADAS_DOMAIN
 SG_ RouteInfoChar_15 : 280|8@1+ (1,0) [0|255] "ascii" ADAS_DOMAIN
 SG_ RouteInfoChar_16 : 288|8@1+ (1,0) [0|255] "ascii" ADAS_DOMAIN
 SG_ RouteInfoChar_17 : 296|8@1+ (1,0) [0|255] "ascii" ADAS_DOMAIN
 SG_ RouteInfoChar_18 : 304|8@1+ (1,0) [0|255] "ascii" ADAS_DOMAIN
 SG_ RouteInfoChar_19 : 312|8@1+ (1,0) [0|255] "ascii" ADAS_DOMAIN
 SG_ RouteInfoChar_20 : 320|8@1+ (1,0) [0|255] "ascii" ADAS_DOMAIN
 SG_ RouteInfoChar_21 : 328|8@1+ (1,0) [0|255] "ascii" ADAS_DOMAIN
 SG_ RouteInfoChar_22 : 336|8@1+ (1,0) [0|255] "ascii" ADAS_DOMAIN
 SG_ RouteInfoChar_23 : 344|8@1+ (1,0) [0|255] "ascii" ADAS_DOMAIN
 SG_ RouteInfoChar_24 : 352|8@1+ (1,0) [0|255] "ascii" ADAS_DOMAIN
 SG_ RouteInfoChar_25 : 360|8@1+ (1,0) [0|255] "ascii" ADAS_DOMAIN
 SG_ RouteInfoChar_26 : 368|8@1+ (1,0) [0|255] "ascii" ADAS_DOMAIN
 SG_ RouteInfoChar_27 : 376|8@1+ (1,0) [0|255] "ascii" ADAS_DOMAIN
 SG_ RouteInfoChar_28 : 384|8@1+ (1,0) [0|255] "ascii" ADAS_DOMAIN
 SG_ RouteInfoChar_29 : 392|8@1+ (1,0) [0|255] "ascii" ADAS_DOMAIN
 SG_ RouteInfoChar_30 : 400|8@1+ (1,0) [0|255] "ascii" ADAS_DOMAIN
 SG_ RouteInfoChar_31 : 408|8@1+ (1,0) [0|255] "ascii" ADAS_DOMAIN
 SG_ RouteInfoChar_32 : 416|8@1+ (1,0) [0|255] "ascii" ADAS_DOMAIN
 SG_ RouteInfoChar_33 : 424|8@1+ (1,0) [0|255] "ascii" ADAS_DOMAIN
 SG_ RouteInfoChar_34 : 432|8@1+ (1,0) [0|255] "ascii" ADAS_DOMAIN
 SG_ RouteInfoChar_35 : 440|8@1+ (1,0) [0|255] "ascii" ADAS_DOMAIN
 SG_ RouteInfoChar_36 : 448|8@1+ (1,0) [0|255] "ascii" ADAS_DOMAIN
 SG_ RouteInfoChar_37 : 456|8@1+ (1,0) [0|255] "ascii" ADAS_DOMAIN
 SG_ RouteInfoChar_38 : 464|8@1+ (1,0) [0|255] "ascii" ADAS_DOMAIN
 SG_ RouteInfoChar_39 : 472|8@1+ (1,0) [0|255] "ascii" ADAS_DOMAIN
 SG_ RouteInfoChar_40 : 480|8@1+ (1,0) [0|255] "ascii" ADAS_DOMAIN
 SG_ RouteInfoChar_41 : 488|8@1+ (1,0) [0|255] "ascii" ADAS_DOMAIN
 SG_ RouteInfoChar_42 : 496|8@1+ (1,0) [0|255] "ascii" ADAS_DOMAIN
 SG_ RouteInfoChar_43 : 504|8@1+ (1,0) [0|255] "ascii" ADAS_DOMAIN

CM_ BO_ 385 "Cycle=33ms; Channel=CAN1; CAN-FD; NominalBitrate=500kbit/s; DataBitrate=5000kbit/s;  Data request; receiver answers with response frame; PayloadRouteInfo='CAMERA_FRONT_WIDE -> ADAS_DOMAIN' in bytes 20-63;";

BO_ 1577 RESP_041_ADAS_DOMAIN_TO_CAMERA_FRONT_WIDE: 16 ADAS_DOMAIN
 SG_ CRC8 : 0|8@1+ (1,0) [0|255] "" CAMERA_FRONT_WIDE
 SG_ ResponseCounter : 8|4@1+ (1,0) [0|15] "" CAMERA_FRONT_WIDE
 SG_ AckState : 12|4@1+ (1,0) [0|15] "" CAMERA_FRONT_WIDE
 SG_ ReceivedFrameId : 16|11@1+ (1,0) [0|2047] "" CAMERA_FRONT_WIDE
 SG_ ReceivedCounter : 27|4@1+ (1,0) [0|15] "" CAMERA_FRONT_WIDE
 SG_ ChecksumOk : 31|1@1+ (1,0) [0|1] "" CAMERA_FRONT_WIDE
 SG_ PayloadLength : 32|8@1+ (1,0) [0|64] "byte" CAMERA_FRONT_WIDE
 SG_ ErrorCode : 40|8@1+ (1,0) [0|255] "" CAMERA_FRONT_WIDE
 SG_ ProcessingTimeUs : 48|16@1+ (1,0) [0|65535] "us" CAMERA_FRONT_WIDE
 SG_ ResponseSequence : 64|16@1+ (1,0) [0|65535] "" CAMERA_FRONT_WIDE
 SG_ ReceivedCrc : 80|8@1+ (1,0) [0|255] "" CAMERA_FRONT_WIDE
 SG_ CalculatedCrc : 88|8@1+ (1,0) [0|255] "" CAMERA_FRONT_WIDE

CM_ BO_ 1577 "Cycle=33ms; Channel=CAN1; CAN-FD; NominalBitrate=500kbit/s; DataBitrate=5000kbit/s;  ResponseFor=0x181; ACK/NACK with CRC, DLC and counter check;";

BO_ 386 DATA_042_RADAR_TARGET_LIST: 64 RADAR_FRONT_LONG_RANGE
 SG_ CRC8 : 0|8@1+ (1,0) [0|255] "" ADAS_DOMAIN
 SG_ AliveCounter : 8|4@1+ (1,0) [0|15] "" ADAS_DOMAIN
 SG_ MuxState : 12|4@1+ (1,0) [0|15] "" ADAS_DOMAIN
 SG_ SIG_182_00 : 16|12@1+ (0.1,0.0) [0|4095] "obj" ADAS_DOMAIN
 SG_ SIG_182_01 : 28|12@1+ (0.1,0.0) [0|4095] "A" ADAS_DOMAIN
 SG_ SIG_182_02 : 40|12@1+ (0.1,0.0) [0|4095] "rpm" ADAS_DOMAIN
 SG_ SIG_182_03 : 52|12@1+ (0.1,0.0) [0|4095] "Nm" ADAS_DOMAIN
 SG_ SIG_182_04 : 64|12@1+ (0.1,0.0) [0|4095] "V" ADAS_DOMAIN
 SG_ SIG_182_05 : 76|12@1+ (0.1,0.0) [0|4095] "Nm" ADAS_DOMAIN
 SG_ SIG_182_06 : 88|12@1+ (0.1,0.0) [0|4095] "Nm" ADAS_DOMAIN
 SG_ SIG_182_07 : 100|12@1+ (0.1,0.0) [0|4095] "deg" ADAS_DOMAIN
 SG_ SIG_182_08 : 112|12@1+ (0.1,0.0) [0|4095] "km/h" ADAS_DOMAIN
 SG_ SIG_182_09 : 124|12@1+ (0.1,0.0) [0|4095] "km/h" ADAS_DOMAIN
 SG_ SIG_182_10 : 136|12@1+ (0.1,0.0) [0|4095] "Nm" ADAS_DOMAIN
 SG_ SIG_182_11 : 148|12@1+ (0.1,0.0) [0|4095] "C" ADAS_DOMAIN
 SG_ RouteInfoChar_00 : 160|8@1+ (1,0) [0|255] "ascii" ADAS_DOMAIN
 SG_ RouteInfoChar_01 : 168|8@1+ (1,0) [0|255] "ascii" ADAS_DOMAIN
 SG_ RouteInfoChar_02 : 176|8@1+ (1,0) [0|255] "ascii" ADAS_DOMAIN
 SG_ RouteInfoChar_03 : 184|8@1+ (1,0) [0|255] "ascii" ADAS_DOMAIN
 SG_ RouteInfoChar_04 : 192|8@1+ (1,0) [0|255] "ascii" ADAS_DOMAIN
 SG_ RouteInfoChar_05 : 200|8@1+ (1,0) [0|255] "ascii" ADAS_DOMAIN
 SG_ RouteInfoChar_06 : 208|8@1+ (1,0) [0|255] "ascii" ADAS_DOMAIN
 SG_ RouteInfoChar_07 : 216|8@1+ (1,0) [0|255] "ascii" ADAS_DOMAIN
 SG_ RouteInfoChar_08 : 224|8@1+ (1,0) [0|255] "ascii" ADAS_DOMAIN
 SG_ RouteInfoChar_09 : 232|8@1+ (1,0) [0|255] "ascii" ADAS_DOMAIN
 SG_ RouteInfoChar_10 : 240|8@1+ (1,0) [0|255] "ascii" ADAS_DOMAIN
 SG_ RouteInfoChar_11 : 248|8@1+ (1,0) [0|255] "ascii" ADAS_DOMAIN
 SG_ RouteInfoChar_12 : 256|8@1+ (1,0) [0|255] "ascii" ADAS_DOMAIN
 SG_ RouteInfoChar_13 : 264|8@1+ (1,0) [0|255] "ascii" ADAS_DOMAIN
 SG_ RouteInfoChar_14 : 272|8@1+ (1,0) [0|255] "ascii" ADAS_DOMAIN
 SG_ RouteInfoChar_15 : 280|8@1+ (1,0) [0|255] "ascii" ADAS_DOMAIN
 SG_ RouteInfoChar_16 : 288|8@1+ (1,0) [0|255] "ascii" ADAS_DOMAIN
 SG_ RouteInfoChar_17 : 296|8@1+ (1,0) [0|255] "ascii" ADAS_DOMAIN
 SG_ RouteInfoChar_18 : 304|8@1+ (1,0) [0|255] "ascii" ADAS_DOMAIN
 SG_ RouteInfoChar_19 : 312|8@1+ (1,0) [0|255] "ascii" ADAS_DOMAIN
 SG_ RouteInfoChar_20 : 320|8@1+ (1,0) [0|255] "ascii" ADAS_DOMAIN
 SG_ RouteInfoChar_21 : 328|8@1+ (1,0) [0|255] "ascii" ADAS_DOMAIN
 SG_ RouteInfoChar_22 : 336|8@1+ (1,0) [0|255] "ascii" ADAS_DOMAIN
 SG_ RouteInfoChar_23 : 344|8@1+ (1,0) [0|255] "ascii" ADAS_DOMAIN
 SG_ RouteInfoChar_24 : 352|8@1+ (1,0) [0|255] "ascii" ADAS_DOMAIN
 SG_ RouteInfoChar_25 : 360|8@1+ (1,0) [0|255] "ascii" ADAS_DOMAIN
 SG_ RouteInfoChar_26 : 368|8@1+ (1,0) [0|255] "ascii" ADAS_DOMAIN
 SG_ RouteInfoChar_27 : 376|8@1+ (1,0) [0|255] "ascii" ADAS_DOMAIN
 SG_ RouteInfoChar_28 : 384|8@1+ (1,0) [0|255] "ascii" ADAS_DOMAIN
 SG_ RouteInfoChar_29 : 392|8@1+ (1,0) [0|255] "ascii" ADAS_DOMAIN
 SG_ RouteInfoChar_30 : 400|8@1+ (1,0) [0|255] "ascii" ADAS_DOMAIN
 SG_ RouteInfoChar_31 : 408|8@1+ (1,0) [0|255] "ascii" ADAS_DOMAIN
 SG_ RouteInfoChar_32 : 416|8@1+ (1,0) [0|255] "ascii" ADAS_DOMAIN
 SG_ RouteInfoChar_33 : 424|8@1+ (1,0) [0|255] "ascii" ADAS_DOMAIN
 SG_ RouteInfoChar_34 : 432|8@1+ (1,0) [0|255] "ascii" ADAS_DOMAIN
 SG_ RouteInfoChar_35 : 440|8@1+ (1,0) [0|255] "ascii" ADAS_DOMAIN
 SG_ RouteInfoChar_36 : 448|8@1+ (1,0) [0|255] "ascii" ADAS_DOMAIN
 SG_ RouteInfoChar_37 : 456|8@1+ (1,0) [0|255] "ascii" ADAS_DOMAIN
 SG_ RouteInfoChar_38 : 464|8@1+ (1,0) [0|255] "ascii" ADAS_DOMAIN
 SG_ RouteInfoChar_39 : 472|8@1+ (1,0) [0|255] "ascii" ADAS_DOMAIN
 SG_ RouteInfoChar_40 : 480|8@1+ (1,0) [0|255] "ascii" ADAS_DOMAIN
 SG_ RouteInfoChar_41 : 488|8@1+ (1,0) [0|255] "ascii" ADAS_DOMAIN
 SG_ RouteInfoChar_42 : 496|8@1+ (1,0) [0|255] "ascii" ADAS_DOMAIN
 SG_ RouteInfoChar_43 : 504|8@1+ (1,0) [0|255] "ascii" ADAS_DOMAIN

CM_ BO_ 386 "Cycle=20ms; Channel=CAN2; CAN-FD; NominalBitrate=500kbit/s; DataBitrate=5000kbit/s;  Data request; receiver answers with response frame; PayloadRouteInfo='RADAR_FRONT_LONG_RANGE -> ADAS_DOMAIN' in bytes 20-63;";

BO_ 1578 RESP_042_ADAS_DOMAIN_TO_RADAR_FRONT_LONG_RANGE: 16 ADAS_DOMAIN
 SG_ CRC8 : 0|8@1+ (1,0) [0|255] "" RADAR_FRONT_LONG_RANGE
 SG_ ResponseCounter : 8|4@1+ (1,0) [0|15] "" RADAR_FRONT_LONG_RANGE
 SG_ AckState : 12|4@1+ (1,0) [0|15] "" RADAR_FRONT_LONG_RANGE
 SG_ ReceivedFrameId : 16|11@1+ (1,0) [0|2047] "" RADAR_FRONT_LONG_RANGE
 SG_ ReceivedCounter : 27|4@1+ (1,0) [0|15] "" RADAR_FRONT_LONG_RANGE
 SG_ ChecksumOk : 31|1@1+ (1,0) [0|1] "" RADAR_FRONT_LONG_RANGE
 SG_ PayloadLength : 32|8@1+ (1,0) [0|64] "byte" RADAR_FRONT_LONG_RANGE
 SG_ ErrorCode : 40|8@1+ (1,0) [0|255] "" RADAR_FRONT_LONG_RANGE
 SG_ ProcessingTimeUs : 48|16@1+ (1,0) [0|65535] "us" RADAR_FRONT_LONG_RANGE
 SG_ ResponseSequence : 64|16@1+ (1,0) [0|65535] "" RADAR_FRONT_LONG_RANGE
 SG_ ReceivedCrc : 80|8@1+ (1,0) [0|255] "" RADAR_FRONT_LONG_RANGE
 SG_ CalculatedCrc : 88|8@1+ (1,0) [0|255] "" RADAR_FRONT_LONG_RANGE

CM_ BO_ 1578 "Cycle=20ms; Channel=CAN2; CAN-FD; NominalBitrate=500kbit/s; DataBitrate=5000kbit/s;  ResponseFor=0x182; ACK/NACK with CRC, DLC and counter check;";

BO_ 387 DATA_043_REAR_CROSS_TRAFFIC: 64 RADAR_REAR_CROSS_TRAFFIC
 SG_ CRC8 : 0|8@1+ (1,0) [0|255] "" ADAS_DOMAIN
 SG_ AliveCounter : 8|4@1+ (1,0) [0|15] "" ADAS_DOMAIN
 SG_ MuxState : 12|4@1+ (1,0) [0|15] "" ADAS_DOMAIN
 SG_ SIG_183_00 : 16|12@1+ (0.1,0.0) [0|4095] "obj" ADAS_DOMAIN
 SG_ SIG_183_01 : 28|12@1+ (0.1,0.0) [0|4095] "rpm" ADAS_DOMAIN
 SG_ SIG_183_02 : 40|12@1+ (0.1,0.0) [0|4095] "C" ADAS_DOMAIN
 SG_ SIG_183_03 : 52|12@1+ (0.1,0.0) [0|4095] "%" ADAS_DOMAIN
 SG_ SIG_183_04 : 64|12@1+ (0.1,0.0) [0|4095] "obj" ADAS_DOMAIN
 SG_ SIG_183_05 : 76|12@1+ (0.1,0.0) [0|4095] "Nm" ADAS_DOMAIN
 SG_ SIG_183_06 : 88|12@1+ (0.1,0.0) [0|4095] "%" ADAS_DOMAIN
 SG_ SIG_183_07 : 100|12@1+ (0.1,0.0) [0|4095] "C" ADAS_DOMAIN
 SG_ SIG_183_08 : 112|12@1+ (0.1,0.0) [0|4095] "%" ADAS_DOMAIN
 SG_ SIG_183_09 : 124|12@1+ (0.1,0.0) [0|4095] "Nm" ADAS_DOMAIN
 SG_ SIG_183_10 : 136|12@1+ (0.1,0.0) [0|4095] "deg" ADAS_DOMAIN
 SG_ SIG_183_11 : 148|12@1+ (0.1,0.0) [0|4095] "km/h" ADAS_DOMAIN
 SG_ RouteInfoChar_00 : 160|8@1+ (1,0) [0|255] "ascii" ADAS_DOMAIN
 SG_ RouteInfoChar_01 : 168|8@1+ (1,0) [0|255] "ascii" ADAS_DOMAIN
 SG_ RouteInfoChar_02 : 176|8@1+ (1,0) [0|255] "ascii" ADAS_DOMAIN
 SG_ RouteInfoChar_03 : 184|8@1+ (1,0) [0|255] "ascii" ADAS_DOMAIN
 SG_ RouteInfoChar_04 : 192|8@1+ (1,0) [0|255] "ascii" ADAS_DOMAIN
 SG_ RouteInfoChar_05 : 200|8@1+ (1,0) [0|255] "ascii" ADAS_DOMAIN
 SG_ RouteInfoChar_06 : 208|8@1+ (1,0) [0|255] "ascii" ADAS_DOMAIN
 SG_ RouteInfoChar_07 : 216|8@1+ (1,0) [0|255] "ascii" ADAS_DOMAIN
 SG_ RouteInfoChar_08 : 224|8@1+ (1,0) [0|255] "ascii" ADAS_DOMAIN
 SG_ RouteInfoChar_09 : 232|8@1+ (1,0) [0|255] "ascii" ADAS_DOMAIN
 SG_ RouteInfoChar_10 : 240|8@1+ (1,0) [0|255] "ascii" ADAS_DOMAIN
 SG_ RouteInfoChar_11 : 248|8@1+ (1,0) [0|255] "ascii" ADAS_DOMAIN
 SG_ RouteInfoChar_12 : 256|8@1+ (1,0) [0|255] "ascii" ADAS_DOMAIN
 SG_ RouteInfoChar_13 : 264|8@1+ (1,0) [0|255] "ascii" ADAS_DOMAIN
 SG_ RouteInfoChar_14 : 272|8@1+ (1,0) [0|255] "ascii" ADAS_DOMAIN
 SG_ RouteInfoChar_15 : 280|8@1+ (1,0) [0|255] "ascii" ADAS_DOMAIN
 SG_ RouteInfoChar_16 : 288|8@1+ (1,0) [0|255] "ascii" ADAS_DOMAIN
 SG_ RouteInfoChar_17 : 296|8@1+ (1,0) [0|255] "ascii" ADAS_DOMAIN
 SG_ RouteInfoChar_18 : 304|8@1+ (1,0) [0|255] "ascii" ADAS_DOMAIN
 SG_ RouteInfoChar_19 : 312|8@1+ (1,0) [0|255] "ascii" ADAS_DOMAIN
 SG_ RouteInfoChar_20 : 320|8@1+ (1,0) [0|255] "ascii" ADAS_DOMAIN
 SG_ RouteInfoChar_21 : 328|8@1+ (1,0) [0|255] "ascii" ADAS_DOMAIN
 SG_ RouteInfoChar_22 : 336|8@1+ (1,0) [0|255] "ascii" ADAS_DOMAIN
 SG_ RouteInfoChar_23 : 344|8@1+ (1,0) [0|255] "ascii" ADAS_DOMAIN
 SG_ RouteInfoChar_24 : 352|8@1+ (1,0) [0|255] "ascii" ADAS_DOMAIN
 SG_ RouteInfoChar_25 : 360|8@1+ (1,0) [0|255] "ascii" ADAS_DOMAIN
 SG_ RouteInfoChar_26 : 368|8@1+ (1,0) [0|255] "ascii" ADAS_DOMAIN
 SG_ RouteInfoChar_27 : 376|8@1+ (1,0) [0|255] "ascii" ADAS_DOMAIN
 SG_ RouteInfoChar_28 : 384|8@1+ (1,0) [0|255] "ascii" ADAS_DOMAIN
 SG_ RouteInfoChar_29 : 392|8@1+ (1,0) [0|255] "ascii" ADAS_DOMAIN
 SG_ RouteInfoChar_30 : 400|8@1+ (1,0) [0|255] "ascii" ADAS_DOMAIN
 SG_ RouteInfoChar_31 : 408|8@1+ (1,0) [0|255] "ascii" ADAS_DOMAIN
 SG_ RouteInfoChar_32 : 416|8@1+ (1,0) [0|255] "ascii" ADAS_DOMAIN
 SG_ RouteInfoChar_33 : 424|8@1+ (1,0) [0|255] "ascii" ADAS_DOMAIN
 SG_ RouteInfoChar_34 : 432|8@1+ (1,0) [0|255] "ascii" ADAS_DOMAIN
 SG_ RouteInfoChar_35 : 440|8@1+ (1,0) [0|255] "ascii" ADAS_DOMAIN
 SG_ RouteInfoChar_36 : 448|8@1+ (1,0) [0|255] "ascii" ADAS_DOMAIN
 SG_ RouteInfoChar_37 : 456|8@1+ (1,0) [0|255] "ascii" ADAS_DOMAIN
 SG_ RouteInfoChar_38 : 464|8@1+ (1,0) [0|255] "ascii" ADAS_DOMAIN
 SG_ RouteInfoChar_39 : 472|8@1+ (1,0) [0|255] "ascii" ADAS_DOMAIN
 SG_ RouteInfoChar_40 : 480|8@1+ (1,0) [0|255] "ascii" ADAS_DOMAIN
 SG_ RouteInfoChar_41 : 488|8@1+ (1,0) [0|255] "ascii" ADAS_DOMAIN
 SG_ RouteInfoChar_42 : 496|8@1+ (1,0) [0|255] "ascii" ADAS_DOMAIN
 SG_ RouteInfoChar_43 : 504|8@1+ (1,0) [0|255] "ascii" ADAS_DOMAIN

CM_ BO_ 387 "Cycle=50ms; Channel=CAN3; CAN-FD; NominalBitrate=500kbit/s; DataBitrate=5000kbit/s;  Data request; receiver answers with response frame; PayloadRouteInfo='RADAR_REAR_CROSS_TRAFFIC -> ADAS_DOMAIN' in bytes 20-63;";

BO_ 1579 RESP_043_ADAS_DOMAIN_TO_RADAR_REAR_CROSS_TRAFFIC: 16 ADAS_DOMAIN
 SG_ CRC8 : 0|8@1+ (1,0) [0|255] "" RADAR_REAR_CROSS_TRAFFIC
 SG_ ResponseCounter : 8|4@1+ (1,0) [0|15] "" RADAR_REAR_CROSS_TRAFFIC
 SG_ AckState : 12|4@1+ (1,0) [0|15] "" RADAR_REAR_CROSS_TRAFFIC
 SG_ ReceivedFrameId : 16|11@1+ (1,0) [0|2047] "" RADAR_REAR_CROSS_TRAFFIC
 SG_ ReceivedCounter : 27|4@1+ (1,0) [0|15] "" RADAR_REAR_CROSS_TRAFFIC
 SG_ ChecksumOk : 31|1@1+ (1,0) [0|1] "" RADAR_REAR_CROSS_TRAFFIC
 SG_ PayloadLength : 32|8@1+ (1,0) [0|64] "byte" RADAR_REAR_CROSS_TRAFFIC
 SG_ ErrorCode : 40|8@1+ (1,0) [0|255] "" RADAR_REAR_CROSS_TRAFFIC
 SG_ ProcessingTimeUs : 48|16@1+ (1,0) [0|65535] "us" RADAR_REAR_CROSS_TRAFFIC
 SG_ ResponseSequence : 64|16@1+ (1,0) [0|65535] "" RADAR_REAR_CROSS_TRAFFIC
 SG_ ReceivedCrc : 80|8@1+ (1,0) [0|255] "" RADAR_REAR_CROSS_TRAFFIC
 SG_ CalculatedCrc : 88|8@1+ (1,0) [0|255] "" RADAR_REAR_CROSS_TRAFFIC

CM_ BO_ 1579 "Cycle=50ms; Channel=CAN3; CAN-FD; NominalBitrate=500kbit/s; DataBitrate=5000kbit/s;  ResponseFor=0x183; ACK/NACK with CRC, DLC and counter check;";

BO_ 388 DATA_044_ULTRASONIC_LEFT_DISTANCE: 64 ULTRASONIC_LEFT_CLUSTER
 SG_ CRC8 : 0|8@1+ (1,0) [0|255] "" PARK_ASSIST
 SG_ AliveCounter : 8|4@1+ (1,0) [0|15] "" PARK_ASSIST
 SG_ MuxState : 12|4@1+ (1,0) [0|15] "" PARK_ASSIST
 SG_ SIG_184_00 : 16|12@1+ (0.1,0.0) [0|4095] "rpm" PARK_ASSIST
 SG_ SIG_184_01 : 28|12@1+ (0.1,0.0) [0|4095] "%" PARK_ASSIST
 SG_ SIG_184_02 : 40|12@1+ (0.1,0.0) [0|4095] "Nm" PARK_ASSIST
 SG_ SIG_184_03 : 52|12@1+ (0.1,0.0) [0|4095] "deg" PARK_ASSIST
 SG_ SIG_184_04 : 64|12@1+ (0.1,0.0) [0|4095] "m" PARK_ASSIST
 SG_ SIG_184_05 : 76|12@1+ (0.1,0.0) [0|4095] "C" PARK_ASSIST
 SG_ SIG_184_06 : 88|12@1+ (0.1,0.0) [0|4095] "km/h" PARK_ASSIST
 SG_ SIG_184_07 : 100|12@1+ (0.1,0.0) [0|4095] "m" PARK_ASSIST
 SG_ SIG_184_08 : 112|12@1+ (0.1,0.0) [0|4095] "Nm" PARK_ASSIST
 SG_ SIG_184_09 : 124|12@1+ (0.1,0.0) [0|4095] "rpm" PARK_ASSIST
 SG_ SIG_184_10 : 136|12@1+ (0.1,0.0) [0|4095] "C" PARK_ASSIST
 SG_ SIG_184_11 : 148|12@1+ (0.1,0.0) [0|4095] "deg" PARK_ASSIST
 SG_ RouteInfoChar_00 : 160|8@1+ (1,0) [0|255] "ascii" PARK_ASSIST
 SG_ RouteInfoChar_01 : 168|8@1+ (1,0) [0|255] "ascii" PARK_ASSIST
 SG_ RouteInfoChar_02 : 176|8@1+ (1,0) [0|255] "ascii" PARK_ASSIST
 SG_ RouteInfoChar_03 : 184|8@1+ (1,0) [0|255] "ascii" PARK_ASSIST
 SG_ RouteInfoChar_04 : 192|8@1+ (1,0) [0|255] "ascii" PARK_ASSIST
 SG_ RouteInfoChar_05 : 200|8@1+ (1,0) [0|255] "ascii" PARK_ASSIST
 SG_ RouteInfoChar_06 : 208|8@1+ (1,0) [0|255] "ascii" PARK_ASSIST
 SG_ RouteInfoChar_07 : 216|8@1+ (1,0) [0|255] "ascii" PARK_ASSIST
 SG_ RouteInfoChar_08 : 224|8@1+ (1,0) [0|255] "ascii" PARK_ASSIST
 SG_ RouteInfoChar_09 : 232|8@1+ (1,0) [0|255] "ascii" PARK_ASSIST
 SG_ RouteInfoChar_10 : 240|8@1+ (1,0) [0|255] "ascii" PARK_ASSIST
 SG_ RouteInfoChar_11 : 248|8@1+ (1,0) [0|255] "ascii" PARK_ASSIST
 SG_ RouteInfoChar_12 : 256|8@1+ (1,0) [0|255] "ascii" PARK_ASSIST
 SG_ RouteInfoChar_13 : 264|8@1+ (1,0) [0|255] "ascii" PARK_ASSIST
 SG_ RouteInfoChar_14 : 272|8@1+ (1,0) [0|255] "ascii" PARK_ASSIST
 SG_ RouteInfoChar_15 : 280|8@1+ (1,0) [0|255] "ascii" PARK_ASSIST
 SG_ RouteInfoChar_16 : 288|8@1+ (1,0) [0|255] "ascii" PARK_ASSIST
 SG_ RouteInfoChar_17 : 296|8@1+ (1,0) [0|255] "ascii" PARK_ASSIST
 SG_ RouteInfoChar_18 : 304|8@1+ (1,0) [0|255] "ascii" PARK_ASSIST
 SG_ RouteInfoChar_19 : 312|8@1+ (1,0) [0|255] "ascii" PARK_ASSIST
 SG_ RouteInfoChar_20 : 320|8@1+ (1,0) [0|255] "ascii" PARK_ASSIST
 SG_ RouteInfoChar_21 : 328|8@1+ (1,0) [0|255] "ascii" PARK_ASSIST
 SG_ RouteInfoChar_22 : 336|8@1+ (1,0) [0|255] "ascii" PARK_ASSIST
 SG_ RouteInfoChar_23 : 344|8@1+ (1,0) [0|255] "ascii" PARK_ASSIST
 SG_ RouteInfoChar_24 : 352|8@1+ (1,0) [0|255] "ascii" PARK_ASSIST
 SG_ RouteInfoChar_25 : 360|8@1+ (1,0) [0|255] "ascii" PARK_ASSIST
 SG_ RouteInfoChar_26 : 368|8@1+ (1,0) [0|255] "ascii" PARK_ASSIST
 SG_ RouteInfoChar_27 : 376|8@1+ (1,0) [0|255] "ascii" PARK_ASSIST
 SG_ RouteInfoChar_28 : 384|8@1+ (1,0) [0|255] "ascii" PARK_ASSIST
 SG_ RouteInfoChar_29 : 392|8@1+ (1,0) [0|255] "ascii" PARK_ASSIST
 SG_ RouteInfoChar_30 : 400|8@1+ (1,0) [0|255] "ascii" PARK_ASSIST
 SG_ RouteInfoChar_31 : 408|8@1+ (1,0) [0|255] "ascii" PARK_ASSIST
 SG_ RouteInfoChar_32 : 416|8@1+ (1,0) [0|255] "ascii" PARK_ASSIST
 SG_ RouteInfoChar_33 : 424|8@1+ (1,0) [0|255] "ascii" PARK_ASSIST
 SG_ RouteInfoChar_34 : 432|8@1+ (1,0) [0|255] "ascii" PARK_ASSIST
 SG_ RouteInfoChar_35 : 440|8@1+ (1,0) [0|255] "ascii" PARK_ASSIST
 SG_ RouteInfoChar_36 : 448|8@1+ (1,0) [0|255] "ascii" PARK_ASSIST
 SG_ RouteInfoChar_37 : 456|8@1+ (1,0) [0|255] "ascii" PARK_ASSIST
 SG_ RouteInfoChar_38 : 464|8@1+ (1,0) [0|255] "ascii" PARK_ASSIST
 SG_ RouteInfoChar_39 : 472|8@1+ (1,0) [0|255] "ascii" PARK_ASSIST
 SG_ RouteInfoChar_40 : 480|8@1+ (1,0) [0|255] "ascii" PARK_ASSIST
 SG_ RouteInfoChar_41 : 488|8@1+ (1,0) [0|255] "ascii" PARK_ASSIST
 SG_ RouteInfoChar_42 : 496|8@1+ (1,0) [0|255] "ascii" PARK_ASSIST
 SG_ RouteInfoChar_43 : 504|8@1+ (1,0) [0|255] "ascii" PARK_ASSIST

CM_ BO_ 388 "Cycle=40ms; Channel=CAN4; CAN-FD; NominalBitrate=500kbit/s; DataBitrate=5000kbit/s;  Data request; receiver answers with response frame; PayloadRouteInfo='ULTRASONIC_LEFT_CLUSTER -> PARK_ASSIST' in bytes 20-63;";

BO_ 1580 RESP_044_PARK_ASSIST_TO_ULTRASONIC_LEFT_CLUSTER: 16 PARK_ASSIST
 SG_ CRC8 : 0|8@1+ (1,0) [0|255] "" ULTRASONIC_LEFT_CLUSTER
 SG_ ResponseCounter : 8|4@1+ (1,0) [0|15] "" ULTRASONIC_LEFT_CLUSTER
 SG_ AckState : 12|4@1+ (1,0) [0|15] "" ULTRASONIC_LEFT_CLUSTER
 SG_ ReceivedFrameId : 16|11@1+ (1,0) [0|2047] "" ULTRASONIC_LEFT_CLUSTER
 SG_ ReceivedCounter : 27|4@1+ (1,0) [0|15] "" ULTRASONIC_LEFT_CLUSTER
 SG_ ChecksumOk : 31|1@1+ (1,0) [0|1] "" ULTRASONIC_LEFT_CLUSTER
 SG_ PayloadLength : 32|8@1+ (1,0) [0|64] "byte" ULTRASONIC_LEFT_CLUSTER
 SG_ ErrorCode : 40|8@1+ (1,0) [0|255] "" ULTRASONIC_LEFT_CLUSTER
 SG_ ProcessingTimeUs : 48|16@1+ (1,0) [0|65535] "us" ULTRASONIC_LEFT_CLUSTER
 SG_ ResponseSequence : 64|16@1+ (1,0) [0|65535] "" ULTRASONIC_LEFT_CLUSTER
 SG_ ReceivedCrc : 80|8@1+ (1,0) [0|255] "" ULTRASONIC_LEFT_CLUSTER
 SG_ CalculatedCrc : 88|8@1+ (1,0) [0|255] "" ULTRASONIC_LEFT_CLUSTER

CM_ BO_ 1580 "Cycle=40ms; Channel=CAN4; CAN-FD; NominalBitrate=500kbit/s; DataBitrate=5000kbit/s;  ResponseFor=0x184; ACK/NACK with CRC, DLC and counter check;";

BO_ 389 DATA_045_ULTRASONIC_RIGHT_DISTANCE: 64 ULTRASONIC_RIGHT_CLUSTER
 SG_ CRC8 : 0|8@1+ (1,0) [0|255] "" PARK_ASSIST
 SG_ AliveCounter : 8|4@1+ (1,0) [0|15] "" PARK_ASSIST
 SG_ MuxState : 12|4@1+ (1,0) [0|15] "" PARK_ASSIST
 SG_ SIG_185_00 : 16|12@1+ (0.1,0.0) [0|4095] "C" PARK_ASSIST
 SG_ SIG_185_01 : 28|12@1+ (0.1,0.0) [0|4095] "m" PARK_ASSIST
 SG_ SIG_185_02 : 40|12@1+ (0.1,0.0) [0|4095] "m" PARK_ASSIST
 SG_ SIG_185_03 : 52|12@1+ (0.1,0.0) [0|4095] "obj" PARK_ASSIST
 SG_ SIG_185_04 : 64|12@1+ (0.1,0.0) [0|4095] "A" PARK_ASSIST
 SG_ SIG_185_05 : 76|12@1+ (0.1,0.0) [0|4095] "C" PARK_ASSIST
 SG_ SIG_185_06 : 88|12@1+ (0.1,0.0) [0|4095] "obj" PARK_ASSIST
 SG_ SIG_185_07 : 100|12@1+ (0.1,0.0) [0|4095] "m" PARK_ASSIST
 SG_ SIG_185_08 : 112|12@1+ (0.1,0.0) [0|4095] "%" PARK_ASSIST
 SG_ SIG_185_09 : 124|12@1+ (0.1,0.0) [0|4095] "m" PARK_ASSIST
 SG_ SIG_185_10 : 136|12@1+ (0.1,0.0) [0|4095] "C" PARK_ASSIST
 SG_ SIG_185_11 : 148|12@1+ (0.1,0.0) [0|4095] "deg" PARK_ASSIST
 SG_ RouteInfoChar_00 : 160|8@1+ (1,0) [0|255] "ascii" PARK_ASSIST
 SG_ RouteInfoChar_01 : 168|8@1+ (1,0) [0|255] "ascii" PARK_ASSIST
 SG_ RouteInfoChar_02 : 176|8@1+ (1,0) [0|255] "ascii" PARK_ASSIST
 SG_ RouteInfoChar_03 : 184|8@1+ (1,0) [0|255] "ascii" PARK_ASSIST
 SG_ RouteInfoChar_04 : 192|8@1+ (1,0) [0|255] "ascii" PARK_ASSIST
 SG_ RouteInfoChar_05 : 200|8@1+ (1,0) [0|255] "ascii" PARK_ASSIST
 SG_ RouteInfoChar_06 : 208|8@1+ (1,0) [0|255] "ascii" PARK_ASSIST
 SG_ RouteInfoChar_07 : 216|8@1+ (1,0) [0|255] "ascii" PARK_ASSIST
 SG_ RouteInfoChar_08 : 224|8@1+ (1,0) [0|255] "ascii" PARK_ASSIST
 SG_ RouteInfoChar_09 : 232|8@1+ (1,0) [0|255] "ascii" PARK_ASSIST
 SG_ RouteInfoChar_10 : 240|8@1+ (1,0) [0|255] "ascii" PARK_ASSIST
 SG_ RouteInfoChar_11 : 248|8@1+ (1,0) [0|255] "ascii" PARK_ASSIST
 SG_ RouteInfoChar_12 : 256|8@1+ (1,0) [0|255] "ascii" PARK_ASSIST
 SG_ RouteInfoChar_13 : 264|8@1+ (1,0) [0|255] "ascii" PARK_ASSIST
 SG_ RouteInfoChar_14 : 272|8@1+ (1,0) [0|255] "ascii" PARK_ASSIST
 SG_ RouteInfoChar_15 : 280|8@1+ (1,0) [0|255] "ascii" PARK_ASSIST
 SG_ RouteInfoChar_16 : 288|8@1+ (1,0) [0|255] "ascii" PARK_ASSIST
 SG_ RouteInfoChar_17 : 296|8@1+ (1,0) [0|255] "ascii" PARK_ASSIST
 SG_ RouteInfoChar_18 : 304|8@1+ (1,0) [0|255] "ascii" PARK_ASSIST
 SG_ RouteInfoChar_19 : 312|8@1+ (1,0) [0|255] "ascii" PARK_ASSIST
 SG_ RouteInfoChar_20 : 320|8@1+ (1,0) [0|255] "ascii" PARK_ASSIST
 SG_ RouteInfoChar_21 : 328|8@1+ (1,0) [0|255] "ascii" PARK_ASSIST
 SG_ RouteInfoChar_22 : 336|8@1+ (1,0) [0|255] "ascii" PARK_ASSIST
 SG_ RouteInfoChar_23 : 344|8@1+ (1,0) [0|255] "ascii" PARK_ASSIST
 SG_ RouteInfoChar_24 : 352|8@1+ (1,0) [0|255] "ascii" PARK_ASSIST
 SG_ RouteInfoChar_25 : 360|8@1+ (1,0) [0|255] "ascii" PARK_ASSIST
 SG_ RouteInfoChar_26 : 368|8@1+ (1,0) [0|255] "ascii" PARK_ASSIST
 SG_ RouteInfoChar_27 : 376|8@1+ (1,0) [0|255] "ascii" PARK_ASSIST
 SG_ RouteInfoChar_28 : 384|8@1+ (1,0) [0|255] "ascii" PARK_ASSIST
 SG_ RouteInfoChar_29 : 392|8@1+ (1,0) [0|255] "ascii" PARK_ASSIST
 SG_ RouteInfoChar_30 : 400|8@1+ (1,0) [0|255] "ascii" PARK_ASSIST
 SG_ RouteInfoChar_31 : 408|8@1+ (1,0) [0|255] "ascii" PARK_ASSIST
 SG_ RouteInfoChar_32 : 416|8@1+ (1,0) [0|255] "ascii" PARK_ASSIST
 SG_ RouteInfoChar_33 : 424|8@1+ (1,0) [0|255] "ascii" PARK_ASSIST
 SG_ RouteInfoChar_34 : 432|8@1+ (1,0) [0|255] "ascii" PARK_ASSIST
 SG_ RouteInfoChar_35 : 440|8@1+ (1,0) [0|255] "ascii" PARK_ASSIST
 SG_ RouteInfoChar_36 : 448|8@1+ (1,0) [0|255] "ascii" PARK_ASSIST
 SG_ RouteInfoChar_37 : 456|8@1+ (1,0) [0|255] "ascii" PARK_ASSIST
 SG_ RouteInfoChar_38 : 464|8@1+ (1,0) [0|255] "ascii" PARK_ASSIST
 SG_ RouteInfoChar_39 : 472|8@1+ (1,0) [0|255] "ascii" PARK_ASSIST
 SG_ RouteInfoChar_40 : 480|8@1+ (1,0) [0|255] "ascii" PARK_ASSIST
 SG_ RouteInfoChar_41 : 488|8@1+ (1,0) [0|255] "ascii" PARK_ASSIST
 SG_ RouteInfoChar_42 : 496|8@1+ (1,0) [0|255] "ascii" PARK_ASSIST
 SG_ RouteInfoChar_43 : 504|8@1+ (1,0) [0|255] "ascii" PARK_ASSIST

CM_ BO_ 389 "Cycle=40ms; Channel=CAN5; CAN-FD; NominalBitrate=500kbit/s; DataBitrate=5000kbit/s;  Data request; receiver answers with response frame; PayloadRouteInfo='ULTRASONIC_RIGHT_CLUSTER -> PARK_ASSIST' in bytes 20-63;";

BO_ 1581 RESP_045_PARK_ASSIST_TO_ULTRASONIC_RIGHT_CLUSTER: 16 PARK_ASSIST
 SG_ CRC8 : 0|8@1+ (1,0) [0|255] "" ULTRASONIC_RIGHT_CLUSTER
 SG_ ResponseCounter : 8|4@1+ (1,0) [0|15] "" ULTRASONIC_RIGHT_CLUSTER
 SG_ AckState : 12|4@1+ (1,0) [0|15] "" ULTRASONIC_RIGHT_CLUSTER
 SG_ ReceivedFrameId : 16|11@1+ (1,0) [0|2047] "" ULTRASONIC_RIGHT_CLUSTER
 SG_ ReceivedCounter : 27|4@1+ (1,0) [0|15] "" ULTRASONIC_RIGHT_CLUSTER
 SG_ ChecksumOk : 31|1@1+ (1,0) [0|1] "" ULTRASONIC_RIGHT_CLUSTER
 SG_ PayloadLength : 32|8@1+ (1,0) [0|64] "byte" ULTRASONIC_RIGHT_CLUSTER
 SG_ ErrorCode : 40|8@1+ (1,0) [0|255] "" ULTRASONIC_RIGHT_CLUSTER
 SG_ ProcessingTimeUs : 48|16@1+ (1,0) [0|65535] "us" ULTRASONIC_RIGHT_CLUSTER
 SG_ ResponseSequence : 64|16@1+ (1,0) [0|65535] "" ULTRASONIC_RIGHT_CLUSTER
 SG_ ReceivedCrc : 80|8@1+ (1,0) [0|255] "" ULTRASONIC_RIGHT_CLUSTER
 SG_ CalculatedCrc : 88|8@1+ (1,0) [0|255] "" ULTRASONIC_RIGHT_CLUSTER

CM_ BO_ 1581 "Cycle=40ms; Channel=CAN5; CAN-FD; NominalBitrate=500kbit/s; DataBitrate=5000kbit/s;  ResponseFor=0x185; ACK/NACK with CRC, DLC and counter check;";

BO_ 390 DATA_046_IMU_DYNAMICS: 64 IMU_YAW_RATE_SENSOR
 SG_ CRC8 : 0|8@1+ (1,0) [0|255] "" ADAS_DOMAIN
 SG_ AliveCounter : 8|4@1+ (1,0) [0|15] "" ADAS_DOMAIN
 SG_ MuxState : 12|4@1+ (1,0) [0|15] "" ADAS_DOMAIN
 SG_ SIG_186_00 : 16|12@1+ (0.1,0.0) [0|4095] "C" ADAS_DOMAIN
 SG_ SIG_186_01 : 28|12@1+ (0.1,0.0) [0|4095] "C" ADAS_DOMAIN
 SG_ SIG_186_02 : 40|12@1+ (0.1,0.0) [0|4095] "V" ADAS_DOMAIN
 SG_ SIG_186_03 : 52|12@1+ (0.1,0.0) [0|4095] "Nm" ADAS_DOMAIN
 SG_ SIG_186_04 : 64|12@1+ (0.1,0.0) [0|4095] "V" ADAS_DOMAIN
 SG_ SIG_186_05 : 76|12@1+ (0.1,0.0) [0|4095] "m" ADAS_DOMAIN
 SG_ SIG_186_06 : 88|12@1+ (0.1,0.0) [0|4095] "C" ADAS_DOMAIN
 SG_ SIG_186_07 : 100|12@1+ (0.1,0.0) [0|4095] "Nm" ADAS_DOMAIN
 SG_ SIG_186_08 : 112|12@1+ (0.1,0.0) [0|4095] "V" ADAS_DOMAIN
 SG_ SIG_186_09 : 124|12@1+ (0.1,0.0) [0|4095] "C" ADAS_DOMAIN
 SG_ SIG_186_10 : 136|12@1+ (0.1,0.0) [0|4095] "rpm" ADAS_DOMAIN
 SG_ SIG_186_11 : 148|12@1+ (0.1,0.0) [0|4095] "V" ADAS_DOMAIN
 SG_ RouteInfoChar_00 : 160|8@1+ (1,0) [0|255] "ascii" ADAS_DOMAIN
 SG_ RouteInfoChar_01 : 168|8@1+ (1,0) [0|255] "ascii" ADAS_DOMAIN
 SG_ RouteInfoChar_02 : 176|8@1+ (1,0) [0|255] "ascii" ADAS_DOMAIN
 SG_ RouteInfoChar_03 : 184|8@1+ (1,0) [0|255] "ascii" ADAS_DOMAIN
 SG_ RouteInfoChar_04 : 192|8@1+ (1,0) [0|255] "ascii" ADAS_DOMAIN
 SG_ RouteInfoChar_05 : 200|8@1+ (1,0) [0|255] "ascii" ADAS_DOMAIN
 SG_ RouteInfoChar_06 : 208|8@1+ (1,0) [0|255] "ascii" ADAS_DOMAIN
 SG_ RouteInfoChar_07 : 216|8@1+ (1,0) [0|255] "ascii" ADAS_DOMAIN
 SG_ RouteInfoChar_08 : 224|8@1+ (1,0) [0|255] "ascii" ADAS_DOMAIN
 SG_ RouteInfoChar_09 : 232|8@1+ (1,0) [0|255] "ascii" ADAS_DOMAIN
 SG_ RouteInfoChar_10 : 240|8@1+ (1,0) [0|255] "ascii" ADAS_DOMAIN
 SG_ RouteInfoChar_11 : 248|8@1+ (1,0) [0|255] "ascii" ADAS_DOMAIN
 SG_ RouteInfoChar_12 : 256|8@1+ (1,0) [0|255] "ascii" ADAS_DOMAIN
 SG_ RouteInfoChar_13 : 264|8@1+ (1,0) [0|255] "ascii" ADAS_DOMAIN
 SG_ RouteInfoChar_14 : 272|8@1+ (1,0) [0|255] "ascii" ADAS_DOMAIN
 SG_ RouteInfoChar_15 : 280|8@1+ (1,0) [0|255] "ascii" ADAS_DOMAIN
 SG_ RouteInfoChar_16 : 288|8@1+ (1,0) [0|255] "ascii" ADAS_DOMAIN
 SG_ RouteInfoChar_17 : 296|8@1+ (1,0) [0|255] "ascii" ADAS_DOMAIN
 SG_ RouteInfoChar_18 : 304|8@1+ (1,0) [0|255] "ascii" ADAS_DOMAIN
 SG_ RouteInfoChar_19 : 312|8@1+ (1,0) [0|255] "ascii" ADAS_DOMAIN
 SG_ RouteInfoChar_20 : 320|8@1+ (1,0) [0|255] "ascii" ADAS_DOMAIN
 SG_ RouteInfoChar_21 : 328|8@1+ (1,0) [0|255] "ascii" ADAS_DOMAIN
 SG_ RouteInfoChar_22 : 336|8@1+ (1,0) [0|255] "ascii" ADAS_DOMAIN
 SG_ RouteInfoChar_23 : 344|8@1+ (1,0) [0|255] "ascii" ADAS_DOMAIN
 SG_ RouteInfoChar_24 : 352|8@1+ (1,0) [0|255] "ascii" ADAS_DOMAIN
 SG_ RouteInfoChar_25 : 360|8@1+ (1,0) [0|255] "ascii" ADAS_DOMAIN
 SG_ RouteInfoChar_26 : 368|8@1+ (1,0) [0|255] "ascii" ADAS_DOMAIN
 SG_ RouteInfoChar_27 : 376|8@1+ (1,0) [0|255] "ascii" ADAS_DOMAIN
 SG_ RouteInfoChar_28 : 384|8@1+ (1,0) [0|255] "ascii" ADAS_DOMAIN
 SG_ RouteInfoChar_29 : 392|8@1+ (1,0) [0|255] "ascii" ADAS_DOMAIN
 SG_ RouteInfoChar_30 : 400|8@1+ (1,0) [0|255] "ascii" ADAS_DOMAIN
 SG_ RouteInfoChar_31 : 408|8@1+ (1,0) [0|255] "ascii" ADAS_DOMAIN
 SG_ RouteInfoChar_32 : 416|8@1+ (1,0) [0|255] "ascii" ADAS_DOMAIN
 SG_ RouteInfoChar_33 : 424|8@1+ (1,0) [0|255] "ascii" ADAS_DOMAIN
 SG_ RouteInfoChar_34 : 432|8@1+ (1,0) [0|255] "ascii" ADAS_DOMAIN
 SG_ RouteInfoChar_35 : 440|8@1+ (1,0) [0|255] "ascii" ADAS_DOMAIN
 SG_ RouteInfoChar_36 : 448|8@1+ (1,0) [0|255] "ascii" ADAS_DOMAIN
 SG_ RouteInfoChar_37 : 456|8@1+ (1,0) [0|255] "ascii" ADAS_DOMAIN
 SG_ RouteInfoChar_38 : 464|8@1+ (1,0) [0|255] "ascii" ADAS_DOMAIN
 SG_ RouteInfoChar_39 : 472|8@1+ (1,0) [0|255] "ascii" ADAS_DOMAIN
 SG_ RouteInfoChar_40 : 480|8@1+ (1,0) [0|255] "ascii" ADAS_DOMAIN
 SG_ RouteInfoChar_41 : 488|8@1+ (1,0) [0|255] "ascii" ADAS_DOMAIN
 SG_ RouteInfoChar_42 : 496|8@1+ (1,0) [0|255] "ascii" ADAS_DOMAIN
 SG_ RouteInfoChar_43 : 504|8@1+ (1,0) [0|255] "ascii" ADAS_DOMAIN

CM_ BO_ 390 "Cycle=10ms; Channel=CAN6; CAN-FD; NominalBitrate=500kbit/s; DataBitrate=5000kbit/s;  Data request; receiver answers with response frame; PayloadRouteInfo='IMU_YAW_RATE_SENSOR -> ADAS_DOMAIN' in bytes 20-63;";

BO_ 1582 RESP_046_ADAS_DOMAIN_TO_IMU_YAW_RATE_SENSOR: 16 ADAS_DOMAIN
 SG_ CRC8 : 0|8@1+ (1,0) [0|255] "" IMU_YAW_RATE_SENSOR
 SG_ ResponseCounter : 8|4@1+ (1,0) [0|15] "" IMU_YAW_RATE_SENSOR
 SG_ AckState : 12|4@1+ (1,0) [0|15] "" IMU_YAW_RATE_SENSOR
 SG_ ReceivedFrameId : 16|11@1+ (1,0) [0|2047] "" IMU_YAW_RATE_SENSOR
 SG_ ReceivedCounter : 27|4@1+ (1,0) [0|15] "" IMU_YAW_RATE_SENSOR
 SG_ ChecksumOk : 31|1@1+ (1,0) [0|1] "" IMU_YAW_RATE_SENSOR
 SG_ PayloadLength : 32|8@1+ (1,0) [0|64] "byte" IMU_YAW_RATE_SENSOR
 SG_ ErrorCode : 40|8@1+ (1,0) [0|255] "" IMU_YAW_RATE_SENSOR
 SG_ ProcessingTimeUs : 48|16@1+ (1,0) [0|65535] "us" IMU_YAW_RATE_SENSOR
 SG_ ResponseSequence : 64|16@1+ (1,0) [0|65535] "" IMU_YAW_RATE_SENSOR
 SG_ ReceivedCrc : 80|8@1+ (1,0) [0|255] "" IMU_YAW_RATE_SENSOR
 SG_ CalculatedCrc : 88|8@1+ (1,0) [0|255] "" IMU_YAW_RATE_SENSOR

CM_ BO_ 1582 "Cycle=10ms; Channel=CAN6; CAN-FD; NominalBitrate=500kbit/s; DataBitrate=5000kbit/s;  ResponseFor=0x186; ACK/NACK with CRC, DLC and counter check;";

BO_ 391 DATA_047_WHEEL_SPEED_FL: 64 WHEEL_SPEED_FRONT_LEFT
 SG_ CRC8 : 0|8@1+ (1,0) [0|255] "" BRAKE_CONTROLLER
 SG_ AliveCounter : 8|4@1+ (1,0) [0|15] "" BRAKE_CONTROLLER
 SG_ MuxState : 12|4@1+ (1,0) [0|15] "" BRAKE_CONTROLLER
 SG_ SIG_187_00 : 16|12@1+ (0.1,0.0) [0|4095] "Nm" BRAKE_CONTROLLER
 SG_ SIG_187_01 : 28|12@1+ (0.1,0.0) [0|4095] "V" BRAKE_CONTROLLER
 SG_ SIG_187_02 : 40|12@1+ (0.1,0.0) [0|4095] "A" BRAKE_CONTROLLER
 SG_ SIG_187_03 : 52|12@1+ (0.1,0.0) [0|4095] "A" BRAKE_CONTROLLER
 SG_ SIG_187_04 : 64|12@1+ (0.1,0.0) [0|4095] "m" BRAKE_CONTROLLER
 SG_ SIG_187_05 : 76|12@1+ (0.1,0.0) [0|4095] "rpm" BRAKE_CONTROLLER
 SG_ SIG_187_06 : 88|12@1+ (0.1,0.0) [0|4095] "deg" BRAKE_CONTROLLER
 SG_ SIG_187_07 : 100|12@1+ (0.1,0.0) [0|4095] "deg" BRAKE_CONTROLLER
 SG_ SIG_187_08 : 112|12@1+ (0.1,0.0) [0|4095] "Nm" BRAKE_CONTROLLER
 SG_ SIG_187_09 : 124|12@1+ (0.1,0.0) [0|4095] "%" BRAKE_CONTROLLER
 SG_ SIG_187_10 : 136|12@1+ (0.1,0.0) [0|4095] "deg" BRAKE_CONTROLLER
 SG_ SIG_187_11 : 148|12@1+ (0.1,0.0) [0|4095] "Nm" BRAKE_CONTROLLER
 SG_ RouteInfoChar_00 : 160|8@1+ (1,0) [0|255] "ascii" BRAKE_CONTROLLER
 SG_ RouteInfoChar_01 : 168|8@1+ (1,0) [0|255] "ascii" BRAKE_CONTROLLER
 SG_ RouteInfoChar_02 : 176|8@1+ (1,0) [0|255] "ascii" BRAKE_CONTROLLER
 SG_ RouteInfoChar_03 : 184|8@1+ (1,0) [0|255] "ascii" BRAKE_CONTROLLER
 SG_ RouteInfoChar_04 : 192|8@1+ (1,0) [0|255] "ascii" BRAKE_CONTROLLER
 SG_ RouteInfoChar_05 : 200|8@1+ (1,0) [0|255] "ascii" BRAKE_CONTROLLER
 SG_ RouteInfoChar_06 : 208|8@1+ (1,0) [0|255] "ascii" BRAKE_CONTROLLER
 SG_ RouteInfoChar_07 : 216|8@1+ (1,0) [0|255] "ascii" BRAKE_CONTROLLER
 SG_ RouteInfoChar_08 : 224|8@1+ (1,0) [0|255] "ascii" BRAKE_CONTROLLER
 SG_ RouteInfoChar_09 : 232|8@1+ (1,0) [0|255] "ascii" BRAKE_CONTROLLER
 SG_ RouteInfoChar_10 : 240|8@1+ (1,0) [0|255] "ascii" BRAKE_CONTROLLER
 SG_ RouteInfoChar_11 : 248|8@1+ (1,0) [0|255] "ascii" BRAKE_CONTROLLER
 SG_ RouteInfoChar_12 : 256|8@1+ (1,0) [0|255] "ascii" BRAKE_CONTROLLER
 SG_ RouteInfoChar_13 : 264|8@1+ (1,0) [0|255] "ascii" BRAKE_CONTROLLER
 SG_ RouteInfoChar_14 : 272|8@1+ (1,0) [0|255] "ascii" BRAKE_CONTROLLER
 SG_ RouteInfoChar_15 : 280|8@1+ (1,0) [0|255] "ascii" BRAKE_CONTROLLER
 SG_ RouteInfoChar_16 : 288|8@1+ (1,0) [0|255] "ascii" BRAKE_CONTROLLER
 SG_ RouteInfoChar_17 : 296|8@1+ (1,0) [0|255] "ascii" BRAKE_CONTROLLER
 SG_ RouteInfoChar_18 : 304|8@1+ (1,0) [0|255] "ascii" BRAKE_CONTROLLER
 SG_ RouteInfoChar_19 : 312|8@1+ (1,0) [0|255] "ascii" BRAKE_CONTROLLER
 SG_ RouteInfoChar_20 : 320|8@1+ (1,0) [0|255] "ascii" BRAKE_CONTROLLER
 SG_ RouteInfoChar_21 : 328|8@1+ (1,0) [0|255] "ascii" BRAKE_CONTROLLER
 SG_ RouteInfoChar_22 : 336|8@1+ (1,0) [0|255] "ascii" BRAKE_CONTROLLER
 SG_ RouteInfoChar_23 : 344|8@1+ (1,0) [0|255] "ascii" BRAKE_CONTROLLER
 SG_ RouteInfoChar_24 : 352|8@1+ (1,0) [0|255] "ascii" BRAKE_CONTROLLER
 SG_ RouteInfoChar_25 : 360|8@1+ (1,0) [0|255] "ascii" BRAKE_CONTROLLER
 SG_ RouteInfoChar_26 : 368|8@1+ (1,0) [0|255] "ascii" BRAKE_CONTROLLER
 SG_ RouteInfoChar_27 : 376|8@1+ (1,0) [0|255] "ascii" BRAKE_CONTROLLER
 SG_ RouteInfoChar_28 : 384|8@1+ (1,0) [0|255] "ascii" BRAKE_CONTROLLER
 SG_ RouteInfoChar_29 : 392|8@1+ (1,0) [0|255] "ascii" BRAKE_CONTROLLER
 SG_ RouteInfoChar_30 : 400|8@1+ (1,0) [0|255] "ascii" BRAKE_CONTROLLER
 SG_ RouteInfoChar_31 : 408|8@1+ (1,0) [0|255] "ascii" BRAKE_CONTROLLER
 SG_ RouteInfoChar_32 : 416|8@1+ (1,0) [0|255] "ascii" BRAKE_CONTROLLER
 SG_ RouteInfoChar_33 : 424|8@1+ (1,0) [0|255] "ascii" BRAKE_CONTROLLER
 SG_ RouteInfoChar_34 : 432|8@1+ (1,0) [0|255] "ascii" BRAKE_CONTROLLER
 SG_ RouteInfoChar_35 : 440|8@1+ (1,0) [0|255] "ascii" BRAKE_CONTROLLER
 SG_ RouteInfoChar_36 : 448|8@1+ (1,0) [0|255] "ascii" BRAKE_CONTROLLER
 SG_ RouteInfoChar_37 : 456|8@1+ (1,0) [0|255] "ascii" BRAKE_CONTROLLER
 SG_ RouteInfoChar_38 : 464|8@1+ (1,0) [0|255] "ascii" BRAKE_CONTROLLER
 SG_ RouteInfoChar_39 : 472|8@1+ (1,0) [0|255] "ascii" BRAKE_CONTROLLER
 SG_ RouteInfoChar_40 : 480|8@1+ (1,0) [0|255] "ascii" BRAKE_CONTROLLER
 SG_ RouteInfoChar_41 : 488|8@1+ (1,0) [0|255] "ascii" BRAKE_CONTROLLER
 SG_ RouteInfoChar_42 : 496|8@1+ (1,0) [0|255] "ascii" BRAKE_CONTROLLER
 SG_ RouteInfoChar_43 : 504|8@1+ (1,0) [0|255] "ascii" BRAKE_CONTROLLER

CM_ BO_ 391 "Cycle=10ms; Channel=CAN7; CAN-FD; NominalBitrate=500kbit/s; DataBitrate=5000kbit/s;  Data request; receiver answers with response frame; PayloadRouteInfo='WHEEL_SPEED_FRONT_LEFT -> BRAKE_CONTROLLER' in bytes 20-63;";

BO_ 1583 RESP_047_BRAKE_CONTROLLER_TO_WHEEL_SPEED_FRONT_LEFT: 16 BRAKE_CONTROLLER
 SG_ CRC8 : 0|8@1+ (1,0) [0|255] "" WHEEL_SPEED_FRONT_LEFT
 SG_ ResponseCounter : 8|4@1+ (1,0) [0|15] "" WHEEL_SPEED_FRONT_LEFT
 SG_ AckState : 12|4@1+ (1,0) [0|15] "" WHEEL_SPEED_FRONT_LEFT
 SG_ ReceivedFrameId : 16|11@1+ (1,0) [0|2047] "" WHEEL_SPEED_FRONT_LEFT
 SG_ ReceivedCounter : 27|4@1+ (1,0) [0|15] "" WHEEL_SPEED_FRONT_LEFT
 SG_ ChecksumOk : 31|1@1+ (1,0) [0|1] "" WHEEL_SPEED_FRONT_LEFT
 SG_ PayloadLength : 32|8@1+ (1,0) [0|64] "byte" WHEEL_SPEED_FRONT_LEFT
 SG_ ErrorCode : 40|8@1+ (1,0) [0|255] "" WHEEL_SPEED_FRONT_LEFT
 SG_ ProcessingTimeUs : 48|16@1+ (1,0) [0|65535] "us" WHEEL_SPEED_FRONT_LEFT
 SG_ ResponseSequence : 64|16@1+ (1,0) [0|65535] "" WHEEL_SPEED_FRONT_LEFT
 SG_ ReceivedCrc : 80|8@1+ (1,0) [0|255] "" WHEEL_SPEED_FRONT_LEFT
 SG_ CalculatedCrc : 88|8@1+ (1,0) [0|255] "" WHEEL_SPEED_FRONT_LEFT

CM_ BO_ 1583 "Cycle=10ms; Channel=CAN7; CAN-FD; NominalBitrate=500kbit/s; DataBitrate=5000kbit/s;  ResponseFor=0x187; ACK/NACK with CRC, DLC and counter check;";

BO_ 392 DATA_048_BRAKE_STATUS: 64 BRAKE_CONTROLLER
 SG_ CRC8 : 0|8@1+ (1,0) [0|255] "" ADAS_DOMAIN
 SG_ AliveCounter : 8|4@1+ (1,0) [0|15] "" ADAS_DOMAIN
 SG_ MuxState : 12|4@1+ (1,0) [0|15] "" ADAS_DOMAIN
 SG_ SIG_188_00 : 16|12@1+ (0.1,0.0) [0|4095] "rpm" ADAS_DOMAIN
 SG_ SIG_188_01 : 28|12@1+ (0.1,0.0) [0|4095] "%" ADAS_DOMAIN
 SG_ SIG_188_02 : 40|12@1+ (0.1,0.0) [0|4095] "%" ADAS_DOMAIN
 SG_ SIG_188_03 : 52|12@1+ (0.1,0.0) [0|4095] "A" ADAS_DOMAIN
 SG_ SIG_188_04 : 64|12@1+ (0.1,0.0) [0|4095] "m" ADAS_DOMAIN
 SG_ SIG_188_05 : 76|12@1+ (0.1,0.0) [0|4095] "C" ADAS_DOMAIN
 SG_ SIG_188_06 : 88|12@1+ (0.1,0.0) [0|4095] "%" ADAS_DOMAIN
 SG_ SIG_188_07 : 100|12@1+ (0.1,0.0) [0|4095] "km/h" ADAS_DOMAIN
 SG_ SIG_188_08 : 112|12@1+ (0.1,0.0) [0|4095] "Nm" ADAS_DOMAIN
 SG_ SIG_188_09 : 124|12@1+ (0.1,0.0) [0|4095] "%" ADAS_DOMAIN
 SG_ SIG_188_10 : 136|12@1+ (0.1,0.0) [0|4095] "%" ADAS_DOMAIN
 SG_ SIG_188_11 : 148|12@1+ (0.1,0.0) [0|4095] "obj" ADAS_DOMAIN
 SG_ RouteInfoChar_00 : 160|8@1+ (1,0) [0|255] "ascii" ADAS_DOMAIN
 SG_ RouteInfoChar_01 : 168|8@1+ (1,0) [0|255] "ascii" ADAS_DOMAIN
 SG_ RouteInfoChar_02 : 176|8@1+ (1,0) [0|255] "ascii" ADAS_DOMAIN
 SG_ RouteInfoChar_03 : 184|8@1+ (1,0) [0|255] "ascii" ADAS_DOMAIN
 SG_ RouteInfoChar_04 : 192|8@1+ (1,0) [0|255] "ascii" ADAS_DOMAIN
 SG_ RouteInfoChar_05 : 200|8@1+ (1,0) [0|255] "ascii" ADAS_DOMAIN
 SG_ RouteInfoChar_06 : 208|8@1+ (1,0) [0|255] "ascii" ADAS_DOMAIN
 SG_ RouteInfoChar_07 : 216|8@1+ (1,0) [0|255] "ascii" ADAS_DOMAIN
 SG_ RouteInfoChar_08 : 224|8@1+ (1,0) [0|255] "ascii" ADAS_DOMAIN
 SG_ RouteInfoChar_09 : 232|8@1+ (1,0) [0|255] "ascii" ADAS_DOMAIN
 SG_ RouteInfoChar_10 : 240|8@1+ (1,0) [0|255] "ascii" ADAS_DOMAIN
 SG_ RouteInfoChar_11 : 248|8@1+ (1,0) [0|255] "ascii" ADAS_DOMAIN
 SG_ RouteInfoChar_12 : 256|8@1+ (1,0) [0|255] "ascii" ADAS_DOMAIN
 SG_ RouteInfoChar_13 : 264|8@1+ (1,0) [0|255] "ascii" ADAS_DOMAIN
 SG_ RouteInfoChar_14 : 272|8@1+ (1,0) [0|255] "ascii" ADAS_DOMAIN
 SG_ RouteInfoChar_15 : 280|8@1+ (1,0) [0|255] "ascii" ADAS_DOMAIN
 SG_ RouteInfoChar_16 : 288|8@1+ (1,0) [0|255] "ascii" ADAS_DOMAIN
 SG_ RouteInfoChar_17 : 296|8@1+ (1,0) [0|255] "ascii" ADAS_DOMAIN
 SG_ RouteInfoChar_18 : 304|8@1+ (1,0) [0|255] "ascii" ADAS_DOMAIN
 SG_ RouteInfoChar_19 : 312|8@1+ (1,0) [0|255] "ascii" ADAS_DOMAIN
 SG_ RouteInfoChar_20 : 320|8@1+ (1,0) [0|255] "ascii" ADAS_DOMAIN
 SG_ RouteInfoChar_21 : 328|8@1+ (1,0) [0|255] "ascii" ADAS_DOMAIN
 SG_ RouteInfoChar_22 : 336|8@1+ (1,0) [0|255] "ascii" ADAS_DOMAIN
 SG_ RouteInfoChar_23 : 344|8@1+ (1,0) [0|255] "ascii" ADAS_DOMAIN
 SG_ RouteInfoChar_24 : 352|8@1+ (1,0) [0|255] "ascii" ADAS_DOMAIN
 SG_ RouteInfoChar_25 : 360|8@1+ (1,0) [0|255] "ascii" ADAS_DOMAIN
 SG_ RouteInfoChar_26 : 368|8@1+ (1,0) [0|255] "ascii" ADAS_DOMAIN
 SG_ RouteInfoChar_27 : 376|8@1+ (1,0) [0|255] "ascii" ADAS_DOMAIN
 SG_ RouteInfoChar_28 : 384|8@1+ (1,0) [0|255] "ascii" ADAS_DOMAIN
 SG_ RouteInfoChar_29 : 392|8@1+ (1,0) [0|255] "ascii" ADAS_DOMAIN
 SG_ RouteInfoChar_30 : 400|8@1+ (1,0) [0|255] "ascii" ADAS_DOMAIN
 SG_ RouteInfoChar_31 : 408|8@1+ (1,0) [0|255] "ascii" ADAS_DOMAIN
 SG_ RouteInfoChar_32 : 416|8@1+ (1,0) [0|255] "ascii" ADAS_DOMAIN
 SG_ RouteInfoChar_33 : 424|8@1+ (1,0) [0|255] "ascii" ADAS_DOMAIN
 SG_ RouteInfoChar_34 : 432|8@1+ (1,0) [0|255] "ascii" ADAS_DOMAIN
 SG_ RouteInfoChar_35 : 440|8@1+ (1,0) [0|255] "ascii" ADAS_DOMAIN
 SG_ RouteInfoChar_36 : 448|8@1+ (1,0) [0|255] "ascii" ADAS_DOMAIN
 SG_ RouteInfoChar_37 : 456|8@1+ (1,0) [0|255] "ascii" ADAS_DOMAIN
 SG_ RouteInfoChar_38 : 464|8@1+ (1,0) [0|255] "ascii" ADAS_DOMAIN
 SG_ RouteInfoChar_39 : 472|8@1+ (1,0) [0|255] "ascii" ADAS_DOMAIN
 SG_ RouteInfoChar_40 : 480|8@1+ (1,0) [0|255] "ascii" ADAS_DOMAIN
 SG_ RouteInfoChar_41 : 488|8@1+ (1,0) [0|255] "ascii" ADAS_DOMAIN
 SG_ RouteInfoChar_42 : 496|8@1+ (1,0) [0|255] "ascii" ADAS_DOMAIN
 SG_ RouteInfoChar_43 : 504|8@1+ (1,0) [0|255] "ascii" ADAS_DOMAIN

CM_ BO_ 392 "Cycle=20ms; Channel=CAN8; CAN-FD; NominalBitrate=500kbit/s; DataBitrate=5000kbit/s;  Data request; receiver answers with response frame; PayloadRouteInfo='BRAKE_CONTROLLER -> ADAS_DOMAIN' in bytes 20-63;";

BO_ 1584 RESP_048_ADAS_DOMAIN_TO_BRAKE_CONTROLLER: 16 ADAS_DOMAIN
 SG_ CRC8 : 0|8@1+ (1,0) [0|255] "" BRAKE_CONTROLLER
 SG_ ResponseCounter : 8|4@1+ (1,0) [0|15] "" BRAKE_CONTROLLER
 SG_ AckState : 12|4@1+ (1,0) [0|15] "" BRAKE_CONTROLLER
 SG_ ReceivedFrameId : 16|11@1+ (1,0) [0|2047] "" BRAKE_CONTROLLER
 SG_ ReceivedCounter : 27|4@1+ (1,0) [0|15] "" BRAKE_CONTROLLER
 SG_ ChecksumOk : 31|1@1+ (1,0) [0|1] "" BRAKE_CONTROLLER
 SG_ PayloadLength : 32|8@1+ (1,0) [0|64] "byte" BRAKE_CONTROLLER
 SG_ ErrorCode : 40|8@1+ (1,0) [0|255] "" BRAKE_CONTROLLER
 SG_ ProcessingTimeUs : 48|16@1+ (1,0) [0|65535] "us" BRAKE_CONTROLLER
 SG_ ResponseSequence : 64|16@1+ (1,0) [0|65535] "" BRAKE_CONTROLLER
 SG_ ReceivedCrc : 80|8@1+ (1,0) [0|255] "" BRAKE_CONTROLLER
 SG_ CalculatedCrc : 88|8@1+ (1,0) [0|255] "" BRAKE_CONTROLLER

CM_ BO_ 1584 "Cycle=20ms; Channel=CAN8; CAN-FD; NominalBitrate=500kbit/s; DataBitrate=5000kbit/s;  ResponseFor=0x188; ACK/NACK with CRC, DLC and counter check;";

BO_ 393 DATA_049_ADAS_MOTION_REQUEST: 64 ADAS_DOMAIN
 SG_ CRC8 : 0|8@1+ (1,0) [0|255] "" VEHICLE_MOTION_CONTROLLER
 SG_ AliveCounter : 8|4@1+ (1,0) [0|15] "" VEHICLE_MOTION_CONTROLLER
 SG_ MuxState : 12|4@1+ (1,0) [0|15] "" VEHICLE_MOTION_CONTROLLER
 SG_ SIG_189_00 : 16|12@1+ (0.1,0.0) [0|4095] "km/h" VEHICLE_MOTION_CONTROLLER
 SG_ SIG_189_01 : 28|12@1+ (0.1,0.0) [0|4095] "obj" VEHICLE_MOTION_CONTROLLER
 SG_ SIG_189_02 : 40|12@1+ (0.1,0.0) [0|4095] "%" VEHICLE_MOTION_CONTROLLER
 SG_ SIG_189_03 : 52|12@1+ (0.1,0.0) [0|4095] "C" VEHICLE_MOTION_CONTROLLER
 SG_ SIG_189_04 : 64|12@1+ (0.1,0.0) [0|4095] "km/h" VEHICLE_MOTION_CONTROLLER
 SG_ SIG_189_05 : 76|12@1+ (0.1,0.0) [0|4095] "A" VEHICLE_MOTION_CONTROLLER
 SG_ SIG_189_06 : 88|12@1+ (0.1,0.0) [0|4095] "V" VEHICLE_MOTION_CONTROLLER
 SG_ SIG_189_07 : 100|12@1+ (0.1,0.0) [0|4095] "%" VEHICLE_MOTION_CONTROLLER
 SG_ SIG_189_08 : 112|12@1+ (0.1,0.0) [0|4095] "%" VEHICLE_MOTION_CONTROLLER
 SG_ SIG_189_09 : 124|12@1+ (0.1,0.0) [0|4095] "m" VEHICLE_MOTION_CONTROLLER
 SG_ SIG_189_10 : 136|12@1+ (0.1,0.0) [0|4095] "m" VEHICLE_MOTION_CONTROLLER
 SG_ SIG_189_11 : 148|12@1+ (0.1,0.0) [0|4095] "obj" VEHICLE_MOTION_CONTROLLER
 SG_ RouteInfoChar_00 : 160|8@1+ (1,0) [0|255] "ascii" VEHICLE_MOTION_CONTROLLER
 SG_ RouteInfoChar_01 : 168|8@1+ (1,0) [0|255] "ascii" VEHICLE_MOTION_CONTROLLER
 SG_ RouteInfoChar_02 : 176|8@1+ (1,0) [0|255] "ascii" VEHICLE_MOTION_CONTROLLER
 SG_ RouteInfoChar_03 : 184|8@1+ (1,0) [0|255] "ascii" VEHICLE_MOTION_CONTROLLER
 SG_ RouteInfoChar_04 : 192|8@1+ (1,0) [0|255] "ascii" VEHICLE_MOTION_CONTROLLER
 SG_ RouteInfoChar_05 : 200|8@1+ (1,0) [0|255] "ascii" VEHICLE_MOTION_CONTROLLER
 SG_ RouteInfoChar_06 : 208|8@1+ (1,0) [0|255] "ascii" VEHICLE_MOTION_CONTROLLER
 SG_ RouteInfoChar_07 : 216|8@1+ (1,0) [0|255] "ascii" VEHICLE_MOTION_CONTROLLER
 SG_ RouteInfoChar_08 : 224|8@1+ (1,0) [0|255] "ascii" VEHICLE_MOTION_CONTROLLER
 SG_ RouteInfoChar_09 : 232|8@1+ (1,0) [0|255] "ascii" VEHICLE_MOTION_CONTROLLER
 SG_ RouteInfoChar_10 : 240|8@1+ (1,0) [0|255] "ascii" VEHICLE_MOTION_CONTROLLER
 SG_ RouteInfoChar_11 : 248|8@1+ (1,0) [0|255] "ascii" VEHICLE_MOTION_CONTROLLER
 SG_ RouteInfoChar_12 : 256|8@1+ (1,0) [0|255] "ascii" VEHICLE_MOTION_CONTROLLER
 SG_ RouteInfoChar_13 : 264|8@1+ (1,0) [0|255] "ascii" VEHICLE_MOTION_CONTROLLER
 SG_ RouteInfoChar_14 : 272|8@1+ (1,0) [0|255] "ascii" VEHICLE_MOTION_CONTROLLER
 SG_ RouteInfoChar_15 : 280|8@1+ (1,0) [0|255] "ascii" VEHICLE_MOTION_CONTROLLER
 SG_ RouteInfoChar_16 : 288|8@1+ (1,0) [0|255] "ascii" VEHICLE_MOTION_CONTROLLER
 SG_ RouteInfoChar_17 : 296|8@1+ (1,0) [0|255] "ascii" VEHICLE_MOTION_CONTROLLER
 SG_ RouteInfoChar_18 : 304|8@1+ (1,0) [0|255] "ascii" VEHICLE_MOTION_CONTROLLER
 SG_ RouteInfoChar_19 : 312|8@1+ (1,0) [0|255] "ascii" VEHICLE_MOTION_CONTROLLER
 SG_ RouteInfoChar_20 : 320|8@1+ (1,0) [0|255] "ascii" VEHICLE_MOTION_CONTROLLER
 SG_ RouteInfoChar_21 : 328|8@1+ (1,0) [0|255] "ascii" VEHICLE_MOTION_CONTROLLER
 SG_ RouteInfoChar_22 : 336|8@1+ (1,0) [0|255] "ascii" VEHICLE_MOTION_CONTROLLER
 SG_ RouteInfoChar_23 : 344|8@1+ (1,0) [0|255] "ascii" VEHICLE_MOTION_CONTROLLER
 SG_ RouteInfoChar_24 : 352|8@1+ (1,0) [0|255] "ascii" VEHICLE_MOTION_CONTROLLER
 SG_ RouteInfoChar_25 : 360|8@1+ (1,0) [0|255] "ascii" VEHICLE_MOTION_CONTROLLER
 SG_ RouteInfoChar_26 : 368|8@1+ (1,0) [0|255] "ascii" VEHICLE_MOTION_CONTROLLER
 SG_ RouteInfoChar_27 : 376|8@1+ (1,0) [0|255] "ascii" VEHICLE_MOTION_CONTROLLER
 SG_ RouteInfoChar_28 : 384|8@1+ (1,0) [0|255] "ascii" VEHICLE_MOTION_CONTROLLER
 SG_ RouteInfoChar_29 : 392|8@1+ (1,0) [0|255] "ascii" VEHICLE_MOTION_CONTROLLER
 SG_ RouteInfoChar_30 : 400|8@1+ (1,0) [0|255] "ascii" VEHICLE_MOTION_CONTROLLER
 SG_ RouteInfoChar_31 : 408|8@1+ (1,0) [0|255] "ascii" VEHICLE_MOTION_CONTROLLER
 SG_ RouteInfoChar_32 : 416|8@1+ (1,0) [0|255] "ascii" VEHICLE_MOTION_CONTROLLER
 SG_ RouteInfoChar_33 : 424|8@1+ (1,0) [0|255] "ascii" VEHICLE_MOTION_CONTROLLER
 SG_ RouteInfoChar_34 : 432|8@1+ (1,0) [0|255] "ascii" VEHICLE_MOTION_CONTROLLER
 SG_ RouteInfoChar_35 : 440|8@1+ (1,0) [0|255] "ascii" VEHICLE_MOTION_CONTROLLER
 SG_ RouteInfoChar_36 : 448|8@1+ (1,0) [0|255] "ascii" VEHICLE_MOTION_CONTROLLER
 SG_ RouteInfoChar_37 : 456|8@1+ (1,0) [0|255] "ascii" VEHICLE_MOTION_CONTROLLER
 SG_ RouteInfoChar_38 : 464|8@1+ (1,0) [0|255] "ascii" VEHICLE_MOTION_CONTROLLER
 SG_ RouteInfoChar_39 : 472|8@1+ (1,0) [0|255] "ascii" VEHICLE_MOTION_CONTROLLER
 SG_ RouteInfoChar_40 : 480|8@1+ (1,0) [0|255] "ascii" VEHICLE_MOTION_CONTROLLER
 SG_ RouteInfoChar_41 : 488|8@1+ (1,0) [0|255] "ascii" VEHICLE_MOTION_CONTROLLER
 SG_ RouteInfoChar_42 : 496|8@1+ (1,0) [0|255] "ascii" VEHICLE_MOTION_CONTROLLER
 SG_ RouteInfoChar_43 : 504|8@1+ (1,0) [0|255] "ascii" VEHICLE_MOTION_CONTROLLER

CM_ BO_ 393 "Cycle=20ms; Channel=CAN9; CAN-FD; NominalBitrate=500kbit/s; DataBitrate=5000kbit/s;  Data request; receiver answers with response frame; PayloadRouteInfo='ADAS_DOMAIN -> VEHICLE_MOTION_CONTROLLER' in bytes 20-63;";

BO_ 1585 RESP_049_VEHICLE_MOTION_CONTROLLER_TO_ADAS_DOMAIN: 16 VEHICLE_MOTION_CONTROLLER
 SG_ CRC8 : 0|8@1+ (1,0) [0|255] "" ADAS_DOMAIN
 SG_ ResponseCounter : 8|4@1+ (1,0) [0|15] "" ADAS_DOMAIN
 SG_ AckState : 12|4@1+ (1,0) [0|15] "" ADAS_DOMAIN
 SG_ ReceivedFrameId : 16|11@1+ (1,0) [0|2047] "" ADAS_DOMAIN
 SG_ ReceivedCounter : 27|4@1+ (1,0) [0|15] "" ADAS_DOMAIN
 SG_ ChecksumOk : 31|1@1+ (1,0) [0|1] "" ADAS_DOMAIN
 SG_ PayloadLength : 32|8@1+ (1,0) [0|64] "byte" ADAS_DOMAIN
 SG_ ErrorCode : 40|8@1+ (1,0) [0|255] "" ADAS_DOMAIN
 SG_ ProcessingTimeUs : 48|16@1+ (1,0) [0|65535] "us" ADAS_DOMAIN
 SG_ ResponseSequence : 64|16@1+ (1,0) [0|65535] "" ADAS_DOMAIN
 SG_ ReceivedCrc : 80|8@1+ (1,0) [0|255] "" ADAS_DOMAIN
 SG_ CalculatedCrc : 88|8@1+ (1,0) [0|255] "" ADAS_DOMAIN

CM_ BO_ 1585 "Cycle=20ms; Channel=CAN9; CAN-FD; NominalBitrate=500kbit/s; DataBitrate=5000kbit/s;  ResponseFor=0x189; ACK/NACK with CRC, DLC and counter check;";

BO_ 416 DATA_050_LIDAR_OBJECT_LIST: 64 LIDAR_FRONT
 SG_ CRC8 : 0|8@1+ (1,0) [0|255] "" ADAS_DOMAIN
 SG_ AliveCounter : 8|4@1+ (1,0) [0|15] "" ADAS_DOMAIN
 SG_ MuxState : 12|4@1+ (1,0) [0|15] "" ADAS_DOMAIN
 SG_ SIG_1A0_00 : 16|12@1+ (0.1,0.0) [0|4095] "Nm" ADAS_DOMAIN
 SG_ SIG_1A0_01 : 28|12@1+ (0.1,0.0) [0|4095] "C" ADAS_DOMAIN
 SG_ SIG_1A0_02 : 40|12@1+ (0.1,0.0) [0|4095] "Nm" ADAS_DOMAIN
 SG_ SIG_1A0_03 : 52|12@1+ (0.1,0.0) [0|4095] "V" ADAS_DOMAIN
 SG_ SIG_1A0_04 : 64|12@1+ (0.1,0.0) [0|4095] "%" ADAS_DOMAIN
 SG_ SIG_1A0_05 : 76|12@1+ (0.1,0.0) [0|4095] "C" ADAS_DOMAIN
 SG_ SIG_1A0_06 : 88|12@1+ (0.1,0.0) [0|4095] "km/h" ADAS_DOMAIN
 SG_ SIG_1A0_07 : 100|12@1+ (0.1,0.0) [0|4095] "%" ADAS_DOMAIN
 SG_ SIG_1A0_08 : 112|12@1+ (0.1,0.0) [0|4095] "A" ADAS_DOMAIN
 SG_ SIG_1A0_09 : 124|12@1+ (0.1,0.0) [0|4095] "%" ADAS_DOMAIN
 SG_ SIG_1A0_10 : 136|12@1+ (0.1,0.0) [0|4095] "deg" ADAS_DOMAIN
 SG_ SIG_1A0_11 : 148|12@1+ (0.1,0.0) [0|4095] "C" ADAS_DOMAIN
 SG_ RouteInfoChar_00 : 160|8@1+ (1,0) [0|255] "ascii" ADAS_DOMAIN
 SG_ RouteInfoChar_01 : 168|8@1+ (1,0) [0|255] "ascii" ADAS_DOMAIN
 SG_ RouteInfoChar_02 : 176|8@1+ (1,0) [0|255] "ascii" ADAS_DOMAIN
 SG_ RouteInfoChar_03 : 184|8@1+ (1,0) [0|255] "ascii" ADAS_DOMAIN
 SG_ RouteInfoChar_04 : 192|8@1+ (1,0) [0|255] "ascii" ADAS_DOMAIN
 SG_ RouteInfoChar_05 : 200|8@1+ (1,0) [0|255] "ascii" ADAS_DOMAIN
 SG_ RouteInfoChar_06 : 208|8@1+ (1,0) [0|255] "ascii" ADAS_DOMAIN
 SG_ RouteInfoChar_07 : 216|8@1+ (1,0) [0|255] "ascii" ADAS_DOMAIN
 SG_ RouteInfoChar_08 : 224|8@1+ (1,0) [0|255] "ascii" ADAS_DOMAIN
 SG_ RouteInfoChar_09 : 232|8@1+ (1,0) [0|255] "ascii" ADAS_DOMAIN
 SG_ RouteInfoChar_10 : 240|8@1+ (1,0) [0|255] "ascii" ADAS_DOMAIN
 SG_ RouteInfoChar_11 : 248|8@1+ (1,0) [0|255] "ascii" ADAS_DOMAIN
 SG_ RouteInfoChar_12 : 256|8@1+ (1,0) [0|255] "ascii" ADAS_DOMAIN
 SG_ RouteInfoChar_13 : 264|8@1+ (1,0) [0|255] "ascii" ADAS_DOMAIN
 SG_ RouteInfoChar_14 : 272|8@1+ (1,0) [0|255] "ascii" ADAS_DOMAIN
 SG_ RouteInfoChar_15 : 280|8@1+ (1,0) [0|255] "ascii" ADAS_DOMAIN
 SG_ RouteInfoChar_16 : 288|8@1+ (1,0) [0|255] "ascii" ADAS_DOMAIN
 SG_ RouteInfoChar_17 : 296|8@1+ (1,0) [0|255] "ascii" ADAS_DOMAIN
 SG_ RouteInfoChar_18 : 304|8@1+ (1,0) [0|255] "ascii" ADAS_DOMAIN
 SG_ RouteInfoChar_19 : 312|8@1+ (1,0) [0|255] "ascii" ADAS_DOMAIN
 SG_ RouteInfoChar_20 : 320|8@1+ (1,0) [0|255] "ascii" ADAS_DOMAIN
 SG_ RouteInfoChar_21 : 328|8@1+ (1,0) [0|255] "ascii" ADAS_DOMAIN
 SG_ RouteInfoChar_22 : 336|8@1+ (1,0) [0|255] "ascii" ADAS_DOMAIN
 SG_ RouteInfoChar_23 : 344|8@1+ (1,0) [0|255] "ascii" ADAS_DOMAIN
 SG_ RouteInfoChar_24 : 352|8@1+ (1,0) [0|255] "ascii" ADAS_DOMAIN
 SG_ RouteInfoChar_25 : 360|8@1+ (1,0) [0|255] "ascii" ADAS_DOMAIN
 SG_ RouteInfoChar_26 : 368|8@1+ (1,0) [0|255] "ascii" ADAS_DOMAIN
 SG_ RouteInfoChar_27 : 376|8@1+ (1,0) [0|255] "ascii" ADAS_DOMAIN
 SG_ RouteInfoChar_28 : 384|8@1+ (1,0) [0|255] "ascii" ADAS_DOMAIN
 SG_ RouteInfoChar_29 : 392|8@1+ (1,0) [0|255] "ascii" ADAS_DOMAIN
 SG_ RouteInfoChar_30 : 400|8@1+ (1,0) [0|255] "ascii" ADAS_DOMAIN
 SG_ RouteInfoChar_31 : 408|8@1+ (1,0) [0|255] "ascii" ADAS_DOMAIN
 SG_ RouteInfoChar_32 : 416|8@1+ (1,0) [0|255] "ascii" ADAS_DOMAIN
 SG_ RouteInfoChar_33 : 424|8@1+ (1,0) [0|255] "ascii" ADAS_DOMAIN
 SG_ RouteInfoChar_34 : 432|8@1+ (1,0) [0|255] "ascii" ADAS_DOMAIN
 SG_ RouteInfoChar_35 : 440|8@1+ (1,0) [0|255] "ascii" ADAS_DOMAIN
 SG_ RouteInfoChar_36 : 448|8@1+ (1,0) [0|255] "ascii" ADAS_DOMAIN
 SG_ RouteInfoChar_37 : 456|8@1+ (1,0) [0|255] "ascii" ADAS_DOMAIN
 SG_ RouteInfoChar_38 : 464|8@1+ (1,0) [0|255] "ascii" ADAS_DOMAIN
 SG_ RouteInfoChar_39 : 472|8@1+ (1,0) [0|255] "ascii" ADAS_DOMAIN
 SG_ RouteInfoChar_40 : 480|8@1+ (1,0) [0|255] "ascii" ADAS_DOMAIN
 SG_ RouteInfoChar_41 : 488|8@1+ (1,0) [0|255] "ascii" ADAS_DOMAIN
 SG_ RouteInfoChar_42 : 496|8@1+ (1,0) [0|255] "ascii" ADAS_DOMAIN
 SG_ RouteInfoChar_43 : 504|8@1+ (1,0) [0|255] "ascii" ADAS_DOMAIN

CM_ BO_ 416 "Cycle=20ms; Channel=CAN0; CAN-FD; NominalBitrate=500kbit/s; DataBitrate=5000kbit/s;  Data request; receiver answers with response frame; PayloadRouteInfo='LIDAR_FRONT -> ADAS_DOMAIN' in bytes 20-63; Gateway to CAN1";

BO_ 1586 RESP_050_ADAS_DOMAIN_TO_LIDAR_FRONT: 16 ADAS_DOMAIN
 SG_ CRC8 : 0|8@1+ (1,0) [0|255] "" LIDAR_FRONT
 SG_ ResponseCounter : 8|4@1+ (1,0) [0|15] "" LIDAR_FRONT
 SG_ AckState : 12|4@1+ (1,0) [0|15] "" LIDAR_FRONT
 SG_ ReceivedFrameId : 16|11@1+ (1,0) [0|2047] "" LIDAR_FRONT
 SG_ ReceivedCounter : 27|4@1+ (1,0) [0|15] "" LIDAR_FRONT
 SG_ ChecksumOk : 31|1@1+ (1,0) [0|1] "" LIDAR_FRONT
 SG_ PayloadLength : 32|8@1+ (1,0) [0|64] "byte" LIDAR_FRONT
 SG_ ErrorCode : 40|8@1+ (1,0) [0|255] "" LIDAR_FRONT
 SG_ ProcessingTimeUs : 48|16@1+ (1,0) [0|65535] "us" LIDAR_FRONT
 SG_ ResponseSequence : 64|16@1+ (1,0) [0|65535] "" LIDAR_FRONT
 SG_ ReceivedCrc : 80|8@1+ (1,0) [0|255] "" LIDAR_FRONT
 SG_ CalculatedCrc : 88|8@1+ (1,0) [0|255] "" LIDAR_FRONT

CM_ BO_ 1586 "Cycle=20ms; Channel=CAN0; CAN-FD; NominalBitrate=500kbit/s; DataBitrate=5000kbit/s;  ResponseFor=0x1A0; ACK/NACK with CRC, DLC and counter check;";

BO_ 417 DATA_051_CAMERA_LANE_MODEL: 64 CAMERA_FRONT_WIDE
 SG_ CRC8 : 0|8@1+ (1,0) [0|255] "" ADAS_DOMAIN
 SG_ AliveCounter : 8|4@1+ (1,0) [0|15] "" ADAS_DOMAIN
 SG_ MuxState : 12|4@1+ (1,0) [0|15] "" ADAS_DOMAIN
 SG_ SIG_1A1_00 : 16|12@1+ (0.1,0.0) [0|4095] "deg" ADAS_DOMAIN
 SG_ SIG_1A1_01 : 28|12@1+ (0.1,0.0) [0|4095] "obj" ADAS_DOMAIN
 SG_ SIG_1A1_02 : 40|12@1+ (0.1,0.0) [0|4095] "m" ADAS_DOMAIN
 SG_ SIG_1A1_03 : 52|12@1+ (0.1,0.0) [0|4095] "km/h" ADAS_DOMAIN
 SG_ SIG_1A1_04 : 64|12@1+ (0.1,0.0) [0|4095] "%" ADAS_DOMAIN
 SG_ SIG_1A1_05 : 76|12@1+ (0.1,0.0) [0|4095] "obj" ADAS_DOMAIN
 SG_ SIG_1A1_06 : 88|12@1+ (0.1,0.0) [0|4095] "obj" ADAS_DOMAIN
 SG_ SIG_1A1_07 : 100|12@1+ (0.1,0.0) [0|4095] "km/h" ADAS_DOMAIN
 SG_ SIG_1A1_08 : 112|12@1+ (0.1,0.0) [0|4095] "rpm" ADAS_DOMAIN
 SG_ SIG_1A1_09 : 124|12@1+ (0.1,0.0) [0|4095] "%" ADAS_DOMAIN
 SG_ SIG_1A1_10 : 136|12@1+ (0.1,0.0) [0|4095] "deg" ADAS_DOMAIN
 SG_ SIG_1A1_11 : 148|12@1+ (0.1,0.0) [0|4095] "C" ADAS_DOMAIN
 SG_ RouteInfoChar_00 : 160|8@1+ (1,0) [0|255] "ascii" ADAS_DOMAIN
 SG_ RouteInfoChar_01 : 168|8@1+ (1,0) [0|255] "ascii" ADAS_DOMAIN
 SG_ RouteInfoChar_02 : 176|8@1+ (1,0) [0|255] "ascii" ADAS_DOMAIN
 SG_ RouteInfoChar_03 : 184|8@1+ (1,0) [0|255] "ascii" ADAS_DOMAIN
 SG_ RouteInfoChar_04 : 192|8@1+ (1,0) [0|255] "ascii" ADAS_DOMAIN
 SG_ RouteInfoChar_05 : 200|8@1+ (1,0) [0|255] "ascii" ADAS_DOMAIN
 SG_ RouteInfoChar_06 : 208|8@1+ (1,0) [0|255] "ascii" ADAS_DOMAIN
 SG_ RouteInfoChar_07 : 216|8@1+ (1,0) [0|255] "ascii" ADAS_DOMAIN
 SG_ RouteInfoChar_08 : 224|8@1+ (1,0) [0|255] "ascii" ADAS_DOMAIN
 SG_ RouteInfoChar_09 : 232|8@1+ (1,0) [0|255] "ascii" ADAS_DOMAIN
 SG_ RouteInfoChar_10 : 240|8@1+ (1,0) [0|255] "ascii" ADAS_DOMAIN
 SG_ RouteInfoChar_11 : 248|8@1+ (1,0) [0|255] "ascii" ADAS_DOMAIN
 SG_ RouteInfoChar_12 : 256|8@1+ (1,0) [0|255] "ascii" ADAS_DOMAIN
 SG_ RouteInfoChar_13 : 264|8@1+ (1,0) [0|255] "ascii" ADAS_DOMAIN
 SG_ RouteInfoChar_14 : 272|8@1+ (1,0) [0|255] "ascii" ADAS_DOMAIN
 SG_ RouteInfoChar_15 : 280|8@1+ (1,0) [0|255] "ascii" ADAS_DOMAIN
 SG_ RouteInfoChar_16 : 288|8@1+ (1,0) [0|255] "ascii" ADAS_DOMAIN
 SG_ RouteInfoChar_17 : 296|8@1+ (1,0) [0|255] "ascii" ADAS_DOMAIN
 SG_ RouteInfoChar_18 : 304|8@1+ (1,0) [0|255] "ascii" ADAS_DOMAIN
 SG_ RouteInfoChar_19 : 312|8@1+ (1,0) [0|255] "ascii" ADAS_DOMAIN
 SG_ RouteInfoChar_20 : 320|8@1+ (1,0) [0|255] "ascii" ADAS_DOMAIN
 SG_ RouteInfoChar_21 : 328|8@1+ (1,0) [0|255] "ascii" ADAS_DOMAIN
 SG_ RouteInfoChar_22 : 336|8@1+ (1,0) [0|255] "ascii" ADAS_DOMAIN
 SG_ RouteInfoChar_23 : 344|8@1+ (1,0) [0|255] "ascii" ADAS_DOMAIN
 SG_ RouteInfoChar_24 : 352|8@1+ (1,0) [0|255] "ascii" ADAS_DOMAIN
 SG_ RouteInfoChar_25 : 360|8@1+ (1,0) [0|255] "ascii" ADAS_DOMAIN
 SG_ RouteInfoChar_26 : 368|8@1+ (1,0) [0|255] "ascii" ADAS_DOMAIN
 SG_ RouteInfoChar_27 : 376|8@1+ (1,0) [0|255] "ascii" ADAS_DOMAIN
 SG_ RouteInfoChar_28 : 384|8@1+ (1,0) [0|255] "ascii" ADAS_DOMAIN
 SG_ RouteInfoChar_29 : 392|8@1+ (1,0) [0|255] "ascii" ADAS_DOMAIN
 SG_ RouteInfoChar_30 : 400|8@1+ (1,0) [0|255] "ascii" ADAS_DOMAIN
 SG_ RouteInfoChar_31 : 408|8@1+ (1,0) [0|255] "ascii" ADAS_DOMAIN
 SG_ RouteInfoChar_32 : 416|8@1+ (1,0) [0|255] "ascii" ADAS_DOMAIN
 SG_ RouteInfoChar_33 : 424|8@1+ (1,0) [0|255] "ascii" ADAS_DOMAIN
 SG_ RouteInfoChar_34 : 432|8@1+ (1,0) [0|255] "ascii" ADAS_DOMAIN
 SG_ RouteInfoChar_35 : 440|8@1+ (1,0) [0|255] "ascii" ADAS_DOMAIN
 SG_ RouteInfoChar_36 : 448|8@1+ (1,0) [0|255] "ascii" ADAS_DOMAIN
 SG_ RouteInfoChar_37 : 456|8@1+ (1,0) [0|255] "ascii" ADAS_DOMAIN
 SG_ RouteInfoChar_38 : 464|8@1+ (1,0) [0|255] "ascii" ADAS_DOMAIN
 SG_ RouteInfoChar_39 : 472|8@1+ (1,0) [0|255] "ascii" ADAS_DOMAIN
 SG_ RouteInfoChar_40 : 480|8@1+ (1,0) [0|255] "ascii" ADAS_DOMAIN
 SG_ RouteInfoChar_41 : 488|8@1+ (1,0) [0|255] "ascii" ADAS_DOMAIN
 SG_ RouteInfoChar_42 : 496|8@1+ (1,0) [0|255] "ascii" ADAS_DOMAIN
 SG_ RouteInfoChar_43 : 504|8@1+ (1,0) [0|255] "ascii" ADAS_DOMAIN

CM_ BO_ 417 "Cycle=33ms; Channel=CAN1; CAN-FD; NominalBitrate=500kbit/s; DataBitrate=5000kbit/s;  Data request; receiver answers with response frame; PayloadRouteInfo='CAMERA_FRONT_WIDE -> ADAS_DOMAIN' in bytes 20-63;";

BO_ 1587 RESP_051_ADAS_DOMAIN_TO_CAMERA_FRONT_WIDE: 16 ADAS_DOMAIN
 SG_ CRC8 : 0|8@1+ (1,0) [0|255] "" CAMERA_FRONT_WIDE
 SG_ ResponseCounter : 8|4@1+ (1,0) [0|15] "" CAMERA_FRONT_WIDE
 SG_ AckState : 12|4@1+ (1,0) [0|15] "" CAMERA_FRONT_WIDE
 SG_ ReceivedFrameId : 16|11@1+ (1,0) [0|2047] "" CAMERA_FRONT_WIDE
 SG_ ReceivedCounter : 27|4@1+ (1,0) [0|15] "" CAMERA_FRONT_WIDE
 SG_ ChecksumOk : 31|1@1+ (1,0) [0|1] "" CAMERA_FRONT_WIDE
 SG_ PayloadLength : 32|8@1+ (1,0) [0|64] "byte" CAMERA_FRONT_WIDE
 SG_ ErrorCode : 40|8@1+ (1,0) [0|255] "" CAMERA_FRONT_WIDE
 SG_ ProcessingTimeUs : 48|16@1+ (1,0) [0|65535] "us" CAMERA_FRONT_WIDE
 SG_ ResponseSequence : 64|16@1+ (1,0) [0|65535] "" CAMERA_FRONT_WIDE
 SG_ ReceivedCrc : 80|8@1+ (1,0) [0|255] "" CAMERA_FRONT_WIDE
 SG_ CalculatedCrc : 88|8@1+ (1,0) [0|255] "" CAMERA_FRONT_WIDE

CM_ BO_ 1587 "Cycle=33ms; Channel=CAN1; CAN-FD; NominalBitrate=500kbit/s; DataBitrate=5000kbit/s;  ResponseFor=0x1A1; ACK/NACK with CRC, DLC and counter check;";

BO_ 418 DATA_052_RADAR_TARGET_LIST: 64 RADAR_FRONT_LONG_RANGE
 SG_ CRC8 : 0|8@1+ (1,0) [0|255] "" ADAS_DOMAIN
 SG_ AliveCounter : 8|4@1+ (1,0) [0|15] "" ADAS_DOMAIN
 SG_ MuxState : 12|4@1+ (1,0) [0|15] "" ADAS_DOMAIN
 SG_ SIG_1A2_00 : 16|12@1+ (0.1,0.0) [0|4095] "deg" ADAS_DOMAIN
 SG_ SIG_1A2_01 : 28|12@1+ (0.1,0.0) [0|4095] "km/h" ADAS_DOMAIN
 SG_ SIG_1A2_02 : 40|12@1+ (0.1,0.0) [0|4095] "V" ADAS_DOMAIN
 SG_ SIG_1A2_03 : 52|12@1+ (0.1,0.0) [0|4095] "%" ADAS_DOMAIN
 SG_ SIG_1A2_04 : 64|12@1+ (0.1,0.0) [0|4095] "A" ADAS_DOMAIN
 SG_ SIG_1A2_05 : 76|12@1+ (0.1,0.0) [0|4095] "Nm" ADAS_DOMAIN
 SG_ SIG_1A2_06 : 88|12@1+ (0.1,0.0) [0|4095] "C" ADAS_DOMAIN
 SG_ SIG_1A2_07 : 100|12@1+ (0.1,0.0) [0|4095] "A" ADAS_DOMAIN
 SG_ SIG_1A2_08 : 112|12@1+ (0.1,0.0) [0|4095] "A" ADAS_DOMAIN
 SG_ SIG_1A2_09 : 124|12@1+ (0.1,0.0) [0|4095] "%" ADAS_DOMAIN
 SG_ SIG_1A2_10 : 136|12@1+ (0.1,0.0) [0|4095] "V" ADAS_DOMAIN
 SG_ SIG_1A2_11 : 148|12@1+ (0.1,0.0) [0|4095] "%" ADAS_DOMAIN
 SG_ RouteInfoChar_00 : 160|8@1+ (1,0) [0|255] "ascii" ADAS_DOMAIN
 SG_ RouteInfoChar_01 : 168|8@1+ (1,0) [0|255] "ascii" ADAS_DOMAIN
 SG_ RouteInfoChar_02 : 176|8@1+ (1,0) [0|255] "ascii" ADAS_DOMAIN
 SG_ RouteInfoChar_03 : 184|8@1+ (1,0) [0|255] "ascii" ADAS_DOMAIN
 SG_ RouteInfoChar_04 : 192|8@1+ (1,0) [0|255] "ascii" ADAS_DOMAIN
 SG_ RouteInfoChar_05 : 200|8@1+ (1,0) [0|255] "ascii" ADAS_DOMAIN
 SG_ RouteInfoChar_06 : 208|8@1+ (1,0) [0|255] "ascii" ADAS_DOMAIN
 SG_ RouteInfoChar_07 : 216|8@1+ (1,0) [0|255] "ascii" ADAS_DOMAIN
 SG_ RouteInfoChar_08 : 224|8@1+ (1,0) [0|255] "ascii" ADAS_DOMAIN
 SG_ RouteInfoChar_09 : 232|8@1+ (1,0) [0|255] "ascii" ADAS_DOMAIN
 SG_ RouteInfoChar_10 : 240|8@1+ (1,0) [0|255] "ascii" ADAS_DOMAIN
 SG_ RouteInfoChar_11 : 248|8@1+ (1,0) [0|255] "ascii" ADAS_DOMAIN
 SG_ RouteInfoChar_12 : 256|8@1+ (1,0) [0|255] "ascii" ADAS_DOMAIN
 SG_ RouteInfoChar_13 : 264|8@1+ (1,0) [0|255] "ascii" ADAS_DOMAIN
 SG_ RouteInfoChar_14 : 272|8@1+ (1,0) [0|255] "ascii" ADAS_DOMAIN
 SG_ RouteInfoChar_15 : 280|8@1+ (1,0) [0|255] "ascii" ADAS_DOMAIN
 SG_ RouteInfoChar_16 : 288|8@1+ (1,0) [0|255] "ascii" ADAS_DOMAIN
 SG_ RouteInfoChar_17 : 296|8@1+ (1,0) [0|255] "ascii" ADAS_DOMAIN
 SG_ RouteInfoChar_18 : 304|8@1+ (1,0) [0|255] "ascii" ADAS_DOMAIN
 SG_ RouteInfoChar_19 : 312|8@1+ (1,0) [0|255] "ascii" ADAS_DOMAIN
 SG_ RouteInfoChar_20 : 320|8@1+ (1,0) [0|255] "ascii" ADAS_DOMAIN
 SG_ RouteInfoChar_21 : 328|8@1+ (1,0) [0|255] "ascii" ADAS_DOMAIN
 SG_ RouteInfoChar_22 : 336|8@1+ (1,0) [0|255] "ascii" ADAS_DOMAIN
 SG_ RouteInfoChar_23 : 344|8@1+ (1,0) [0|255] "ascii" ADAS_DOMAIN
 SG_ RouteInfoChar_24 : 352|8@1+ (1,0) [0|255] "ascii" ADAS_DOMAIN
 SG_ RouteInfoChar_25 : 360|8@1+ (1,0) [0|255] "ascii" ADAS_DOMAIN
 SG_ RouteInfoChar_26 : 368|8@1+ (1,0) [0|255] "ascii" ADAS_DOMAIN
 SG_ RouteInfoChar_27 : 376|8@1+ (1,0) [0|255] "ascii" ADAS_DOMAIN
 SG_ RouteInfoChar_28 : 384|8@1+ (1,0) [0|255] "ascii" ADAS_DOMAIN
 SG_ RouteInfoChar_29 : 392|8@1+ (1,0) [0|255] "ascii" ADAS_DOMAIN
 SG_ RouteInfoChar_30 : 400|8@1+ (1,0) [0|255] "ascii" ADAS_DOMAIN
 SG_ RouteInfoChar_31 : 408|8@1+ (1,0) [0|255] "ascii" ADAS_DOMAIN
 SG_ RouteInfoChar_32 : 416|8@1+ (1,0) [0|255] "ascii" ADAS_DOMAIN
 SG_ RouteInfoChar_33 : 424|8@1+ (1,0) [0|255] "ascii" ADAS_DOMAIN
 SG_ RouteInfoChar_34 : 432|8@1+ (1,0) [0|255] "ascii" ADAS_DOMAIN
 SG_ RouteInfoChar_35 : 440|8@1+ (1,0) [0|255] "ascii" ADAS_DOMAIN
 SG_ RouteInfoChar_36 : 448|8@1+ (1,0) [0|255] "ascii" ADAS_DOMAIN
 SG_ RouteInfoChar_37 : 456|8@1+ (1,0) [0|255] "ascii" ADAS_DOMAIN
 SG_ RouteInfoChar_38 : 464|8@1+ (1,0) [0|255] "ascii" ADAS_DOMAIN
 SG_ RouteInfoChar_39 : 472|8@1+ (1,0) [0|255] "ascii" ADAS_DOMAIN
 SG_ RouteInfoChar_40 : 480|8@1+ (1,0) [0|255] "ascii" ADAS_DOMAIN
 SG_ RouteInfoChar_41 : 488|8@1+ (1,0) [0|255] "ascii" ADAS_DOMAIN
 SG_ RouteInfoChar_42 : 496|8@1+ (1,0) [0|255] "ascii" ADAS_DOMAIN
 SG_ RouteInfoChar_43 : 504|8@1+ (1,0) [0|255] "ascii" ADAS_DOMAIN

CM_ BO_ 418 "Cycle=20ms; Channel=CAN2; CAN-FD; NominalBitrate=500kbit/s; DataBitrate=5000kbit/s;  Data request; receiver answers with response frame; PayloadRouteInfo='RADAR_FRONT_LONG_RANGE -> ADAS_DOMAIN' in bytes 20-63;";

BO_ 1588 RESP_052_ADAS_DOMAIN_TO_RADAR_FRONT_LONG_RANGE: 16 ADAS_DOMAIN
 SG_ CRC8 : 0|8@1+ (1,0) [0|255] "" RADAR_FRONT_LONG_RANGE
 SG_ ResponseCounter : 8|4@1+ (1,0) [0|15] "" RADAR_FRONT_LONG_RANGE
 SG_ AckState : 12|4@1+ (1,0) [0|15] "" RADAR_FRONT_LONG_RANGE
 SG_ ReceivedFrameId : 16|11@1+ (1,0) [0|2047] "" RADAR_FRONT_LONG_RANGE
 SG_ ReceivedCounter : 27|4@1+ (1,0) [0|15] "" RADAR_FRONT_LONG_RANGE
 SG_ ChecksumOk : 31|1@1+ (1,0) [0|1] "" RADAR_FRONT_LONG_RANGE
 SG_ PayloadLength : 32|8@1+ (1,0) [0|64] "byte" RADAR_FRONT_LONG_RANGE
 SG_ ErrorCode : 40|8@1+ (1,0) [0|255] "" RADAR_FRONT_LONG_RANGE
 SG_ ProcessingTimeUs : 48|16@1+ (1,0) [0|65535] "us" RADAR_FRONT_LONG_RANGE
 SG_ ResponseSequence : 64|16@1+ (1,0) [0|65535] "" RADAR_FRONT_LONG_RANGE
 SG_ ReceivedCrc : 80|8@1+ (1,0) [0|255] "" RADAR_FRONT_LONG_RANGE
 SG_ CalculatedCrc : 88|8@1+ (1,0) [0|255] "" RADAR_FRONT_LONG_RANGE

CM_ BO_ 1588 "Cycle=20ms; Channel=CAN2; CAN-FD; NominalBitrate=500kbit/s; DataBitrate=5000kbit/s;  ResponseFor=0x1A2; ACK/NACK with CRC, DLC and counter check;";

BO_ 419 DATA_053_REAR_CROSS_TRAFFIC: 64 RADAR_REAR_CROSS_TRAFFIC
 SG_ CRC8 : 0|8@1+ (1,0) [0|255] "" ADAS_DOMAIN
 SG_ AliveCounter : 8|4@1+ (1,0) [0|15] "" ADAS_DOMAIN
 SG_ MuxState : 12|4@1+ (1,0) [0|15] "" ADAS_DOMAIN
 SG_ SIG_1A3_00 : 16|12@1+ (0.1,0.0) [0|4095] "V" ADAS_DOMAIN
 SG_ SIG_1A3_01 : 28|12@1+ (0.1,0.0) [0|4095] "rpm" ADAS_DOMAIN
 SG_ SIG_1A3_02 : 40|12@1+ (0.1,0.0) [0|4095] "C" ADAS_DOMAIN
 SG_ SIG_1A3_03 : 52|12@1+ (0.1,0.0) [0|4095] "km/h" ADAS_DOMAIN
 SG_ SIG_1A3_04 : 64|12@1+ (0.1,0.0) [0|4095] "m" ADAS_DOMAIN
 SG_ SIG_1A3_05 : 76|12@1+ (0.1,0.0) [0|4095] "km/h" ADAS_DOMAIN
 SG_ SIG_1A3_06 : 88|12@1+ (0.1,0.0) [0|4095] "A" ADAS_DOMAIN
 SG_ SIG_1A3_07 : 100|12@1+ (0.1,0.0) [0|4095] "Nm" ADAS_DOMAIN
 SG_ SIG_1A3_08 : 112|12@1+ (0.1,0.0) [0|4095] "rpm" ADAS_DOMAIN
 SG_ SIG_1A3_09 : 124|12@1+ (0.1,0.0) [0|4095] "km/h" ADAS_DOMAIN
 SG_ SIG_1A3_10 : 136|12@1+ (0.1,0.0) [0|4095] "km/h" ADAS_DOMAIN
 SG_ SIG_1A3_11 : 148|12@1+ (0.1,0.0) [0|4095] "Nm" ADAS_DOMAIN
 SG_ RouteInfoChar_00 : 160|8@1+ (1,0) [0|255] "ascii" ADAS_DOMAIN
 SG_ RouteInfoChar_01 : 168|8@1+ (1,0) [0|255] "ascii" ADAS_DOMAIN
 SG_ RouteInfoChar_02 : 176|8@1+ (1,0) [0|255] "ascii" ADAS_DOMAIN
 SG_ RouteInfoChar_03 : 184|8@1+ (1,0) [0|255] "ascii" ADAS_DOMAIN
 SG_ RouteInfoChar_04 : 192|8@1+ (1,0) [0|255] "ascii" ADAS_DOMAIN
 SG_ RouteInfoChar_05 : 200|8@1+ (1,0) [0|255] "ascii" ADAS_DOMAIN
 SG_ RouteInfoChar_06 : 208|8@1+ (1,0) [0|255] "ascii" ADAS_DOMAIN
 SG_ RouteInfoChar_07 : 216|8@1+ (1,0) [0|255] "ascii" ADAS_DOMAIN
 SG_ RouteInfoChar_08 : 224|8@1+ (1,0) [0|255] "ascii" ADAS_DOMAIN
 SG_ RouteInfoChar_09 : 232|8@1+ (1,0) [0|255] "ascii" ADAS_DOMAIN
 SG_ RouteInfoChar_10 : 240|8@1+ (1,0) [0|255] "ascii" ADAS_DOMAIN
 SG_ RouteInfoChar_11 : 248|8@1+ (1,0) [0|255] "ascii" ADAS_DOMAIN
 SG_ RouteInfoChar_12 : 256|8@1+ (1,0) [0|255] "ascii" ADAS_DOMAIN
 SG_ RouteInfoChar_13 : 264|8@1+ (1,0) [0|255] "ascii" ADAS_DOMAIN
 SG_ RouteInfoChar_14 : 272|8@1+ (1,0) [0|255] "ascii" ADAS_DOMAIN
 SG_ RouteInfoChar_15 : 280|8@1+ (1,0) [0|255] "ascii" ADAS_DOMAIN
 SG_ RouteInfoChar_16 : 288|8@1+ (1,0) [0|255] "ascii" ADAS_DOMAIN
 SG_ RouteInfoChar_17 : 296|8@1+ (1,0) [0|255] "ascii" ADAS_DOMAIN
 SG_ RouteInfoChar_18 : 304|8@1+ (1,0) [0|255] "ascii" ADAS_DOMAIN
 SG_ RouteInfoChar_19 : 312|8@1+ (1,0) [0|255] "ascii" ADAS_DOMAIN
 SG_ RouteInfoChar_20 : 320|8@1+ (1,0) [0|255] "ascii" ADAS_DOMAIN
 SG_ RouteInfoChar_21 : 328|8@1+ (1,0) [0|255] "ascii" ADAS_DOMAIN
 SG_ RouteInfoChar_22 : 336|8@1+ (1,0) [0|255] "ascii" ADAS_DOMAIN
 SG_ RouteInfoChar_23 : 344|8@1+ (1,0) [0|255] "ascii" ADAS_DOMAIN
 SG_ RouteInfoChar_24 : 352|8@1+ (1,0) [0|255] "ascii" ADAS_DOMAIN
 SG_ RouteInfoChar_25 : 360|8@1+ (1,0) [0|255] "ascii" ADAS_DOMAIN
 SG_ RouteInfoChar_26 : 368|8@1+ (1,0) [0|255] "ascii" ADAS_DOMAIN
 SG_ RouteInfoChar_27 : 376|8@1+ (1,0) [0|255] "ascii" ADAS_DOMAIN
 SG_ RouteInfoChar_28 : 384|8@1+ (1,0) [0|255] "ascii" ADAS_DOMAIN
 SG_ RouteInfoChar_29 : 392|8@1+ (1,0) [0|255] "ascii" ADAS_DOMAIN
 SG_ RouteInfoChar_30 : 400|8@1+ (1,0) [0|255] "ascii" ADAS_DOMAIN
 SG_ RouteInfoChar_31 : 408|8@1+ (1,0) [0|255] "ascii" ADAS_DOMAIN
 SG_ RouteInfoChar_32 : 416|8@1+ (1,0) [0|255] "ascii" ADAS_DOMAIN
 SG_ RouteInfoChar_33 : 424|8@1+ (1,0) [0|255] "ascii" ADAS_DOMAIN
 SG_ RouteInfoChar_34 : 432|8@1+ (1,0) [0|255] "ascii" ADAS_DOMAIN
 SG_ RouteInfoChar_35 : 440|8@1+ (1,0) [0|255] "ascii" ADAS_DOMAIN
 SG_ RouteInfoChar_36 : 448|8@1+ (1,0) [0|255] "ascii" ADAS_DOMAIN
 SG_ RouteInfoChar_37 : 456|8@1+ (1,0) [0|255] "ascii" ADAS_DOMAIN
 SG_ RouteInfoChar_38 : 464|8@1+ (1,0) [0|255] "ascii" ADAS_DOMAIN
 SG_ RouteInfoChar_39 : 472|8@1+ (1,0) [0|255] "ascii" ADAS_DOMAIN
 SG_ RouteInfoChar_40 : 480|8@1+ (1,0) [0|255] "ascii" ADAS_DOMAIN
 SG_ RouteInfoChar_41 : 488|8@1+ (1,0) [0|255] "ascii" ADAS_DOMAIN
 SG_ RouteInfoChar_42 : 496|8@1+ (1,0) [0|255] "ascii" ADAS_DOMAIN
 SG_ RouteInfoChar_43 : 504|8@1+ (1,0) [0|255] "ascii" ADAS_DOMAIN

CM_ BO_ 419 "Cycle=50ms; Channel=CAN3; CAN-FD; NominalBitrate=500kbit/s; DataBitrate=5000kbit/s;  Data request; receiver answers with response frame; PayloadRouteInfo='RADAR_REAR_CROSS_TRAFFIC -> ADAS_DOMAIN' in bytes 20-63;";

BO_ 1589 RESP_053_ADAS_DOMAIN_TO_RADAR_REAR_CROSS_TRAFFIC: 16 ADAS_DOMAIN
 SG_ CRC8 : 0|8@1+ (1,0) [0|255] "" RADAR_REAR_CROSS_TRAFFIC
 SG_ ResponseCounter : 8|4@1+ (1,0) [0|15] "" RADAR_REAR_CROSS_TRAFFIC
 SG_ AckState : 12|4@1+ (1,0) [0|15] "" RADAR_REAR_CROSS_TRAFFIC
 SG_ ReceivedFrameId : 16|11@1+ (1,0) [0|2047] "" RADAR_REAR_CROSS_TRAFFIC
 SG_ ReceivedCounter : 27|4@1+ (1,0) [0|15] "" RADAR_REAR_CROSS_TRAFFIC
 SG_ ChecksumOk : 31|1@1+ (1,0) [0|1] "" RADAR_REAR_CROSS_TRAFFIC
 SG_ PayloadLength : 32|8@1+ (1,0) [0|64] "byte" RADAR_REAR_CROSS_TRAFFIC
 SG_ ErrorCode : 40|8@1+ (1,0) [0|255] "" RADAR_REAR_CROSS_TRAFFIC
 SG_ ProcessingTimeUs : 48|16@1+ (1,0) [0|65535] "us" RADAR_REAR_CROSS_TRAFFIC
 SG_ ResponseSequence : 64|16@1+ (1,0) [0|65535] "" RADAR_REAR_CROSS_TRAFFIC
 SG_ ReceivedCrc : 80|8@1+ (1,0) [0|255] "" RADAR_REAR_CROSS_TRAFFIC
 SG_ CalculatedCrc : 88|8@1+ (1,0) [0|255] "" RADAR_REAR_CROSS_TRAFFIC

CM_ BO_ 1589 "Cycle=50ms; Channel=CAN3; CAN-FD; NominalBitrate=500kbit/s; DataBitrate=5000kbit/s;  ResponseFor=0x1A3; ACK/NACK with CRC, DLC and counter check;";

BO_ 420 DATA_054_ULTRASONIC_LEFT_DISTANCE: 64 ULTRASONIC_LEFT_CLUSTER
 SG_ CRC8 : 0|8@1+ (1,0) [0|255] "" PARK_ASSIST
 SG_ AliveCounter : 8|4@1+ (1,0) [0|15] "" PARK_ASSIST
 SG_ MuxState : 12|4@1+ (1,0) [0|15] "" PARK_ASSIST
 SG_ SIG_1A4_00 : 16|12@1+ (0.1,0.0) [0|4095] "Nm" PARK_ASSIST
 SG_ SIG_1A4_01 : 28|12@1+ (0.1,0.0) [0|4095] "km/h" PARK_ASSIST
 SG_ SIG_1A4_02 : 40|12@1+ (0.1,0.0) [0|4095] "obj" PARK_ASSIST
 SG_ SIG_1A4_03 : 52|12@1+ (0.1,0.0) [0|4095] "deg" PARK_ASSIST
 SG_ SIG_1A4_04 : 64|12@1+ (0.1,0.0) [0|4095] "Nm" PARK_ASSIST
 SG_ SIG_1A4_05 : 76|12@1+ (0.1,0.0) [0|4095] "deg" PARK_ASSIST
 SG_ SIG_1A4_06 : 88|12@1+ (0.1,0.0) [0|4095] "C" PARK_ASSIST
 SG_ SIG_1A4_07 : 100|12@1+ (0.1,0.0) [0|4095] "rpm" PARK_ASSIST
 SG_ SIG_1A4_08 : 112|12@1+ (0.1,0.0) [0|4095] "obj" PARK_ASSIST
 SG_ SIG_1A4_09 : 124|12@1+ (0.1,0.0) [0|4095] "Nm" PARK_ASSIST
 SG_ SIG_1A4_10 : 136|12@1+ (0.1,0.0) [0|4095] "C" PARK_ASSIST
 SG_ SIG_1A4_11 : 148|12@1+ (0.1,0.0) [0|4095] "V" PARK_ASSIST
 SG_ RouteInfoChar_00 : 160|8@1+ (1,0) [0|255] "ascii" PARK_ASSIST
 SG_ RouteInfoChar_01 : 168|8@1+ (1,0) [0|255] "ascii" PARK_ASSIST
 SG_ RouteInfoChar_02 : 176|8@1+ (1,0) [0|255] "ascii" PARK_ASSIST
 SG_ RouteInfoChar_03 : 184|8@1+ (1,0) [0|255] "ascii" PARK_ASSIST
 SG_ RouteInfoChar_04 : 192|8@1+ (1,0) [0|255] "ascii" PARK_ASSIST
 SG_ RouteInfoChar_05 : 200|8@1+ (1,0) [0|255] "ascii" PARK_ASSIST
 SG_ RouteInfoChar_06 : 208|8@1+ (1,0) [0|255] "ascii" PARK_ASSIST
 SG_ RouteInfoChar_07 : 216|8@1+ (1,0) [0|255] "ascii" PARK_ASSIST
 SG_ RouteInfoChar_08 : 224|8@1+ (1,0) [0|255] "ascii" PARK_ASSIST
 SG_ RouteInfoChar_09 : 232|8@1+ (1,0) [0|255] "ascii" PARK_ASSIST
 SG_ RouteInfoChar_10 : 240|8@1+ (1,0) [0|255] "ascii" PARK_ASSIST
 SG_ RouteInfoChar_11 : 248|8@1+ (1,0) [0|255] "ascii" PARK_ASSIST
 SG_ RouteInfoChar_12 : 256|8@1+ (1,0) [0|255] "ascii" PARK_ASSIST
 SG_ RouteInfoChar_13 : 264|8@1+ (1,0) [0|255] "ascii" PARK_ASSIST
 SG_ RouteInfoChar_14 : 272|8@1+ (1,0) [0|255] "ascii" PARK_ASSIST
 SG_ RouteInfoChar_15 : 280|8@1+ (1,0) [0|255] "ascii" PARK_ASSIST
 SG_ RouteInfoChar_16 : 288|8@1+ (1,0) [0|255] "ascii" PARK_ASSIST
 SG_ RouteInfoChar_17 : 296|8@1+ (1,0) [0|255] "ascii" PARK_ASSIST
 SG_ RouteInfoChar_18 : 304|8@1+ (1,0) [0|255] "ascii" PARK_ASSIST
 SG_ RouteInfoChar_19 : 312|8@1+ (1,0) [0|255] "ascii" PARK_ASSIST
 SG_ RouteInfoChar_20 : 320|8@1+ (1,0) [0|255] "ascii" PARK_ASSIST
 SG_ RouteInfoChar_21 : 328|8@1+ (1,0) [0|255] "ascii" PARK_ASSIST
 SG_ RouteInfoChar_22 : 336|8@1+ (1,0) [0|255] "ascii" PARK_ASSIST
 SG_ RouteInfoChar_23 : 344|8@1+ (1,0) [0|255] "ascii" PARK_ASSIST
 SG_ RouteInfoChar_24 : 352|8@1+ (1,0) [0|255] "ascii" PARK_ASSIST
 SG_ RouteInfoChar_25 : 360|8@1+ (1,0) [0|255] "ascii" PARK_ASSIST
 SG_ RouteInfoChar_26 : 368|8@1+ (1,0) [0|255] "ascii" PARK_ASSIST
 SG_ RouteInfoChar_27 : 376|8@1+ (1,0) [0|255] "ascii" PARK_ASSIST
 SG_ RouteInfoChar_28 : 384|8@1+ (1,0) [0|255] "ascii" PARK_ASSIST
 SG_ RouteInfoChar_29 : 392|8@1+ (1,0) [0|255] "ascii" PARK_ASSIST
 SG_ RouteInfoChar_30 : 400|8@1+ (1,0) [0|255] "ascii" PARK_ASSIST
 SG_ RouteInfoChar_31 : 408|8@1+ (1,0) [0|255] "ascii" PARK_ASSIST
 SG_ RouteInfoChar_32 : 416|8@1+ (1,0) [0|255] "ascii" PARK_ASSIST
 SG_ RouteInfoChar_33 : 424|8@1+ (1,0) [0|255] "ascii" PARK_ASSIST
 SG_ RouteInfoChar_34 : 432|8@1+ (1,0) [0|255] "ascii" PARK_ASSIST
 SG_ RouteInfoChar_35 : 440|8@1+ (1,0) [0|255] "ascii" PARK_ASSIST
 SG_ RouteInfoChar_36 : 448|8@1+ (1,0) [0|255] "ascii" PARK_ASSIST
 SG_ RouteInfoChar_37 : 456|8@1+ (1,0) [0|255] "ascii" PARK_ASSIST
 SG_ RouteInfoChar_38 : 464|8@1+ (1,0) [0|255] "ascii" PARK_ASSIST
 SG_ RouteInfoChar_39 : 472|8@1+ (1,0) [0|255] "ascii" PARK_ASSIST
 SG_ RouteInfoChar_40 : 480|8@1+ (1,0) [0|255] "ascii" PARK_ASSIST
 SG_ RouteInfoChar_41 : 488|8@1+ (1,0) [0|255] "ascii" PARK_ASSIST
 SG_ RouteInfoChar_42 : 496|8@1+ (1,0) [0|255] "ascii" PARK_ASSIST
 SG_ RouteInfoChar_43 : 504|8@1+ (1,0) [0|255] "ascii" PARK_ASSIST

CM_ BO_ 420 "Cycle=40ms; Channel=CAN4; CAN-FD; NominalBitrate=500kbit/s; DataBitrate=5000kbit/s;  Data request; receiver answers with response frame; PayloadRouteInfo='ULTRASONIC_LEFT_CLUSTER -> PARK_ASSIST' in bytes 20-63;";

BO_ 1590 RESP_054_PARK_ASSIST_TO_ULTRASONIC_LEFT_CLUSTER: 16 PARK_ASSIST
 SG_ CRC8 : 0|8@1+ (1,0) [0|255] "" ULTRASONIC_LEFT_CLUSTER
 SG_ ResponseCounter : 8|4@1+ (1,0) [0|15] "" ULTRASONIC_LEFT_CLUSTER
 SG_ AckState : 12|4@1+ (1,0) [0|15] "" ULTRASONIC_LEFT_CLUSTER
 SG_ ReceivedFrameId : 16|11@1+ (1,0) [0|2047] "" ULTRASONIC_LEFT_CLUSTER
 SG_ ReceivedCounter : 27|4@1+ (1,0) [0|15] "" ULTRASONIC_LEFT_CLUSTER
 SG_ ChecksumOk : 31|1@1+ (1,0) [0|1] "" ULTRASONIC_LEFT_CLUSTER
 SG_ PayloadLength : 32|8@1+ (1,0) [0|64] "byte" ULTRASONIC_LEFT_CLUSTER
 SG_ ErrorCode : 40|8@1+ (1,0) [0|255] "" ULTRASONIC_LEFT_CLUSTER
 SG_ ProcessingTimeUs : 48|16@1+ (1,0) [0|65535] "us" ULTRASONIC_LEFT_CLUSTER
 SG_ ResponseSequence : 64|16@1+ (1,0) [0|65535] "" ULTRASONIC_LEFT_CLUSTER
 SG_ ReceivedCrc : 80|8@1+ (1,0) [0|255] "" ULTRASONIC_LEFT_CLUSTER
 SG_ CalculatedCrc : 88|8@1+ (1,0) [0|255] "" ULTRASONIC_LEFT_CLUSTER

CM_ BO_ 1590 "Cycle=40ms; Channel=CAN4; CAN-FD; NominalBitrate=500kbit/s; DataBitrate=5000kbit/s;  ResponseFor=0x1A4; ACK/NACK with CRC, DLC and counter check;";

BO_ 421 DATA_055_ULTRASONIC_RIGHT_DISTANCE: 64 ULTRASONIC_RIGHT_CLUSTER
 SG_ CRC8 : 0|8@1+ (1,0) [0|255] "" PARK_ASSIST
 SG_ AliveCounter : 8|4@1+ (1,0) [0|15] "" PARK_ASSIST
 SG_ MuxState : 12|4@1+ (1,0) [0|15] "" PARK_ASSIST
 SG_ SIG_1A5_00 : 16|12@1+ (0.1,0.0) [0|4095] "A" PARK_ASSIST
 SG_ SIG_1A5_01 : 28|12@1+ (0.1,0.0) [0|4095] "deg" PARK_ASSIST
 SG_ SIG_1A5_02 : 40|12@1+ (0.1,0.0) [0|4095] "obj" PARK_ASSIST
 SG_ SIG_1A5_03 : 52|12@1+ (0.1,0.0) [0|4095] "obj" PARK_ASSIST
 SG_ SIG_1A5_04 : 64|12@1+ (0.1,0.0) [0|4095] "rpm" PARK_ASSIST
 SG_ SIG_1A5_05 : 76|12@1+ (0.1,0.0) [0|4095] "deg" PARK_ASSIST
 SG_ SIG_1A5_06 : 88|12@1+ (0.1,0.0) [0|4095] "V" PARK_ASSIST
 SG_ SIG_1A5_07 : 100|12@1+ (0.1,0.0) [0|4095] "rpm" PARK_ASSIST
 SG_ SIG_1A5_08 : 112|12@1+ (0.1,0.0) [0|4095] "obj" PARK_ASSIST
 SG_ SIG_1A5_09 : 124|12@1+ (0.1,0.0) [0|4095] "km/h" PARK_ASSIST
 SG_ SIG_1A5_10 : 136|12@1+ (0.1,0.0) [0|4095] "V" PARK_ASSIST
 SG_ SIG_1A5_11 : 148|12@1+ (0.1,0.0) [0|4095] "obj" PARK_ASSIST
 SG_ RouteInfoChar_00 : 160|8@1+ (1,0) [0|255] "ascii" PARK_ASSIST
 SG_ RouteInfoChar_01 : 168|8@1+ (1,0) [0|255] "ascii" PARK_ASSIST
 SG_ RouteInfoChar_02 : 176|8@1+ (1,0) [0|255] "ascii" PARK_ASSIST
 SG_ RouteInfoChar_03 : 184|8@1+ (1,0) [0|255] "ascii" PARK_ASSIST
 SG_ RouteInfoChar_04 : 192|8@1+ (1,0) [0|255] "ascii" PARK_ASSIST
 SG_ RouteInfoChar_05 : 200|8@1+ (1,0) [0|255] "ascii" PARK_ASSIST
 SG_ RouteInfoChar_06 : 208|8@1+ (1,0) [0|255] "ascii" PARK_ASSIST
 SG_ RouteInfoChar_07 : 216|8@1+ (1,0) [0|255] "ascii" PARK_ASSIST
 SG_ RouteInfoChar_08 : 224|8@1+ (1,0) [0|255] "ascii" PARK_ASSIST
 SG_ RouteInfoChar_09 : 232|8@1+ (1,0) [0|255] "ascii" PARK_ASSIST
 SG_ RouteInfoChar_10 : 240|8@1+ (1,0) [0|255] "ascii" PARK_ASSIST
 SG_ RouteInfoChar_11 : 248|8@1+ (1,0) [0|255] "ascii" PARK_ASSIST
 SG_ RouteInfoChar_12 : 256|8@1+ (1,0) [0|255] "ascii" PARK_ASSIST
 SG_ RouteInfoChar_13 : 264|8@1+ (1,0) [0|255] "ascii" PARK_ASSIST
 SG_ RouteInfoChar_14 : 272|8@1+ (1,0) [0|255] "ascii" PARK_ASSIST
 SG_ RouteInfoChar_15 : 280|8@1+ (1,0) [0|255] "ascii" PARK_ASSIST
 SG_ RouteInfoChar_16 : 288|8@1+ (1,0) [0|255] "ascii" PARK_ASSIST
 SG_ RouteInfoChar_17 : 296|8@1+ (1,0) [0|255] "ascii" PARK_ASSIST
 SG_ RouteInfoChar_18 : 304|8@1+ (1,0) [0|255] "ascii" PARK_ASSIST
 SG_ RouteInfoChar_19 : 312|8@1+ (1,0) [0|255] "ascii" PARK_ASSIST
 SG_ RouteInfoChar_20 : 320|8@1+ (1,0) [0|255] "ascii" PARK_ASSIST
 SG_ RouteInfoChar_21 : 328|8@1+ (1,0) [0|255] "ascii" PARK_ASSIST
 SG_ RouteInfoChar_22 : 336|8@1+ (1,0) [0|255] "ascii" PARK_ASSIST
 SG_ RouteInfoChar_23 : 344|8@1+ (1,0) [0|255] "ascii" PARK_ASSIST
 SG_ RouteInfoChar_24 : 352|8@1+ (1,0) [0|255] "ascii" PARK_ASSIST
 SG_ RouteInfoChar_25 : 360|8@1+ (1,0) [0|255] "ascii" PARK_ASSIST
 SG_ RouteInfoChar_26 : 368|8@1+ (1,0) [0|255] "ascii" PARK_ASSIST
 SG_ RouteInfoChar_27 : 376|8@1+ (1,0) [0|255] "ascii" PARK_ASSIST
 SG_ RouteInfoChar_28 : 384|8@1+ (1,0) [0|255] "ascii" PARK_ASSIST
 SG_ RouteInfoChar_29 : 392|8@1+ (1,0) [0|255] "ascii" PARK_ASSIST
 SG_ RouteInfoChar_30 : 400|8@1+ (1,0) [0|255] "ascii" PARK_ASSIST
 SG_ RouteInfoChar_31 : 408|8@1+ (1,0) [0|255] "ascii" PARK_ASSIST
 SG_ RouteInfoChar_32 : 416|8@1+ (1,0) [0|255] "ascii" PARK_ASSIST
 SG_ RouteInfoChar_33 : 424|8@1+ (1,0) [0|255] "ascii" PARK_ASSIST
 SG_ RouteInfoChar_34 : 432|8@1+ (1,0) [0|255] "ascii" PARK_ASSIST
 SG_ RouteInfoChar_35 : 440|8@1+ (1,0) [0|255] "ascii" PARK_ASSIST
 SG_ RouteInfoChar_36 : 448|8@1+ (1,0) [0|255] "ascii" PARK_ASSIST
 SG_ RouteInfoChar_37 : 456|8@1+ (1,0) [0|255] "ascii" PARK_ASSIST
 SG_ RouteInfoChar_38 : 464|8@1+ (1,0) [0|255] "ascii" PARK_ASSIST
 SG_ RouteInfoChar_39 : 472|8@1+ (1,0) [0|255] "ascii" PARK_ASSIST
 SG_ RouteInfoChar_40 : 480|8@1+ (1,0) [0|255] "ascii" PARK_ASSIST
 SG_ RouteInfoChar_41 : 488|8@1+ (1,0) [0|255] "ascii" PARK_ASSIST
 SG_ RouteInfoChar_42 : 496|8@1+ (1,0) [0|255] "ascii" PARK_ASSIST
 SG_ RouteInfoChar_43 : 504|8@1+ (1,0) [0|255] "ascii" PARK_ASSIST

CM_ BO_ 421 "Cycle=40ms; Channel=CAN5; CAN-FD; NominalBitrate=500kbit/s; DataBitrate=5000kbit/s;  Data request; receiver answers with response frame; PayloadRouteInfo='ULTRASONIC_RIGHT_CLUSTER -> PARK_ASSIST' in bytes 20-63;";

BO_ 1591 RESP_055_PARK_ASSIST_TO_ULTRASONIC_RIGHT_CLUSTER: 16 PARK_ASSIST
 SG_ CRC8 : 0|8@1+ (1,0) [0|255] "" ULTRASONIC_RIGHT_CLUSTER
 SG_ ResponseCounter : 8|4@1+ (1,0) [0|15] "" ULTRASONIC_RIGHT_CLUSTER
 SG_ AckState : 12|4@1+ (1,0) [0|15] "" ULTRASONIC_RIGHT_CLUSTER
 SG_ ReceivedFrameId : 16|11@1+ (1,0) [0|2047] "" ULTRASONIC_RIGHT_CLUSTER
 SG_ ReceivedCounter : 27|4@1+ (1,0) [0|15] "" ULTRASONIC_RIGHT_CLUSTER
 SG_ ChecksumOk : 31|1@1+ (1,0) [0|1] "" ULTRASONIC_RIGHT_CLUSTER
 SG_ PayloadLength : 32|8@1+ (1,0) [0|64] "byte" ULTRASONIC_RIGHT_CLUSTER
 SG_ ErrorCode : 40|8@1+ (1,0) [0|255] "" ULTRASONIC_RIGHT_CLUSTER
 SG_ ProcessingTimeUs : 48|16@1+ (1,0) [0|65535] "us" ULTRASONIC_RIGHT_CLUSTER
 SG_ ResponseSequence : 64|16@1+ (1,0) [0|65535] "" ULTRASONIC_RIGHT_CLUSTER
 SG_ ReceivedCrc : 80|8@1+ (1,0) [0|255] "" ULTRASONIC_RIGHT_CLUSTER
 SG_ CalculatedCrc : 88|8@1+ (1,0) [0|255] "" ULTRASONIC_RIGHT_CLUSTER

CM_ BO_ 1591 "Cycle=40ms; Channel=CAN5; CAN-FD; NominalBitrate=500kbit/s; DataBitrate=5000kbit/s;  ResponseFor=0x1A5; ACK/NACK with CRC, DLC and counter check;";

BO_ 422 DATA_056_IMU_DYNAMICS: 64 IMU_YAW_RATE_SENSOR
 SG_ CRC8 : 0|8@1+ (1,0) [0|255] "" ADAS_DOMAIN
 SG_ AliveCounter : 8|4@1+ (1,0) [0|15] "" ADAS_DOMAIN
 SG_ MuxState : 12|4@1+ (1,0) [0|15] "" ADAS_DOMAIN
 SG_ SIG_1A6_00 : 16|12@1+ (0.1,0.0) [0|4095] "%" ADAS_DOMAIN
 SG_ SIG_1A6_01 : 28|12@1+ (0.1,0.0) [0|4095] "%" ADAS_DOMAIN
 SG_ SIG_1A6_02 : 40|12@1+ (0.1,0.0) [0|4095] "Nm" ADAS_DOMAIN
 SG_ SIG_1A6_03 : 52|12@1+ (0.1,0.0) [0|4095] "rpm" ADAS_DOMAIN
 SG_ SIG_1A6_04 : 64|12@1+ (0.1,0.0) [0|4095] "obj" ADAS_DOMAIN
 SG_ SIG_1A6_05 : 76|12@1+ (0.1,0.0) [0|4095] "Nm" ADAS_DOMAIN
 SG_ SIG_1A6_06 : 88|12@1+ (0.1,0.0) [0|4095] "rpm" ADAS_DOMAIN
 SG_ SIG_1A6_07 : 100|12@1+ (0.1,0.0) [0|4095] "V" ADAS_DOMAIN
 SG_ SIG_1A6_08 : 112|12@1+ (0.1,0.0) [0|4095] "obj" ADAS_DOMAIN
 SG_ SIG_1A6_09 : 124|12@1+ (0.1,0.0) [0|4095] "rpm" ADAS_DOMAIN
 SG_ SIG_1A6_10 : 136|12@1+ (0.1,0.0) [0|4095] "obj" ADAS_DOMAIN
 SG_ SIG_1A6_11 : 148|12@1+ (0.1,0.0) [0|4095] "km/h" ADAS_DOMAIN
 SG_ RouteInfoChar_00 : 160|8@1+ (1,0) [0|255] "ascii" ADAS_DOMAIN
 SG_ RouteInfoChar_01 : 168|8@1+ (1,0) [0|255] "ascii" ADAS_DOMAIN
 SG_ RouteInfoChar_02 : 176|8@1+ (1,0) [0|255] "ascii" ADAS_DOMAIN
 SG_ RouteInfoChar_03 : 184|8@1+ (1,0) [0|255] "ascii" ADAS_DOMAIN
 SG_ RouteInfoChar_04 : 192|8@1+ (1,0) [0|255] "ascii" ADAS_DOMAIN
 SG_ RouteInfoChar_05 : 200|8@1+ (1,0) [0|255] "ascii" ADAS_DOMAIN
 SG_ RouteInfoChar_06 : 208|8@1+ (1,0) [0|255] "ascii" ADAS_DOMAIN
 SG_ RouteInfoChar_07 : 216|8@1+ (1,0) [0|255] "ascii" ADAS_DOMAIN
 SG_ RouteInfoChar_08 : 224|8@1+ (1,0) [0|255] "ascii" ADAS_DOMAIN
 SG_ RouteInfoChar_09 : 232|8@1+ (1,0) [0|255] "ascii" ADAS_DOMAIN
 SG_ RouteInfoChar_10 : 240|8@1+ (1,0) [0|255] "ascii" ADAS_DOMAIN
 SG_ RouteInfoChar_11 : 248|8@1+ (1,0) [0|255] "ascii" ADAS_DOMAIN
 SG_ RouteInfoChar_12 : 256|8@1+ (1,0) [0|255] "ascii" ADAS_DOMAIN
 SG_ RouteInfoChar_13 : 264|8@1+ (1,0) [0|255] "ascii" ADAS_DOMAIN
 SG_ RouteInfoChar_14 : 272|8@1+ (1,0) [0|255] "ascii" ADAS_DOMAIN
 SG_ RouteInfoChar_15 : 280|8@1+ (1,0) [0|255] "ascii" ADAS_DOMAIN
 SG_ RouteInfoChar_16 : 288|8@1+ (1,0) [0|255] "ascii" ADAS_DOMAIN
 SG_ RouteInfoChar_17 : 296|8@1+ (1,0) [0|255] "ascii" ADAS_DOMAIN
 SG_ RouteInfoChar_18 : 304|8@1+ (1,0) [0|255] "ascii" ADAS_DOMAIN
 SG_ RouteInfoChar_19 : 312|8@1+ (1,0) [0|255] "ascii" ADAS_DOMAIN
 SG_ RouteInfoChar_20 : 320|8@1+ (1,0) [0|255] "ascii" ADAS_DOMAIN
 SG_ RouteInfoChar_21 : 328|8@1+ (1,0) [0|255] "ascii" ADAS_DOMAIN
 SG_ RouteInfoChar_22 : 336|8@1+ (1,0) [0|255] "ascii" ADAS_DOMAIN
 SG_ RouteInfoChar_23 : 344|8@1+ (1,0) [0|255] "ascii" ADAS_DOMAIN
 SG_ RouteInfoChar_24 : 352|8@1+ (1,0) [0|255] "ascii" ADAS_DOMAIN
 SG_ RouteInfoChar_25 : 360|8@1+ (1,0) [0|255] "ascii" ADAS_DOMAIN
 SG_ RouteInfoChar_26 : 368|8@1+ (1,0) [0|255] "ascii" ADAS_DOMAIN
 SG_ RouteInfoChar_27 : 376|8@1+ (1,0) [0|255] "ascii" ADAS_DOMAIN
 SG_ RouteInfoChar_28 : 384|8@1+ (1,0) [0|255] "ascii" ADAS_DOMAIN
 SG_ RouteInfoChar_29 : 392|8@1+ (1,0) [0|255] "ascii" ADAS_DOMAIN
 SG_ RouteInfoChar_30 : 400|8@1+ (1,0) [0|255] "ascii" ADAS_DOMAIN
 SG_ RouteInfoChar_31 : 408|8@1+ (1,0) [0|255] "ascii" ADAS_DOMAIN
 SG_ RouteInfoChar_32 : 416|8@1+ (1,0) [0|255] "ascii" ADAS_DOMAIN
 SG_ RouteInfoChar_33 : 424|8@1+ (1,0) [0|255] "ascii" ADAS_DOMAIN
 SG_ RouteInfoChar_34 : 432|8@1+ (1,0) [0|255] "ascii" ADAS_DOMAIN
 SG_ RouteInfoChar_35 : 440|8@1+ (1,0) [0|255] "ascii" ADAS_DOMAIN
 SG_ RouteInfoChar_36 : 448|8@1+ (1,0) [0|255] "ascii" ADAS_DOMAIN
 SG_ RouteInfoChar_37 : 456|8@1+ (1,0) [0|255] "ascii" ADAS_DOMAIN
 SG_ RouteInfoChar_38 : 464|8@1+ (1,0) [0|255] "ascii" ADAS_DOMAIN
 SG_ RouteInfoChar_39 : 472|8@1+ (1,0) [0|255] "ascii" ADAS_DOMAIN
 SG_ RouteInfoChar_40 : 480|8@1+ (1,0) [0|255] "ascii" ADAS_DOMAIN
 SG_ RouteInfoChar_41 : 488|8@1+ (1,0) [0|255] "ascii" ADAS_DOMAIN
 SG_ RouteInfoChar_42 : 496|8@1+ (1,0) [0|255] "ascii" ADAS_DOMAIN
 SG_ RouteInfoChar_43 : 504|8@1+ (1,0) [0|255] "ascii" ADAS_DOMAIN

CM_ BO_ 422 "Cycle=10ms; Channel=CAN6; CAN-FD; NominalBitrate=500kbit/s; DataBitrate=5000kbit/s;  Data request; receiver answers with response frame; PayloadRouteInfo='IMU_YAW_RATE_SENSOR -> ADAS_DOMAIN' in bytes 20-63;";

BO_ 1592 RESP_056_ADAS_DOMAIN_TO_IMU_YAW_RATE_SENSOR: 16 ADAS_DOMAIN
 SG_ CRC8 : 0|8@1+ (1,0) [0|255] "" IMU_YAW_RATE_SENSOR
 SG_ ResponseCounter : 8|4@1+ (1,0) [0|15] "" IMU_YAW_RATE_SENSOR
 SG_ AckState : 12|4@1+ (1,0) [0|15] "" IMU_YAW_RATE_SENSOR
 SG_ ReceivedFrameId : 16|11@1+ (1,0) [0|2047] "" IMU_YAW_RATE_SENSOR
 SG_ ReceivedCounter : 27|4@1+ (1,0) [0|15] "" IMU_YAW_RATE_SENSOR
 SG_ ChecksumOk : 31|1@1+ (1,0) [0|1] "" IMU_YAW_RATE_SENSOR
 SG_ PayloadLength : 32|8@1+ (1,0) [0|64] "byte" IMU_YAW_RATE_SENSOR
 SG_ ErrorCode : 40|8@1+ (1,0) [0|255] "" IMU_YAW_RATE_SENSOR
 SG_ ProcessingTimeUs : 48|16@1+ (1,0) [0|65535] "us" IMU_YAW_RATE_SENSOR
 SG_ ResponseSequence : 64|16@1+ (1,0) [0|65535] "" IMU_YAW_RATE_SENSOR
 SG_ ReceivedCrc : 80|8@1+ (1,0) [0|255] "" IMU_YAW_RATE_SENSOR
 SG_ CalculatedCrc : 88|8@1+ (1,0) [0|255] "" IMU_YAW_RATE_SENSOR

CM_ BO_ 1592 "Cycle=10ms; Channel=CAN6; CAN-FD; NominalBitrate=500kbit/s; DataBitrate=5000kbit/s;  ResponseFor=0x1A6; ACK/NACK with CRC, DLC and counter check;";

BO_ 423 DATA_057_WHEEL_SPEED_FL: 64 WHEEL_SPEED_FRONT_LEFT
 SG_ CRC8 : 0|8@1+ (1,0) [0|255] "" BRAKE_CONTROLLER
 SG_ AliveCounter : 8|4@1+ (1,0) [0|15] "" BRAKE_CONTROLLER
 SG_ MuxState : 12|4@1+ (1,0) [0|15] "" BRAKE_CONTROLLER
 SG_ SIG_1A7_00 : 16|12@1+ (0.1,0.0) [0|4095] "A" BRAKE_CONTROLLER
 SG_ SIG_1A7_01 : 28|12@1+ (0.1,0.0) [0|4095] "m" BRAKE_CONTROLLER
 SG_ SIG_1A7_02 : 40|12@1+ (0.1,0.0) [0|4095] "%" BRAKE_CONTROLLER
 SG_ SIG_1A7_03 : 52|12@1+ (0.1,0.0) [0|4095] "A" BRAKE_CONTROLLER
 SG_ SIG_1A7_04 : 64|12@1+ (0.1,0.0) [0|4095] "rpm" BRAKE_CONTROLLER
 SG_ SIG_1A7_05 : 76|12@1+ (0.1,0.0) [0|4095] "m" BRAKE_CONTROLLER
 SG_ SIG_1A7_06 : 88|12@1+ (0.1,0.0) [0|4095] "A" BRAKE_CONTROLLER
 SG_ SIG_1A7_07 : 100|12@1+ (0.1,0.0) [0|4095] "km/h" BRAKE_CONTROLLER
 SG_ SIG_1A7_08 : 112|12@1+ (0.1,0.0) [0|4095] "%" BRAKE_CONTROLLER
 SG_ SIG_1A7_09 : 124|12@1+ (0.1,0.0) [0|4095] "C" BRAKE_CONTROLLER
 SG_ SIG_1A7_10 : 136|12@1+ (0.1,0.0) [0|4095] "rpm" BRAKE_CONTROLLER
 SG_ SIG_1A7_11 : 148|12@1+ (0.1,0.0) [0|4095] "%" BRAKE_CONTROLLER
 SG_ RouteInfoChar_00 : 160|8@1+ (1,0) [0|255] "ascii" BRAKE_CONTROLLER
 SG_ RouteInfoChar_01 : 168|8@1+ (1,0) [0|255] "ascii" BRAKE_CONTROLLER
 SG_ RouteInfoChar_02 : 176|8@1+ (1,0) [0|255] "ascii" BRAKE_CONTROLLER
 SG_ RouteInfoChar_03 : 184|8@1+ (1,0) [0|255] "ascii" BRAKE_CONTROLLER
 SG_ RouteInfoChar_04 : 192|8@1+ (1,0) [0|255] "ascii" BRAKE_CONTROLLER
 SG_ RouteInfoChar_05 : 200|8@1+ (1,0) [0|255] "ascii" BRAKE_CONTROLLER
 SG_ RouteInfoChar_06 : 208|8@1+ (1,0) [0|255] "ascii" BRAKE_CONTROLLER
 SG_ RouteInfoChar_07 : 216|8@1+ (1,0) [0|255] "ascii" BRAKE_CONTROLLER
 SG_ RouteInfoChar_08 : 224|8@1+ (1,0) [0|255] "ascii" BRAKE_CONTROLLER
 SG_ RouteInfoChar_09 : 232|8@1+ (1,0) [0|255] "ascii" BRAKE_CONTROLLER
 SG_ RouteInfoChar_10 : 240|8@1+ (1,0) [0|255] "ascii" BRAKE_CONTROLLER
 SG_ RouteInfoChar_11 : 248|8@1+ (1,0) [0|255] "ascii" BRAKE_CONTROLLER
 SG_ RouteInfoChar_12 : 256|8@1+ (1,0) [0|255] "ascii" BRAKE_CONTROLLER
 SG_ RouteInfoChar_13 : 264|8@1+ (1,0) [0|255] "ascii" BRAKE_CONTROLLER
 SG_ RouteInfoChar_14 : 272|8@1+ (1,0) [0|255] "ascii" BRAKE_CONTROLLER
 SG_ RouteInfoChar_15 : 280|8@1+ (1,0) [0|255] "ascii" BRAKE_CONTROLLER
 SG_ RouteInfoChar_16 : 288|8@1+ (1,0) [0|255] "ascii" BRAKE_CONTROLLER
 SG_ RouteInfoChar_17 : 296|8@1+ (1,0) [0|255] "ascii" BRAKE_CONTROLLER
 SG_ RouteInfoChar_18 : 304|8@1+ (1,0) [0|255] "ascii" BRAKE_CONTROLLER
 SG_ RouteInfoChar_19 : 312|8@1+ (1,0) [0|255] "ascii" BRAKE_CONTROLLER
 SG_ RouteInfoChar_20 : 320|8@1+ (1,0) [0|255] "ascii" BRAKE_CONTROLLER
 SG_ RouteInfoChar_21 : 328|8@1+ (1,0) [0|255] "ascii" BRAKE_CONTROLLER
 SG_ RouteInfoChar_22 : 336|8@1+ (1,0) [0|255] "ascii" BRAKE_CONTROLLER
 SG_ RouteInfoChar_23 : 344|8@1+ (1,0) [0|255] "ascii" BRAKE_CONTROLLER
 SG_ RouteInfoChar_24 : 352|8@1+ (1,0) [0|255] "ascii" BRAKE_CONTROLLER
 SG_ RouteInfoChar_25 : 360|8@1+ (1,0) [0|255] "ascii" BRAKE_CONTROLLER
 SG_ RouteInfoChar_26 : 368|8@1+ (1,0) [0|255] "ascii" BRAKE_CONTROLLER
 SG_ RouteInfoChar_27 : 376|8@1+ (1,0) [0|255] "ascii" BRAKE_CONTROLLER
 SG_ RouteInfoChar_28 : 384|8@1+ (1,0) [0|255] "ascii" BRAKE_CONTROLLER
 SG_ RouteInfoChar_29 : 392|8@1+ (1,0) [0|255] "ascii" BRAKE_CONTROLLER
 SG_ RouteInfoChar_30 : 400|8@1+ (1,0) [0|255] "ascii" BRAKE_CONTROLLER
 SG_ RouteInfoChar_31 : 408|8@1+ (1,0) [0|255] "ascii" BRAKE_CONTROLLER
 SG_ RouteInfoChar_32 : 416|8@1+ (1,0) [0|255] "ascii" BRAKE_CONTROLLER
 SG_ RouteInfoChar_33 : 424|8@1+ (1,0) [0|255] "ascii" BRAKE_CONTROLLER
 SG_ RouteInfoChar_34 : 432|8@1+ (1,0) [0|255] "ascii" BRAKE_CONTROLLER
 SG_ RouteInfoChar_35 : 440|8@1+ (1,0) [0|255] "ascii" BRAKE_CONTROLLER
 SG_ RouteInfoChar_36 : 448|8@1+ (1,0) [0|255] "ascii" BRAKE_CONTROLLER
 SG_ RouteInfoChar_37 : 456|8@1+ (1,0) [0|255] "ascii" BRAKE_CONTROLLER
 SG_ RouteInfoChar_38 : 464|8@1+ (1,0) [0|255] "ascii" BRAKE_CONTROLLER
 SG_ RouteInfoChar_39 : 472|8@1+ (1,0) [0|255] "ascii" BRAKE_CONTROLLER
 SG_ RouteInfoChar_40 : 480|8@1+ (1,0) [0|255] "ascii" BRAKE_CONTROLLER
 SG_ RouteInfoChar_41 : 488|8@1+ (1,0) [0|255] "ascii" BRAKE_CONTROLLER
 SG_ RouteInfoChar_42 : 496|8@1+ (1,0) [0|255] "ascii" BRAKE_CONTROLLER
 SG_ RouteInfoChar_43 : 504|8@1+ (1,0) [0|255] "ascii" BRAKE_CONTROLLER

CM_ BO_ 423 "Cycle=10ms; Channel=CAN7; CAN-FD; NominalBitrate=500kbit/s; DataBitrate=5000kbit/s;  Data request; receiver answers with response frame; PayloadRouteInfo='WHEEL_SPEED_FRONT_LEFT -> BRAKE_CONTROLLER' in bytes 20-63;";

BO_ 1593 RESP_057_BRAKE_CONTROLLER_TO_WHEEL_SPEED_FRONT_LEFT: 16 BRAKE_CONTROLLER
 SG_ CRC8 : 0|8@1+ (1,0) [0|255] "" WHEEL_SPEED_FRONT_LEFT
 SG_ ResponseCounter : 8|4@1+ (1,0) [0|15] "" WHEEL_SPEED_FRONT_LEFT
 SG_ AckState : 12|4@1+ (1,0) [0|15] "" WHEEL_SPEED_FRONT_LEFT
 SG_ ReceivedFrameId : 16|11@1+ (1,0) [0|2047] "" WHEEL_SPEED_FRONT_LEFT
 SG_ ReceivedCounter : 27|4@1+ (1,0) [0|15] "" WHEEL_SPEED_FRONT_LEFT
 SG_ ChecksumOk : 31|1@1+ (1,0) [0|1] "" WHEEL_SPEED_FRONT_LEFT
 SG_ PayloadLength : 32|8@1+ (1,0) [0|64] "byte" WHEEL_SPEED_FRONT_LEFT
 SG_ ErrorCode : 40|8@1+ (1,0) [0|255] "" WHEEL_SPEED_FRONT_LEFT
 SG_ ProcessingTimeUs : 48|16@1+ (1,0) [0|65535] "us" WHEEL_SPEED_FRONT_LEFT
 SG_ ResponseSequence : 64|16@1+ (1,0) [0|65535] "" WHEEL_SPEED_FRONT_LEFT
 SG_ ReceivedCrc : 80|8@1+ (1,0) [0|255] "" WHEEL_SPEED_FRONT_LEFT
 SG_ CalculatedCrc : 88|8@1+ (1,0) [0|255] "" WHEEL_SPEED_FRONT_LEFT

CM_ BO_ 1593 "Cycle=10ms; Channel=CAN7; CAN-FD; NominalBitrate=500kbit/s; DataBitrate=5000kbit/s;  ResponseFor=0x1A7; ACK/NACK with CRC, DLC and counter check;";

BO_ 424 DATA_058_BRAKE_STATUS: 64 BRAKE_CONTROLLER
 SG_ CRC8 : 0|8@1+ (1,0) [0|255] "" ADAS_DOMAIN
 SG_ AliveCounter : 8|4@1+ (1,0) [0|15] "" ADAS_DOMAIN
 SG_ MuxState : 12|4@1+ (1,0) [0|15] "" ADAS_DOMAIN
 SG_ SIG_1A8_00 : 16|12@1+ (0.1,0.0) [0|4095] "A" ADAS_DOMAIN
 SG_ SIG_1A8_01 : 28|12@1+ (0.1,0.0) [0|4095] "C" ADAS_DOMAIN
 SG_ SIG_1A8_02 : 40|12@1+ (0.1,0.0) [0|4095] "deg" ADAS_DOMAIN
 SG_ SIG_1A8_03 : 52|12@1+ (0.1,0.0) [0|4095] "%" ADAS_DOMAIN
 SG_ SIG_1A8_04 : 64|12@1+ (0.1,0.0) [0|4095] "deg" ADAS_DOMAIN
 SG_ SIG_1A8_05 : 76|12@1+ (0.1,0.0) [0|4095] "m" ADAS_DOMAIN
 SG_ SIG_1A8_06 : 88|12@1+ (0.1,0.0) [0|4095] "V" ADAS_DOMAIN
 SG_ SIG_1A8_07 : 100|12@1+ (0.1,0.0) [0|4095] "obj" ADAS_DOMAIN
 SG_ SIG_1A8_08 : 112|12@1+ (0.1,0.0) [0|4095] "m" ADAS_DOMAIN
 SG_ SIG_1A8_09 : 124|12@1+ (0.1,0.0) [0|4095] "C" ADAS_DOMAIN
 SG_ SIG_1A8_10 : 136|12@1+ (0.1,0.0) [0|4095] "C" ADAS_DOMAIN
 SG_ SIG_1A8_11 : 148|12@1+ (0.1,0.0) [0|4095] "%" ADAS_DOMAIN
 SG_ RouteInfoChar_00 : 160|8@1+ (1,0) [0|255] "ascii" ADAS_DOMAIN
 SG_ RouteInfoChar_01 : 168|8@1+ (1,0) [0|255] "ascii" ADAS_DOMAIN
 SG_ RouteInfoChar_02 : 176|8@1+ (1,0) [0|255] "ascii" ADAS_DOMAIN
 SG_ RouteInfoChar_03 : 184|8@1+ (1,0) [0|255] "ascii" ADAS_DOMAIN
 SG_ RouteInfoChar_04 : 192|8@1+ (1,0) [0|255] "ascii" ADAS_DOMAIN
 SG_ RouteInfoChar_05 : 200|8@1+ (1,0) [0|255] "ascii" ADAS_DOMAIN
 SG_ RouteInfoChar_06 : 208|8@1+ (1,0) [0|255] "ascii" ADAS_DOMAIN
 SG_ RouteInfoChar_07 : 216|8@1+ (1,0) [0|255] "ascii" ADAS_DOMAIN
 SG_ RouteInfoChar_08 : 224|8@1+ (1,0) [0|255] "ascii" ADAS_DOMAIN
 SG_ RouteInfoChar_09 : 232|8@1+ (1,0) [0|255] "ascii" ADAS_DOMAIN
 SG_ RouteInfoChar_10 : 240|8@1+ (1,0) [0|255] "ascii" ADAS_DOMAIN
 SG_ RouteInfoChar_11 : 248|8@1+ (1,0) [0|255] "ascii" ADAS_DOMAIN
 SG_ RouteInfoChar_12 : 256|8@1+ (1,0) [0|255] "ascii" ADAS_DOMAIN
 SG_ RouteInfoChar_13 : 264|8@1+ (1,0) [0|255] "ascii" ADAS_DOMAIN
 SG_ RouteInfoChar_14 : 272|8@1+ (1,0) [0|255] "ascii" ADAS_DOMAIN
 SG_ RouteInfoChar_15 : 280|8@1+ (1,0) [0|255] "ascii" ADAS_DOMAIN
 SG_ RouteInfoChar_16 : 288|8@1+ (1,0) [0|255] "ascii" ADAS_DOMAIN
 SG_ RouteInfoChar_17 : 296|8@1+ (1,0) [0|255] "ascii" ADAS_DOMAIN
 SG_ RouteInfoChar_18 : 304|8@1+ (1,0) [0|255] "ascii" ADAS_DOMAIN
 SG_ RouteInfoChar_19 : 312|8@1+ (1,0) [0|255] "ascii" ADAS_DOMAIN
 SG_ RouteInfoChar_20 : 320|8@1+ (1,0) [0|255] "ascii" ADAS_DOMAIN
 SG_ RouteInfoChar_21 : 328|8@1+ (1,0) [0|255] "ascii" ADAS_DOMAIN
 SG_ RouteInfoChar_22 : 336|8@1+ (1,0) [0|255] "ascii" ADAS_DOMAIN
 SG_ RouteInfoChar_23 : 344|8@1+ (1,0) [0|255] "ascii" ADAS_DOMAIN
 SG_ RouteInfoChar_24 : 352|8@1+ (1,0) [0|255] "ascii" ADAS_DOMAIN
 SG_ RouteInfoChar_25 : 360|8@1+ (1,0) [0|255] "ascii" ADAS_DOMAIN
 SG_ RouteInfoChar_26 : 368|8@1+ (1,0) [0|255] "ascii" ADAS_DOMAIN
 SG_ RouteInfoChar_27 : 376|8@1+ (1,0) [0|255] "ascii" ADAS_DOMAIN
 SG_ RouteInfoChar_28 : 384|8@1+ (1,0) [0|255] "ascii" ADAS_DOMAIN
 SG_ RouteInfoChar_29 : 392|8@1+ (1,0) [0|255] "ascii" ADAS_DOMAIN
 SG_ RouteInfoChar_30 : 400|8@1+ (1,0) [0|255] "ascii" ADAS_DOMAIN
 SG_ RouteInfoChar_31 : 408|8@1+ (1,0) [0|255] "ascii" ADAS_DOMAIN
 SG_ RouteInfoChar_32 : 416|8@1+ (1,0) [0|255] "ascii" ADAS_DOMAIN
 SG_ RouteInfoChar_33 : 424|8@1+ (1,0) [0|255] "ascii" ADAS_DOMAIN
 SG_ RouteInfoChar_34 : 432|8@1+ (1,0) [0|255] "ascii" ADAS_DOMAIN
 SG_ RouteInfoChar_35 : 440|8@1+ (1,0) [0|255] "ascii" ADAS_DOMAIN
 SG_ RouteInfoChar_36 : 448|8@1+ (1,0) [0|255] "ascii" ADAS_DOMAIN
 SG_ RouteInfoChar_37 : 456|8@1+ (1,0) [0|255] "ascii" ADAS_DOMAIN
 SG_ RouteInfoChar_38 : 464|8@1+ (1,0) [0|255] "ascii" ADAS_DOMAIN
 SG_ RouteInfoChar_39 : 472|8@1+ (1,0) [0|255] "ascii" ADAS_DOMAIN
 SG_ RouteInfoChar_40 : 480|8@1+ (1,0) [0|255] "ascii" ADAS_DOMAIN
 SG_ RouteInfoChar_41 : 488|8@1+ (1,0) [0|255] "ascii" ADAS_DOMAIN
 SG_ RouteInfoChar_42 : 496|8@1+ (1,0) [0|255] "ascii" ADAS_DOMAIN
 SG_ RouteInfoChar_43 : 504|8@1+ (1,0) [0|255] "ascii" ADAS_DOMAIN

CM_ BO_ 424 "Cycle=20ms; Channel=CAN8; CAN-FD; NominalBitrate=500kbit/s; DataBitrate=5000kbit/s;  Data request; receiver answers with response frame; PayloadRouteInfo='BRAKE_CONTROLLER -> ADAS_DOMAIN' in bytes 20-63;";

BO_ 1594 RESP_058_ADAS_DOMAIN_TO_BRAKE_CONTROLLER: 16 ADAS_DOMAIN
 SG_ CRC8 : 0|8@1+ (1,0) [0|255] "" BRAKE_CONTROLLER
 SG_ ResponseCounter : 8|4@1+ (1,0) [0|15] "" BRAKE_CONTROLLER
 SG_ AckState : 12|4@1+ (1,0) [0|15] "" BRAKE_CONTROLLER
 SG_ ReceivedFrameId : 16|11@1+ (1,0) [0|2047] "" BRAKE_CONTROLLER
 SG_ ReceivedCounter : 27|4@1+ (1,0) [0|15] "" BRAKE_CONTROLLER
 SG_ ChecksumOk : 31|1@1+ (1,0) [0|1] "" BRAKE_CONTROLLER
 SG_ PayloadLength : 32|8@1+ (1,0) [0|64] "byte" BRAKE_CONTROLLER
 SG_ ErrorCode : 40|8@1+ (1,0) [0|255] "" BRAKE_CONTROLLER
 SG_ ProcessingTimeUs : 48|16@1+ (1,0) [0|65535] "us" BRAKE_CONTROLLER
 SG_ ResponseSequence : 64|16@1+ (1,0) [0|65535] "" BRAKE_CONTROLLER
 SG_ ReceivedCrc : 80|8@1+ (1,0) [0|255] "" BRAKE_CONTROLLER
 SG_ CalculatedCrc : 88|8@1+ (1,0) [0|255] "" BRAKE_CONTROLLER

CM_ BO_ 1594 "Cycle=20ms; Channel=CAN8; CAN-FD; NominalBitrate=500kbit/s; DataBitrate=5000kbit/s;  ResponseFor=0x1A8; ACK/NACK with CRC, DLC and counter check;";

BO_ 425 DATA_059_ADAS_MOTION_REQUEST: 64 ADAS_DOMAIN
 SG_ CRC8 : 0|8@1+ (1,0) [0|255] "" VEHICLE_MOTION_CONTROLLER
 SG_ AliveCounter : 8|4@1+ (1,0) [0|15] "" VEHICLE_MOTION_CONTROLLER
 SG_ MuxState : 12|4@1+ (1,0) [0|15] "" VEHICLE_MOTION_CONTROLLER
 SG_ SIG_1A9_00 : 16|12@1+ (0.1,0.0) [0|4095] "obj" VEHICLE_MOTION_CONTROLLER
 SG_ SIG_1A9_01 : 28|12@1+ (0.1,0.0) [0|4095] "V" VEHICLE_MOTION_CONTROLLER
 SG_ SIG_1A9_02 : 40|12@1+ (0.1,0.0) [0|4095] "A" VEHICLE_MOTION_CONTROLLER
 SG_ SIG_1A9_03 : 52|12@1+ (0.1,0.0) [0|4095] "Nm" VEHICLE_MOTION_CONTROLLER
 SG_ SIG_1A9_04 : 64|12@1+ (0.1,0.0) [0|4095] "rpm" VEHICLE_MOTION_CONTROLLER
 SG_ SIG_1A9_05 : 76|12@1+ (0.1,0.0) [0|4095] "V" VEHICLE_MOTION_CONTROLLER
 SG_ SIG_1A9_06 : 88|12@1+ (0.1,0.0) [0|4095] "C" VEHICLE_MOTION_CONTROLLER
 SG_ SIG_1A9_07 : 100|12@1+ (0.1,0.0) [0|4095] "Nm" VEHICLE_MOTION_CONTROLLER
 SG_ SIG_1A9_08 : 112|12@1+ (0.1,0.0) [0|4095] "C" VEHICLE_MOTION_CONTROLLER
 SG_ SIG_1A9_09 : 124|12@1+ (0.1,0.0) [0|4095] "obj" VEHICLE_MOTION_CONTROLLER
 SG_ SIG_1A9_10 : 136|12@1+ (0.1,0.0) [0|4095] "obj" VEHICLE_MOTION_CONTROLLER
 SG_ SIG_1A9_11 : 148|12@1+ (0.1,0.0) [0|4095] "%" VEHICLE_MOTION_CONTROLLER
 SG_ RouteInfoChar_00 : 160|8@1+ (1,0) [0|255] "ascii" VEHICLE_MOTION_CONTROLLER
 SG_ RouteInfoChar_01 : 168|8@1+ (1,0) [0|255] "ascii" VEHICLE_MOTION_CONTROLLER
 SG_ RouteInfoChar_02 : 176|8@1+ (1,0) [0|255] "ascii" VEHICLE_MOTION_CONTROLLER
 SG_ RouteInfoChar_03 : 184|8@1+ (1,0) [0|255] "ascii" VEHICLE_MOTION_CONTROLLER
 SG_ RouteInfoChar_04 : 192|8@1+ (1,0) [0|255] "ascii" VEHICLE_MOTION_CONTROLLER
 SG_ RouteInfoChar_05 : 200|8@1+ (1,0) [0|255] "ascii" VEHICLE_MOTION_CONTROLLER
 SG_ RouteInfoChar_06 : 208|8@1+ (1,0) [0|255] "ascii" VEHICLE_MOTION_CONTROLLER
 SG_ RouteInfoChar_07 : 216|8@1+ (1,0) [0|255] "ascii" VEHICLE_MOTION_CONTROLLER
 SG_ RouteInfoChar_08 : 224|8@1+ (1,0) [0|255] "ascii" VEHICLE_MOTION_CONTROLLER
 SG_ RouteInfoChar_09 : 232|8@1+ (1,0) [0|255] "ascii" VEHICLE_MOTION_CONTROLLER
 SG_ RouteInfoChar_10 : 240|8@1+ (1,0) [0|255] "ascii" VEHICLE_MOTION_CONTROLLER
 SG_ RouteInfoChar_11 : 248|8@1+ (1,0) [0|255] "ascii" VEHICLE_MOTION_CONTROLLER
 SG_ RouteInfoChar_12 : 256|8@1+ (1,0) [0|255] "ascii" VEHICLE_MOTION_CONTROLLER
 SG_ RouteInfoChar_13 : 264|8@1+ (1,0) [0|255] "ascii" VEHICLE_MOTION_CONTROLLER
 SG_ RouteInfoChar_14 : 272|8@1+ (1,0) [0|255] "ascii" VEHICLE_MOTION_CONTROLLER
 SG_ RouteInfoChar_15 : 280|8@1+ (1,0) [0|255] "ascii" VEHICLE_MOTION_CONTROLLER
 SG_ RouteInfoChar_16 : 288|8@1+ (1,0) [0|255] "ascii" VEHICLE_MOTION_CONTROLLER
 SG_ RouteInfoChar_17 : 296|8@1+ (1,0) [0|255] "ascii" VEHICLE_MOTION_CONTROLLER
 SG_ RouteInfoChar_18 : 304|8@1+ (1,0) [0|255] "ascii" VEHICLE_MOTION_CONTROLLER
 SG_ RouteInfoChar_19 : 312|8@1+ (1,0) [0|255] "ascii" VEHICLE_MOTION_CONTROLLER
 SG_ RouteInfoChar_20 : 320|8@1+ (1,0) [0|255] "ascii" VEHICLE_MOTION_CONTROLLER
 SG_ RouteInfoChar_21 : 328|8@1+ (1,0) [0|255] "ascii" VEHICLE_MOTION_CONTROLLER
 SG_ RouteInfoChar_22 : 336|8@1+ (1,0) [0|255] "ascii" VEHICLE_MOTION_CONTROLLER
 SG_ RouteInfoChar_23 : 344|8@1+ (1,0) [0|255] "ascii" VEHICLE_MOTION_CONTROLLER
 SG_ RouteInfoChar_24 : 352|8@1+ (1,0) [0|255] "ascii" VEHICLE_MOTION_CONTROLLER
 SG_ RouteInfoChar_25 : 360|8@1+ (1,0) [0|255] "ascii" VEHICLE_MOTION_CONTROLLER
 SG_ RouteInfoChar_26 : 368|8@1+ (1,0) [0|255] "ascii" VEHICLE_MOTION_CONTROLLER
 SG_ RouteInfoChar_27 : 376|8@1+ (1,0) [0|255] "ascii" VEHICLE_MOTION_CONTROLLER
 SG_ RouteInfoChar_28 : 384|8@1+ (1,0) [0|255] "ascii" VEHICLE_MOTION_CONTROLLER
 SG_ RouteInfoChar_29 : 392|8@1+ (1,0) [0|255] "ascii" VEHICLE_MOTION_CONTROLLER
 SG_ RouteInfoChar_30 : 400|8@1+ (1,0) [0|255] "ascii" VEHICLE_MOTION_CONTROLLER
 SG_ RouteInfoChar_31 : 408|8@1+ (1,0) [0|255] "ascii" VEHICLE_MOTION_CONTROLLER
 SG_ RouteInfoChar_32 : 416|8@1+ (1,0) [0|255] "ascii" VEHICLE_MOTION_CONTROLLER
 SG_ RouteInfoChar_33 : 424|8@1+ (1,0) [0|255] "ascii" VEHICLE_MOTION_CONTROLLER
 SG_ RouteInfoChar_34 : 432|8@1+ (1,0) [0|255] "ascii" VEHICLE_MOTION_CONTROLLER
 SG_ RouteInfoChar_35 : 440|8@1+ (1,0) [0|255] "ascii" VEHICLE_MOTION_CONTROLLER
 SG_ RouteInfoChar_36 : 448|8@1+ (1,0) [0|255] "ascii" VEHICLE_MOTION_CONTROLLER
 SG_ RouteInfoChar_37 : 456|8@1+ (1,0) [0|255] "ascii" VEHICLE_MOTION_CONTROLLER
 SG_ RouteInfoChar_38 : 464|8@1+ (1,0) [0|255] "ascii" VEHICLE_MOTION_CONTROLLER
 SG_ RouteInfoChar_39 : 472|8@1+ (1,0) [0|255] "ascii" VEHICLE_MOTION_CONTROLLER
 SG_ RouteInfoChar_40 : 480|8@1+ (1,0) [0|255] "ascii" VEHICLE_MOTION_CONTROLLER
 SG_ RouteInfoChar_41 : 488|8@1+ (1,0) [0|255] "ascii" VEHICLE_MOTION_CONTROLLER
 SG_ RouteInfoChar_42 : 496|8@1+ (1,0) [0|255] "ascii" VEHICLE_MOTION_CONTROLLER
 SG_ RouteInfoChar_43 : 504|8@1+ (1,0) [0|255] "ascii" VEHICLE_MOTION_CONTROLLER

CM_ BO_ 425 "Cycle=20ms; Channel=CAN9; CAN-FD; NominalBitrate=500kbit/s; DataBitrate=5000kbit/s;  Data request; receiver answers with response frame; PayloadRouteInfo='ADAS_DOMAIN -> VEHICLE_MOTION_CONTROLLER' in bytes 20-63;";

BO_ 1595 RESP_059_VEHICLE_MOTION_CONTROLLER_TO_ADAS_DOMAIN: 16 VEHICLE_MOTION_CONTROLLER
 SG_ CRC8 : 0|8@1+ (1,0) [0|255] "" ADAS_DOMAIN
 SG_ ResponseCounter : 8|4@1+ (1,0) [0|15] "" ADAS_DOMAIN
 SG_ AckState : 12|4@1+ (1,0) [0|15] "" ADAS_DOMAIN
 SG_ ReceivedFrameId : 16|11@1+ (1,0) [0|2047] "" ADAS_DOMAIN
 SG_ ReceivedCounter : 27|4@1+ (1,0) [0|15] "" ADAS_DOMAIN
 SG_ ChecksumOk : 31|1@1+ (1,0) [0|1] "" ADAS_DOMAIN
 SG_ PayloadLength : 32|8@1+ (1,0) [0|64] "byte" ADAS_DOMAIN
 SG_ ErrorCode : 40|8@1+ (1,0) [0|255] "" ADAS_DOMAIN
 SG_ ProcessingTimeUs : 48|16@1+ (1,0) [0|65535] "us" ADAS_DOMAIN
 SG_ ResponseSequence : 64|16@1+ (1,0) [0|65535] "" ADAS_DOMAIN
 SG_ ReceivedCrc : 80|8@1+ (1,0) [0|255] "" ADAS_DOMAIN
 SG_ CalculatedCrc : 88|8@1+ (1,0) [0|255] "" ADAS_DOMAIN

CM_ BO_ 1595 "Cycle=20ms; Channel=CAN9; CAN-FD; NominalBitrate=500kbit/s; DataBitrate=5000kbit/s;  ResponseFor=0x1A9; ACK/NACK with CRC, DLC and counter check;";

BO_ 448 DATA_060_LIDAR_OBJECT_LIST: 64 LIDAR_FRONT
 SG_ CRC8 : 0|8@1+ (1,0) [0|255] "" ADAS_DOMAIN
 SG_ AliveCounter : 8|4@1+ (1,0) [0|15] "" ADAS_DOMAIN
 SG_ MuxState : 12|4@1+ (1,0) [0|15] "" ADAS_DOMAIN
 SG_ SIG_1C0_00 : 16|12@1+ (0.1,0.0) [0|4095] "A" ADAS_DOMAIN
 SG_ SIG_1C0_01 : 28|12@1+ (0.1,0.0) [0|4095] "km/h" ADAS_DOMAIN
 SG_ SIG_1C0_02 : 40|12@1+ (0.1,0.0) [0|4095] "C" ADAS_DOMAIN
 SG_ SIG_1C0_03 : 52|12@1+ (0.1,0.0) [0|4095] "A" ADAS_DOMAIN
 SG_ SIG_1C0_04 : 64|12@1+ (0.1,0.0) [0|4095] "deg" ADAS_DOMAIN
 SG_ SIG_1C0_05 : 76|12@1+ (0.1,0.0) [0|4095] "C" ADAS_DOMAIN
 SG_ SIG_1C0_06 : 88|12@1+ (0.1,0.0) [0|4095] "Nm" ADAS_DOMAIN
 SG_ SIG_1C0_07 : 100|12@1+ (0.1,0.0) [0|4095] "A" ADAS_DOMAIN
 SG_ SIG_1C0_08 : 112|12@1+ (0.1,0.0) [0|4095] "V" ADAS_DOMAIN
 SG_ SIG_1C0_09 : 124|12@1+ (0.1,0.0) [0|4095] "A" ADAS_DOMAIN
 SG_ SIG_1C0_10 : 136|12@1+ (0.1,0.0) [0|4095] "V" ADAS_DOMAIN
 SG_ SIG_1C0_11 : 148|12@1+ (0.1,0.0) [0|4095] "obj" ADAS_DOMAIN
 SG_ RouteInfoChar_00 : 160|8@1+ (1,0) [0|255] "ascii" ADAS_DOMAIN
 SG_ RouteInfoChar_01 : 168|8@1+ (1,0) [0|255] "ascii" ADAS_DOMAIN
 SG_ RouteInfoChar_02 : 176|8@1+ (1,0) [0|255] "ascii" ADAS_DOMAIN
 SG_ RouteInfoChar_03 : 184|8@1+ (1,0) [0|255] "ascii" ADAS_DOMAIN
 SG_ RouteInfoChar_04 : 192|8@1+ (1,0) [0|255] "ascii" ADAS_DOMAIN
 SG_ RouteInfoChar_05 : 200|8@1+ (1,0) [0|255] "ascii" ADAS_DOMAIN
 SG_ RouteInfoChar_06 : 208|8@1+ (1,0) [0|255] "ascii" ADAS_DOMAIN
 SG_ RouteInfoChar_07 : 216|8@1+ (1,0) [0|255] "ascii" ADAS_DOMAIN
 SG_ RouteInfoChar_08 : 224|8@1+ (1,0) [0|255] "ascii" ADAS_DOMAIN
 SG_ RouteInfoChar_09 : 232|8@1+ (1,0) [0|255] "ascii" ADAS_DOMAIN
 SG_ RouteInfoChar_10 : 240|8@1+ (1,0) [0|255] "ascii" ADAS_DOMAIN
 SG_ RouteInfoChar_11 : 248|8@1+ (1,0) [0|255] "ascii" ADAS_DOMAIN
 SG_ RouteInfoChar_12 : 256|8@1+ (1,0) [0|255] "ascii" ADAS_DOMAIN
 SG_ RouteInfoChar_13 : 264|8@1+ (1,0) [0|255] "ascii" ADAS_DOMAIN
 SG_ RouteInfoChar_14 : 272|8@1+ (1,0) [0|255] "ascii" ADAS_DOMAIN
 SG_ RouteInfoChar_15 : 280|8@1+ (1,0) [0|255] "ascii" ADAS_DOMAIN
 SG_ RouteInfoChar_16 : 288|8@1+ (1,0) [0|255] "ascii" ADAS_DOMAIN
 SG_ RouteInfoChar_17 : 296|8@1+ (1,0) [0|255] "ascii" ADAS_DOMAIN
 SG_ RouteInfoChar_18 : 304|8@1+ (1,0) [0|255] "ascii" ADAS_DOMAIN
 SG_ RouteInfoChar_19 : 312|8@1+ (1,0) [0|255] "ascii" ADAS_DOMAIN
 SG_ RouteInfoChar_20 : 320|8@1+ (1,0) [0|255] "ascii" ADAS_DOMAIN
 SG_ RouteInfoChar_21 : 328|8@1+ (1,0) [0|255] "ascii" ADAS_DOMAIN
 SG_ RouteInfoChar_22 : 336|8@1+ (1,0) [0|255] "ascii" ADAS_DOMAIN
 SG_ RouteInfoChar_23 : 344|8@1+ (1,0) [0|255] "ascii" ADAS_DOMAIN
 SG_ RouteInfoChar_24 : 352|8@1+ (1,0) [0|255] "ascii" ADAS_DOMAIN
 SG_ RouteInfoChar_25 : 360|8@1+ (1,0) [0|255] "ascii" ADAS_DOMAIN
 SG_ RouteInfoChar_26 : 368|8@1+ (1,0) [0|255] "ascii" ADAS_DOMAIN
 SG_ RouteInfoChar_27 : 376|8@1+ (1,0) [0|255] "ascii" ADAS_DOMAIN
 SG_ RouteInfoChar_28 : 384|8@1+ (1,0) [0|255] "ascii" ADAS_DOMAIN
 SG_ RouteInfoChar_29 : 392|8@1+ (1,0) [0|255] "ascii" ADAS_DOMAIN
 SG_ RouteInfoChar_30 : 400|8@1+ (1,0) [0|255] "ascii" ADAS_DOMAIN
 SG_ RouteInfoChar_31 : 408|8@1+ (1,0) [0|255] "ascii" ADAS_DOMAIN
 SG_ RouteInfoChar_32 : 416|8@1+ (1,0) [0|255] "ascii" ADAS_DOMAIN
 SG_ RouteInfoChar_33 : 424|8@1+ (1,0) [0|255] "ascii" ADAS_DOMAIN
 SG_ RouteInfoChar_34 : 432|8@1+ (1,0) [0|255] "ascii" ADAS_DOMAIN
 SG_ RouteInfoChar_35 : 440|8@1+ (1,0) [0|255] "ascii" ADAS_DOMAIN
 SG_ RouteInfoChar_36 : 448|8@1+ (1,0) [0|255] "ascii" ADAS_DOMAIN
 SG_ RouteInfoChar_37 : 456|8@1+ (1,0) [0|255] "ascii" ADAS_DOMAIN
 SG_ RouteInfoChar_38 : 464|8@1+ (1,0) [0|255] "ascii" ADAS_DOMAIN
 SG_ RouteInfoChar_39 : 472|8@1+ (1,0) [0|255] "ascii" ADAS_DOMAIN
 SG_ RouteInfoChar_40 : 480|8@1+ (1,0) [0|255] "ascii" ADAS_DOMAIN
 SG_ RouteInfoChar_41 : 488|8@1+ (1,0) [0|255] "ascii" ADAS_DOMAIN
 SG_ RouteInfoChar_42 : 496|8@1+ (1,0) [0|255] "ascii" ADAS_DOMAIN
 SG_ RouteInfoChar_43 : 504|8@1+ (1,0) [0|255] "ascii" ADAS_DOMAIN

CM_ BO_ 448 "Cycle=20ms; Channel=CAN0; CAN-FD; NominalBitrate=500kbit/s; DataBitrate=5000kbit/s;  Data request; receiver answers with response frame; PayloadRouteInfo='LIDAR_FRONT -> ADAS_DOMAIN' in bytes 20-63; Gateway to CAN1";

BO_ 1596 RESP_060_ADAS_DOMAIN_TO_LIDAR_FRONT: 16 ADAS_DOMAIN
 SG_ CRC8 : 0|8@1+ (1,0) [0|255] "" LIDAR_FRONT
 SG_ ResponseCounter : 8|4@1+ (1,0) [0|15] "" LIDAR_FRONT
 SG_ AckState : 12|4@1+ (1,0) [0|15] "" LIDAR_FRONT
 SG_ ReceivedFrameId : 16|11@1+ (1,0) [0|2047] "" LIDAR_FRONT
 SG_ ReceivedCounter : 27|4@1+ (1,0) [0|15] "" LIDAR_FRONT
 SG_ ChecksumOk : 31|1@1+ (1,0) [0|1] "" LIDAR_FRONT
 SG_ PayloadLength : 32|8@1+ (1,0) [0|64] "byte" LIDAR_FRONT
 SG_ ErrorCode : 40|8@1+ (1,0) [0|255] "" LIDAR_FRONT
 SG_ ProcessingTimeUs : 48|16@1+ (1,0) [0|65535] "us" LIDAR_FRONT
 SG_ ResponseSequence : 64|16@1+ (1,0) [0|65535] "" LIDAR_FRONT
 SG_ ReceivedCrc : 80|8@1+ (1,0) [0|255] "" LIDAR_FRONT
 SG_ CalculatedCrc : 88|8@1+ (1,0) [0|255] "" LIDAR_FRONT

CM_ BO_ 1596 "Cycle=20ms; Channel=CAN0; CAN-FD; NominalBitrate=500kbit/s; DataBitrate=5000kbit/s;  ResponseFor=0x1C0; ACK/NACK with CRC, DLC and counter check;";

BO_ 449 DATA_061_CAMERA_LANE_MODEL: 64 CAMERA_FRONT_WIDE
 SG_ CRC8 : 0|8@1+ (1,0) [0|255] "" ADAS_DOMAIN
 SG_ AliveCounter : 8|4@1+ (1,0) [0|15] "" ADAS_DOMAIN
 SG_ MuxState : 12|4@1+ (1,0) [0|15] "" ADAS_DOMAIN
 SG_ SIG_1C1_00 : 16|12@1+ (0.1,0.0) [0|4095] "V" ADAS_DOMAIN
 SG_ SIG_1C1_01 : 28|12@1+ (0.1,0.0) [0|4095] "m" ADAS_DOMAIN
 SG_ SIG_1C1_02 : 40|12@1+ (0.1,0.0) [0|4095] "km/h" ADAS_DOMAIN
 SG_ SIG_1C1_03 : 52|12@1+ (0.1,0.0) [0|4095] "m" ADAS_DOMAIN
 SG_ SIG_1C1_04 : 64|12@1+ (0.1,0.0) [0|4095] "Nm" ADAS_DOMAIN
 SG_ SIG_1C1_05 : 76|12@1+ (0.1,0.0) [0|4095] "rpm" ADAS_DOMAIN
 SG_ SIG_1C1_06 : 88|12@1+ (0.1,0.0) [0|4095] "Nm" ADAS_DOMAIN
 SG_ SIG_1C1_07 : 100|12@1+ (0.1,0.0) [0|4095] "%" ADAS_DOMAIN
 SG_ SIG_1C1_08 : 112|12@1+ (0.1,0.0) [0|4095] "C" ADAS_DOMAIN
 SG_ SIG_1C1_09 : 124|12@1+ (0.1,0.0) [0|4095] "m" ADAS_DOMAIN
 SG_ SIG_1C1_10 : 136|12@1+ (0.1,0.0) [0|4095] "Nm" ADAS_DOMAIN
 SG_ SIG_1C1_11 : 148|12@1+ (0.1,0.0) [0|4095] "C" ADAS_DOMAIN
 SG_ RouteInfoChar_00 : 160|8@1+ (1,0) [0|255] "ascii" ADAS_DOMAIN
 SG_ RouteInfoChar_01 : 168|8@1+ (1,0) [0|255] "ascii" ADAS_DOMAIN
 SG_ RouteInfoChar_02 : 176|8@1+ (1,0) [0|255] "ascii" ADAS_DOMAIN
 SG_ RouteInfoChar_03 : 184|8@1+ (1,0) [0|255] "ascii" ADAS_DOMAIN
 SG_ RouteInfoChar_04 : 192|8@1+ (1,0) [0|255] "ascii" ADAS_DOMAIN
 SG_ RouteInfoChar_05 : 200|8@1+ (1,0) [0|255] "ascii" ADAS_DOMAIN
 SG_ RouteInfoChar_06 : 208|8@1+ (1,0) [0|255] "ascii" ADAS_DOMAIN
 SG_ RouteInfoChar_07 : 216|8@1+ (1,0) [0|255] "ascii" ADAS_DOMAIN
 SG_ RouteInfoChar_08 : 224|8@1+ (1,0) [0|255] "ascii" ADAS_DOMAIN
 SG_ RouteInfoChar_09 : 232|8@1+ (1,0) [0|255] "ascii" ADAS_DOMAIN
 SG_ RouteInfoChar_10 : 240|8@1+ (1,0) [0|255] "ascii" ADAS_DOMAIN
 SG_ RouteInfoChar_11 : 248|8@1+ (1,0) [0|255] "ascii" ADAS_DOMAIN
 SG_ RouteInfoChar_12 : 256|8@1+ (1,0) [0|255] "ascii" ADAS_DOMAIN
 SG_ RouteInfoChar_13 : 264|8@1+ (1,0) [0|255] "ascii" ADAS_DOMAIN
 SG_ RouteInfoChar_14 : 272|8@1+ (1,0) [0|255] "ascii" ADAS_DOMAIN
 SG_ RouteInfoChar_15 : 280|8@1+ (1,0) [0|255] "ascii" ADAS_DOMAIN
 SG_ RouteInfoChar_16 : 288|8@1+ (1,0) [0|255] "ascii" ADAS_DOMAIN
 SG_ RouteInfoChar_17 : 296|8@1+ (1,0) [0|255] "ascii" ADAS_DOMAIN
 SG_ RouteInfoChar_18 : 304|8@1+ (1,0) [0|255] "ascii" ADAS_DOMAIN
 SG_ RouteInfoChar_19 : 312|8@1+ (1,0) [0|255] "ascii" ADAS_DOMAIN
 SG_ RouteInfoChar_20 : 320|8@1+ (1,0) [0|255] "ascii" ADAS_DOMAIN
 SG_ RouteInfoChar_21 : 328|8@1+ (1,0) [0|255] "ascii" ADAS_DOMAIN
 SG_ RouteInfoChar_22 : 336|8@1+ (1,0) [0|255] "ascii" ADAS_DOMAIN
 SG_ RouteInfoChar_23 : 344|8@1+ (1,0) [0|255] "ascii" ADAS_DOMAIN
 SG_ RouteInfoChar_24 : 352|8@1+ (1,0) [0|255] "ascii" ADAS_DOMAIN
 SG_ RouteInfoChar_25 : 360|8@1+ (1,0) [0|255] "ascii" ADAS_DOMAIN
 SG_ RouteInfoChar_26 : 368|8@1+ (1,0) [0|255] "ascii" ADAS_DOMAIN
 SG_ RouteInfoChar_27 : 376|8@1+ (1,0) [0|255] "ascii" ADAS_DOMAIN
 SG_ RouteInfoChar_28 : 384|8@1+ (1,0) [0|255] "ascii" ADAS_DOMAIN
 SG_ RouteInfoChar_29 : 392|8@1+ (1,0) [0|255] "ascii" ADAS_DOMAIN
 SG_ RouteInfoChar_30 : 400|8@1+ (1,0) [0|255] "ascii" ADAS_DOMAIN
 SG_ RouteInfoChar_31 : 408|8@1+ (1,0) [0|255] "ascii" ADAS_DOMAIN
 SG_ RouteInfoChar_32 : 416|8@1+ (1,0) [0|255] "ascii" ADAS_DOMAIN
 SG_ RouteInfoChar_33 : 424|8@1+ (1,0) [0|255] "ascii" ADAS_DOMAIN
 SG_ RouteInfoChar_34 : 432|8@1+ (1,0) [0|255] "ascii" ADAS_DOMAIN
 SG_ RouteInfoChar_35 : 440|8@1+ (1,0) [0|255] "ascii" ADAS_DOMAIN
 SG_ RouteInfoChar_36 : 448|8@1+ (1,0) [0|255] "ascii" ADAS_DOMAIN
 SG_ RouteInfoChar_37 : 456|8@1+ (1,0) [0|255] "ascii" ADAS_DOMAIN
 SG_ RouteInfoChar_38 : 464|8@1+ (1,0) [0|255] "ascii" ADAS_DOMAIN
 SG_ RouteInfoChar_39 : 472|8@1+ (1,0) [0|255] "ascii" ADAS_DOMAIN
 SG_ RouteInfoChar_40 : 480|8@1+ (1,0) [0|255] "ascii" ADAS_DOMAIN
 SG_ RouteInfoChar_41 : 488|8@1+ (1,0) [0|255] "ascii" ADAS_DOMAIN
 SG_ RouteInfoChar_42 : 496|8@1+ (1,0) [0|255] "ascii" ADAS_DOMAIN
 SG_ RouteInfoChar_43 : 504|8@1+ (1,0) [0|255] "ascii" ADAS_DOMAIN

CM_ BO_ 449 "Cycle=33ms; Channel=CAN1; CAN-FD; NominalBitrate=500kbit/s; DataBitrate=5000kbit/s;  Data request; receiver answers with response frame; PayloadRouteInfo='CAMERA_FRONT_WIDE -> ADAS_DOMAIN' in bytes 20-63;";

BO_ 1597 RESP_061_ADAS_DOMAIN_TO_CAMERA_FRONT_WIDE: 16 ADAS_DOMAIN
 SG_ CRC8 : 0|8@1+ (1,0) [0|255] "" CAMERA_FRONT_WIDE
 SG_ ResponseCounter : 8|4@1+ (1,0) [0|15] "" CAMERA_FRONT_WIDE
 SG_ AckState : 12|4@1+ (1,0) [0|15] "" CAMERA_FRONT_WIDE
 SG_ ReceivedFrameId : 16|11@1+ (1,0) [0|2047] "" CAMERA_FRONT_WIDE
 SG_ ReceivedCounter : 27|4@1+ (1,0) [0|15] "" CAMERA_FRONT_WIDE
 SG_ ChecksumOk : 31|1@1+ (1,0) [0|1] "" CAMERA_FRONT_WIDE
 SG_ PayloadLength : 32|8@1+ (1,0) [0|64] "byte" CAMERA_FRONT_WIDE
 SG_ ErrorCode : 40|8@1+ (1,0) [0|255] "" CAMERA_FRONT_WIDE
 SG_ ProcessingTimeUs : 48|16@1+ (1,0) [0|65535] "us" CAMERA_FRONT_WIDE
 SG_ ResponseSequence : 64|16@1+ (1,0) [0|65535] "" CAMERA_FRONT_WIDE
 SG_ ReceivedCrc : 80|8@1+ (1,0) [0|255] "" CAMERA_FRONT_WIDE
 SG_ CalculatedCrc : 88|8@1+ (1,0) [0|255] "" CAMERA_FRONT_WIDE

CM_ BO_ 1597 "Cycle=33ms; Channel=CAN1; CAN-FD; NominalBitrate=500kbit/s; DataBitrate=5000kbit/s;  ResponseFor=0x1C1; ACK/NACK with CRC, DLC and counter check;";

BO_ 450 DATA_062_RADAR_TARGET_LIST: 64 RADAR_FRONT_LONG_RANGE
 SG_ CRC8 : 0|8@1+ (1,0) [0|255] "" ADAS_DOMAIN
 SG_ AliveCounter : 8|4@1+ (1,0) [0|15] "" ADAS_DOMAIN
 SG_ MuxState : 12|4@1+ (1,0) [0|15] "" ADAS_DOMAIN
 SG_ SIG_1C2_00 : 16|12@1+ (0.1,0.0) [0|4095] "C" ADAS_DOMAIN
 SG_ SIG_1C2_01 : 28|12@1+ (0.1,0.0) [0|4095] "C" ADAS_DOMAIN
 SG_ SIG_1C2_02 : 40|12@1+ (0.1,0.0) [0|4095] "km/h" ADAS_DOMAIN
 SG_ SIG_1C2_03 : 52|12@1+ (0.1,0.0) [0|4095] "rpm" ADAS_DOMAIN
 SG_ SIG_1C2_04 : 64|12@1+ (0.1,0.0) [0|4095] "V" ADAS_DOMAIN
 SG_ SIG_1C2_05 : 76|12@1+ (0.1,0.0) [0|4095] "Nm" ADAS_DOMAIN
 SG_ SIG_1C2_06 : 88|12@1+ (0.1,0.0) [0|4095] "%" ADAS_DOMAIN
 SG_ SIG_1C2_07 : 100|12@1+ (0.1,0.0) [0|4095] "Nm" ADAS_DOMAIN
 SG_ SIG_1C2_08 : 112|12@1+ (0.1,0.0) [0|4095] "V" ADAS_DOMAIN
 SG_ SIG_1C2_09 : 124|12@1+ (0.1,0.0) [0|4095] "obj" ADAS_DOMAIN
 SG_ SIG_1C2_10 : 136|12@1+ (0.1,0.0) [0|4095] "A" ADAS_DOMAIN
 SG_ SIG_1C2_11 : 148|12@1+ (0.1,0.0) [0|4095] "C" ADAS_DOMAIN
 SG_ RouteInfoChar_00 : 160|8@1+ (1,0) [0|255] "ascii" ADAS_DOMAIN
 SG_ RouteInfoChar_01 : 168|8@1+ (1,0) [0|255] "ascii" ADAS_DOMAIN
 SG_ RouteInfoChar_02 : 176|8@1+ (1,0) [0|255] "ascii" ADAS_DOMAIN
 SG_ RouteInfoChar_03 : 184|8@1+ (1,0) [0|255] "ascii" ADAS_DOMAIN
 SG_ RouteInfoChar_04 : 192|8@1+ (1,0) [0|255] "ascii" ADAS_DOMAIN
 SG_ RouteInfoChar_05 : 200|8@1+ (1,0) [0|255] "ascii" ADAS_DOMAIN
 SG_ RouteInfoChar_06 : 208|8@1+ (1,0) [0|255] "ascii" ADAS_DOMAIN
 SG_ RouteInfoChar_07 : 216|8@1+ (1,0) [0|255] "ascii" ADAS_DOMAIN
 SG_ RouteInfoChar_08 : 224|8@1+ (1,0) [0|255] "ascii" ADAS_DOMAIN
 SG_ RouteInfoChar_09 : 232|8@1+ (1,0) [0|255] "ascii" ADAS_DOMAIN
 SG_ RouteInfoChar_10 : 240|8@1+ (1,0) [0|255] "ascii" ADAS_DOMAIN
 SG_ RouteInfoChar_11 : 248|8@1+ (1,0) [0|255] "ascii" ADAS_DOMAIN
 SG_ RouteInfoChar_12 : 256|8@1+ (1,0) [0|255] "ascii" ADAS_DOMAIN
 SG_ RouteInfoChar_13 : 264|8@1+ (1,0) [0|255] "ascii" ADAS_DOMAIN
 SG_ RouteInfoChar_14 : 272|8@1+ (1,0) [0|255] "ascii" ADAS_DOMAIN
 SG_ RouteInfoChar_15 : 280|8@1+ (1,0) [0|255] "ascii" ADAS_DOMAIN
 SG_ RouteInfoChar_16 : 288|8@1+ (1,0) [0|255] "ascii" ADAS_DOMAIN
 SG_ RouteInfoChar_17 : 296|8@1+ (1,0) [0|255] "ascii" ADAS_DOMAIN
 SG_ RouteInfoChar_18 : 304|8@1+ (1,0) [0|255] "ascii" ADAS_DOMAIN
 SG_ RouteInfoChar_19 : 312|8@1+ (1,0) [0|255] "ascii" ADAS_DOMAIN
 SG_ RouteInfoChar_20 : 320|8@1+ (1,0) [0|255] "ascii" ADAS_DOMAIN
 SG_ RouteInfoChar_21 : 328|8@1+ (1,0) [0|255] "ascii" ADAS_DOMAIN
 SG_ RouteInfoChar_22 : 336|8@1+ (1,0) [0|255] "ascii" ADAS_DOMAIN
 SG_ RouteInfoChar_23 : 344|8@1+ (1,0) [0|255] "ascii" ADAS_DOMAIN
 SG_ RouteInfoChar_24 : 352|8@1+ (1,0) [0|255] "ascii" ADAS_DOMAIN
 SG_ RouteInfoChar_25 : 360|8@1+ (1,0) [0|255] "ascii" ADAS_DOMAIN
 SG_ RouteInfoChar_26 : 368|8@1+ (1,0) [0|255] "ascii" ADAS_DOMAIN
 SG_ RouteInfoChar_27 : 376|8@1+ (1,0) [0|255] "ascii" ADAS_DOMAIN
 SG_ RouteInfoChar_28 : 384|8@1+ (1,0) [0|255] "ascii" ADAS_DOMAIN
 SG_ RouteInfoChar_29 : 392|8@1+ (1,0) [0|255] "ascii" ADAS_DOMAIN
 SG_ RouteInfoChar_30 : 400|8@1+ (1,0) [0|255] "ascii" ADAS_DOMAIN
 SG_ RouteInfoChar_31 : 408|8@1+ (1,0) [0|255] "ascii" ADAS_DOMAIN
 SG_ RouteInfoChar_32 : 416|8@1+ (1,0) [0|255] "ascii" ADAS_DOMAIN
 SG_ RouteInfoChar_33 : 424|8@1+ (1,0) [0|255] "ascii" ADAS_DOMAIN
 SG_ RouteInfoChar_34 : 432|8@1+ (1,0) [0|255] "ascii" ADAS_DOMAIN
 SG_ RouteInfoChar_35 : 440|8@1+ (1,0) [0|255] "ascii" ADAS_DOMAIN
 SG_ RouteInfoChar_36 : 448|8@1+ (1,0) [0|255] "ascii" ADAS_DOMAIN
 SG_ RouteInfoChar_37 : 456|8@1+ (1,0) [0|255] "ascii" ADAS_DOMAIN
 SG_ RouteInfoChar_38 : 464|8@1+ (1,0) [0|255] "ascii" ADAS_DOMAIN
 SG_ RouteInfoChar_39 : 472|8@1+ (1,0) [0|255] "ascii" ADAS_DOMAIN
 SG_ RouteInfoChar_40 : 480|8@1+ (1,0) [0|255] "ascii" ADAS_DOMAIN
 SG_ RouteInfoChar_41 : 488|8@1+ (1,0) [0|255] "ascii" ADAS_DOMAIN
 SG_ RouteInfoChar_42 : 496|8@1+ (1,0) [0|255] "ascii" ADAS_DOMAIN
 SG_ RouteInfoChar_43 : 504|8@1+ (1,0) [0|255] "ascii" ADAS_DOMAIN

CM_ BO_ 450 "Cycle=20ms; Channel=CAN2; CAN-FD; NominalBitrate=500kbit/s; DataBitrate=5000kbit/s;  Data request; receiver answers with response frame; PayloadRouteInfo='RADAR_FRONT_LONG_RANGE -> ADAS_DOMAIN' in bytes 20-63;";

BO_ 1598 RESP_062_ADAS_DOMAIN_TO_RADAR_FRONT_LONG_RANGE: 16 ADAS_DOMAIN
 SG_ CRC8 : 0|8@1+ (1,0) [0|255] "" RADAR_FRONT_LONG_RANGE
 SG_ ResponseCounter : 8|4@1+ (1,0) [0|15] "" RADAR_FRONT_LONG_RANGE
 SG_ AckState : 12|4@1+ (1,0) [0|15] "" RADAR_FRONT_LONG_RANGE
 SG_ ReceivedFrameId : 16|11@1+ (1,0) [0|2047] "" RADAR_FRONT_LONG_RANGE
 SG_ ReceivedCounter : 27|4@1+ (1,0) [0|15] "" RADAR_FRONT_LONG_RANGE
 SG_ ChecksumOk : 31|1@1+ (1,0) [0|1] "" RADAR_FRONT_LONG_RANGE
 SG_ PayloadLength : 32|8@1+ (1,0) [0|64] "byte" RADAR_FRONT_LONG_RANGE
 SG_ ErrorCode : 40|8@1+ (1,0) [0|255] "" RADAR_FRONT_LONG_RANGE
 SG_ ProcessingTimeUs : 48|16@1+ (1,0) [0|65535] "us" RADAR_FRONT_LONG_RANGE
 SG_ ResponseSequence : 64|16@1+ (1,0) [0|65535] "" RADAR_FRONT_LONG_RANGE
 SG_ ReceivedCrc : 80|8@1+ (1,0) [0|255] "" RADAR_FRONT_LONG_RANGE
 SG_ CalculatedCrc : 88|8@1+ (1,0) [0|255] "" RADAR_FRONT_LONG_RANGE

CM_ BO_ 1598 "Cycle=20ms; Channel=CAN2; CAN-FD; NominalBitrate=500kbit/s; DataBitrate=5000kbit/s;  ResponseFor=0x1C2; ACK/NACK with CRC, DLC and counter check;";

BO_ 451 DATA_063_REAR_CROSS_TRAFFIC: 64 RADAR_REAR_CROSS_TRAFFIC
 SG_ CRC8 : 0|8@1+ (1,0) [0|255] "" ADAS_DOMAIN
 SG_ AliveCounter : 8|4@1+ (1,0) [0|15] "" ADAS_DOMAIN
 SG_ MuxState : 12|4@1+ (1,0) [0|15] "" ADAS_DOMAIN
 SG_ SIG_1C3_00 : 16|12@1+ (0.1,0.0) [0|4095] "m" ADAS_DOMAIN
 SG_ SIG_1C3_01 : 28|12@1+ (0.1,0.0) [0|4095] "m" ADAS_DOMAIN
 SG_ SIG_1C3_02 : 40|12@1+ (0.1,0.0) [0|4095] "A" ADAS_DOMAIN
 SG_ SIG_1C3_03 : 52|12@1+ (0.1,0.0) [0|4095] "%" ADAS_DOMAIN
 SG_ SIG_1C3_04 : 64|12@1+ (0.1,0.0) [0|4095] "m" ADAS_DOMAIN
 SG_ SIG_1C3_05 : 76|12@1+ (0.1,0.0) [0|4095] "A" ADAS_DOMAIN
 SG_ SIG_1C3_06 : 88|12@1+ (0.1,0.0) [0|4095] "A" ADAS_DOMAIN
 SG_ SIG_1C3_07 : 100|12@1+ (0.1,0.0) [0|4095] "C" ADAS_DOMAIN
 SG_ SIG_1C3_08 : 112|12@1+ (0.1,0.0) [0|4095] "V" ADAS_DOMAIN
 SG_ SIG_1C3_09 : 124|12@1+ (0.1,0.0) [0|4095] "V" ADAS_DOMAIN
 SG_ SIG_1C3_10 : 136|12@1+ (0.1,0.0) [0|4095] "V" ADAS_DOMAIN
 SG_ SIG_1C3_11 : 148|12@1+ (0.1,0.0) [0|4095] "Nm" ADAS_DOMAIN
 SG_ RouteInfoChar_00 : 160|8@1+ (1,0) [0|255] "ascii" ADAS_DOMAIN
 SG_ RouteInfoChar_01 : 168|8@1+ (1,0) [0|255] "ascii" ADAS_DOMAIN
 SG_ RouteInfoChar_02 : 176|8@1+ (1,0) [0|255] "ascii" ADAS_DOMAIN
 SG_ RouteInfoChar_03 : 184|8@1+ (1,0) [0|255] "ascii" ADAS_DOMAIN
 SG_ RouteInfoChar_04 : 192|8@1+ (1,0) [0|255] "ascii" ADAS_DOMAIN
 SG_ RouteInfoChar_05 : 200|8@1+ (1,0) [0|255] "ascii" ADAS_DOMAIN
 SG_ RouteInfoChar_06 : 208|8@1+ (1,0) [0|255] "ascii" ADAS_DOMAIN
 SG_ RouteInfoChar_07 : 216|8@1+ (1,0) [0|255] "ascii" ADAS_DOMAIN
 SG_ RouteInfoChar_08 : 224|8@1+ (1,0) [0|255] "ascii" ADAS_DOMAIN
 SG_ RouteInfoChar_09 : 232|8@1+ (1,0) [0|255] "ascii" ADAS_DOMAIN
 SG_ RouteInfoChar_10 : 240|8@1+ (1,0) [0|255] "ascii" ADAS_DOMAIN
 SG_ RouteInfoChar_11 : 248|8@1+ (1,0) [0|255] "ascii" ADAS_DOMAIN
 SG_ RouteInfoChar_12 : 256|8@1+ (1,0) [0|255] "ascii" ADAS_DOMAIN
 SG_ RouteInfoChar_13 : 264|8@1+ (1,0) [0|255] "ascii" ADAS_DOMAIN
 SG_ RouteInfoChar_14 : 272|8@1+ (1,0) [0|255] "ascii" ADAS_DOMAIN
 SG_ RouteInfoChar_15 : 280|8@1+ (1,0) [0|255] "ascii" ADAS_DOMAIN
 SG_ RouteInfoChar_16 : 288|8@1+ (1,0) [0|255] "ascii" ADAS_DOMAIN
 SG_ RouteInfoChar_17 : 296|8@1+ (1,0) [0|255] "ascii" ADAS_DOMAIN
 SG_ RouteInfoChar_18 : 304|8@1+ (1,0) [0|255] "ascii" ADAS_DOMAIN
 SG_ RouteInfoChar_19 : 312|8@1+ (1,0) [0|255] "ascii" ADAS_DOMAIN
 SG_ RouteInfoChar_20 : 320|8@1+ (1,0) [0|255] "ascii" ADAS_DOMAIN
 SG_ RouteInfoChar_21 : 328|8@1+ (1,0) [0|255] "ascii" ADAS_DOMAIN
 SG_ RouteInfoChar_22 : 336|8@1+ (1,0) [0|255] "ascii" ADAS_DOMAIN
 SG_ RouteInfoChar_23 : 344|8@1+ (1,0) [0|255] "ascii" ADAS_DOMAIN
 SG_ RouteInfoChar_24 : 352|8@1+ (1,0) [0|255] "ascii" ADAS_DOMAIN
 SG_ RouteInfoChar_25 : 360|8@1+ (1,0) [0|255] "ascii" ADAS_DOMAIN
 SG_ RouteInfoChar_26 : 368|8@1+ (1,0) [0|255] "ascii" ADAS_DOMAIN
 SG_ RouteInfoChar_27 : 376|8@1+ (1,0) [0|255] "ascii" ADAS_DOMAIN
 SG_ RouteInfoChar_28 : 384|8@1+ (1,0) [0|255] "ascii" ADAS_DOMAIN
 SG_ RouteInfoChar_29 : 392|8@1+ (1,0) [0|255] "ascii" ADAS_DOMAIN
 SG_ RouteInfoChar_30 : 400|8@1+ (1,0) [0|255] "ascii" ADAS_DOMAIN
 SG_ RouteInfoChar_31 : 408|8@1+ (1,0) [0|255] "ascii" ADAS_DOMAIN
 SG_ RouteInfoChar_32 : 416|8@1+ (1,0) [0|255] "ascii" ADAS_DOMAIN
 SG_ RouteInfoChar_33 : 424|8@1+ (1,0) [0|255] "ascii" ADAS_DOMAIN
 SG_ RouteInfoChar_34 : 432|8@1+ (1,0) [0|255] "ascii" ADAS_DOMAIN
 SG_ RouteInfoChar_35 : 440|8@1+ (1,0) [0|255] "ascii" ADAS_DOMAIN
 SG_ RouteInfoChar_36 : 448|8@1+ (1,0) [0|255] "ascii" ADAS_DOMAIN
 SG_ RouteInfoChar_37 : 456|8@1+ (1,0) [0|255] "ascii" ADAS_DOMAIN
 SG_ RouteInfoChar_38 : 464|8@1+ (1,0) [0|255] "ascii" ADAS_DOMAIN
 SG_ RouteInfoChar_39 : 472|8@1+ (1,0) [0|255] "ascii" ADAS_DOMAIN
 SG_ RouteInfoChar_40 : 480|8@1+ (1,0) [0|255] "ascii" ADAS_DOMAIN
 SG_ RouteInfoChar_41 : 488|8@1+ (1,0) [0|255] "ascii" ADAS_DOMAIN
 SG_ RouteInfoChar_42 : 496|8@1+ (1,0) [0|255] "ascii" ADAS_DOMAIN
 SG_ RouteInfoChar_43 : 504|8@1+ (1,0) [0|255] "ascii" ADAS_DOMAIN

CM_ BO_ 451 "Cycle=50ms; Channel=CAN3; CAN-FD; NominalBitrate=500kbit/s; DataBitrate=5000kbit/s;  Data request; receiver answers with response frame; PayloadRouteInfo='RADAR_REAR_CROSS_TRAFFIC -> ADAS_DOMAIN' in bytes 20-63;";

BO_ 1599 RESP_063_ADAS_DOMAIN_TO_RADAR_REAR_CROSS_TRAFFIC: 16 ADAS_DOMAIN
 SG_ CRC8 : 0|8@1+ (1,0) [0|255] "" RADAR_REAR_CROSS_TRAFFIC
 SG_ ResponseCounter : 8|4@1+ (1,0) [0|15] "" RADAR_REAR_CROSS_TRAFFIC
 SG_ AckState : 12|4@1+ (1,0) [0|15] "" RADAR_REAR_CROSS_TRAFFIC
 SG_ ReceivedFrameId : 16|11@1+ (1,0) [0|2047] "" RADAR_REAR_CROSS_TRAFFIC
 SG_ ReceivedCounter : 27|4@1+ (1,0) [0|15] "" RADAR_REAR_CROSS_TRAFFIC
 SG_ ChecksumOk : 31|1@1+ (1,0) [0|1] "" RADAR_REAR_CROSS_TRAFFIC
 SG_ PayloadLength : 32|8@1+ (1,0) [0|64] "byte" RADAR_REAR_CROSS_TRAFFIC
 SG_ ErrorCode : 40|8@1+ (1,0) [0|255] "" RADAR_REAR_CROSS_TRAFFIC
 SG_ ProcessingTimeUs : 48|16@1+ (1,0) [0|65535] "us" RADAR_REAR_CROSS_TRAFFIC
 SG_ ResponseSequence : 64|16@1+ (1,0) [0|65535] "" RADAR_REAR_CROSS_TRAFFIC
 SG_ ReceivedCrc : 80|8@1+ (1,0) [0|255] "" RADAR_REAR_CROSS_TRAFFIC
 SG_ CalculatedCrc : 88|8@1+ (1,0) [0|255] "" RADAR_REAR_CROSS_TRAFFIC

CM_ BO_ 1599 "Cycle=50ms; Channel=CAN3; CAN-FD; NominalBitrate=500kbit/s; DataBitrate=5000kbit/s;  ResponseFor=0x1C3; ACK/NACK with CRC, DLC and counter check;";

BO_ 452 DATA_064_ULTRASONIC_LEFT_DISTANCE: 64 ULTRASONIC_LEFT_CLUSTER
 SG_ CRC8 : 0|8@1+ (1,0) [0|255] "" PARK_ASSIST
 SG_ AliveCounter : 8|4@1+ (1,0) [0|15] "" PARK_ASSIST
 SG_ MuxState : 12|4@1+ (1,0) [0|15] "" PARK_ASSIST
 SG_ SIG_1C4_00 : 16|12@1+ (0.1,0.0) [0|4095] "rpm" PARK_ASSIST
 SG_ SIG_1C4_01 : 28|12@1+ (0.1,0.0) [0|4095] "Nm" PARK_ASSIST
 SG_ SIG_1C4_02 : 40|12@1+ (0.1,0.0) [0|4095] "A" PARK_ASSIST
 SG_ SIG_1C4_03 : 52|12@1+ (0.1,0.0) [0|4095] "rpm" PARK_ASSIST
 SG_ SIG_1C4_04 : 64|12@1+ (0.1,0.0) [0|4095] "m" PARK_ASSIST
 SG_ SIG_1C4_05 : 76|12@1+ (0.1,0.0) [0|4095] "deg" PARK_ASSIST
 SG_ SIG_1C4_06 : 88|12@1+ (0.1,0.0) [0|4095] "Nm" PARK_ASSIST
 SG_ SIG_1C4_07 : 100|12@1+ (0.1,0.0) [0|4095] "Nm" PARK_ASSIST
 SG_ SIG_1C4_08 : 112|12@1+ (0.1,0.0) [0|4095] "C" PARK_ASSIST
 SG_ SIG_1C4_09 : 124|12@1+ (0.1,0.0) [0|4095] "V" PARK_ASSIST
 SG_ SIG_1C4_10 : 136|12@1+ (0.1,0.0) [0|4095] "obj" PARK_ASSIST
 SG_ SIG_1C4_11 : 148|12@1+ (0.1,0.0) [0|4095] "m" PARK_ASSIST
 SG_ RouteInfoChar_00 : 160|8@1+ (1,0) [0|255] "ascii" PARK_ASSIST
 SG_ RouteInfoChar_01 : 168|8@1+ (1,0) [0|255] "ascii" PARK_ASSIST
 SG_ RouteInfoChar_02 : 176|8@1+ (1,0) [0|255] "ascii" PARK_ASSIST
 SG_ RouteInfoChar_03 : 184|8@1+ (1,0) [0|255] "ascii" PARK_ASSIST
 SG_ RouteInfoChar_04 : 192|8@1+ (1,0) [0|255] "ascii" PARK_ASSIST
 SG_ RouteInfoChar_05 : 200|8@1+ (1,0) [0|255] "ascii" PARK_ASSIST
 SG_ RouteInfoChar_06 : 208|8@1+ (1,0) [0|255] "ascii" PARK_ASSIST
 SG_ RouteInfoChar_07 : 216|8@1+ (1,0) [0|255] "ascii" PARK_ASSIST
 SG_ RouteInfoChar_08 : 224|8@1+ (1,0) [0|255] "ascii" PARK_ASSIST
 SG_ RouteInfoChar_09 : 232|8@1+ (1,0) [0|255] "ascii" PARK_ASSIST
 SG_ RouteInfoChar_10 : 240|8@1+ (1,0) [0|255] "ascii" PARK_ASSIST
 SG_ RouteInfoChar_11 : 248|8@1+ (1,0) [0|255] "ascii" PARK_ASSIST
 SG_ RouteInfoChar_12 : 256|8@1+ (1,0) [0|255] "ascii" PARK_ASSIST
 SG_ RouteInfoChar_13 : 264|8@1+ (1,0) [0|255] "ascii" PARK_ASSIST
 SG_ RouteInfoChar_14 : 272|8@1+ (1,0) [0|255] "ascii" PARK_ASSIST
 SG_ RouteInfoChar_15 : 280|8@1+ (1,0) [0|255] "ascii" PARK_ASSIST
 SG_ RouteInfoChar_16 : 288|8@1+ (1,0) [0|255] "ascii" PARK_ASSIST
 SG_ RouteInfoChar_17 : 296|8@1+ (1,0) [0|255] "ascii" PARK_ASSIST
 SG_ RouteInfoChar_18 : 304|8@1+ (1,0) [0|255] "ascii" PARK_ASSIST
 SG_ RouteInfoChar_19 : 312|8@1+ (1,0) [0|255] "ascii" PARK_ASSIST
 SG_ RouteInfoChar_20 : 320|8@1+ (1,0) [0|255] "ascii" PARK_ASSIST
 SG_ RouteInfoChar_21 : 328|8@1+ (1,0) [0|255] "ascii" PARK_ASSIST
 SG_ RouteInfoChar_22 : 336|8@1+ (1,0) [0|255] "ascii" PARK_ASSIST
 SG_ RouteInfoChar_23 : 344|8@1+ (1,0) [0|255] "ascii" PARK_ASSIST
 SG_ RouteInfoChar_24 : 352|8@1+ (1,0) [0|255] "ascii" PARK_ASSIST
 SG_ RouteInfoChar_25 : 360|8@1+ (1,0) [0|255] "ascii" PARK_ASSIST
 SG_ RouteInfoChar_26 : 368|8@1+ (1,0) [0|255] "ascii" PARK_ASSIST
 SG_ RouteInfoChar_27 : 376|8@1+ (1,0) [0|255] "ascii" PARK_ASSIST
 SG_ RouteInfoChar_28 : 384|8@1+ (1,0) [0|255] "ascii" PARK_ASSIST
 SG_ RouteInfoChar_29 : 392|8@1+ (1,0) [0|255] "ascii" PARK_ASSIST
 SG_ RouteInfoChar_30 : 400|8@1+ (1,0) [0|255] "ascii" PARK_ASSIST
 SG_ RouteInfoChar_31 : 408|8@1+ (1,0) [0|255] "ascii" PARK_ASSIST
 SG_ RouteInfoChar_32 : 416|8@1+ (1,0) [0|255] "ascii" PARK_ASSIST
 SG_ RouteInfoChar_33 : 424|8@1+ (1,0) [0|255] "ascii" PARK_ASSIST
 SG_ RouteInfoChar_34 : 432|8@1+ (1,0) [0|255] "ascii" PARK_ASSIST
 SG_ RouteInfoChar_35 : 440|8@1+ (1,0) [0|255] "ascii" PARK_ASSIST
 SG_ RouteInfoChar_36 : 448|8@1+ (1,0) [0|255] "ascii" PARK_ASSIST
 SG_ RouteInfoChar_37 : 456|8@1+ (1,0) [0|255] "ascii" PARK_ASSIST
 SG_ RouteInfoChar_38 : 464|8@1+ (1,0) [0|255] "ascii" PARK_ASSIST
 SG_ RouteInfoChar_39 : 472|8@1+ (1,0) [0|255] "ascii" PARK_ASSIST
 SG_ RouteInfoChar_40 : 480|8@1+ (1,0) [0|255] "ascii" PARK_ASSIST
 SG_ RouteInfoChar_41 : 488|8@1+ (1,0) [0|255] "ascii" PARK_ASSIST
 SG_ RouteInfoChar_42 : 496|8@1+ (1,0) [0|255] "ascii" PARK_ASSIST
 SG_ RouteInfoChar_43 : 504|8@1+ (1,0) [0|255] "ascii" PARK_ASSIST

CM_ BO_ 452 "Cycle=40ms; Channel=CAN4; CAN-FD; NominalBitrate=500kbit/s; DataBitrate=5000kbit/s;  Data request; receiver answers with response frame; PayloadRouteInfo='ULTRASONIC_LEFT_CLUSTER -> PARK_ASSIST' in bytes 20-63;";

BO_ 1600 RESP_064_PARK_ASSIST_TO_ULTRASONIC_LEFT_CLUSTER: 16 PARK_ASSIST
 SG_ CRC8 : 0|8@1+ (1,0) [0|255] "" ULTRASONIC_LEFT_CLUSTER
 SG_ ResponseCounter : 8|4@1+ (1,0) [0|15] "" ULTRASONIC_LEFT_CLUSTER
 SG_ AckState : 12|4@1+ (1,0) [0|15] "" ULTRASONIC_LEFT_CLUSTER
 SG_ ReceivedFrameId : 16|11@1+ (1,0) [0|2047] "" ULTRASONIC_LEFT_CLUSTER
 SG_ ReceivedCounter : 27|4@1+ (1,0) [0|15] "" ULTRASONIC_LEFT_CLUSTER
 SG_ ChecksumOk : 31|1@1+ (1,0) [0|1] "" ULTRASONIC_LEFT_CLUSTER
 SG_ PayloadLength : 32|8@1+ (1,0) [0|64] "byte" ULTRASONIC_LEFT_CLUSTER
 SG_ ErrorCode : 40|8@1+ (1,0) [0|255] "" ULTRASONIC_LEFT_CLUSTER
 SG_ ProcessingTimeUs : 48|16@1+ (1,0) [0|65535] "us" ULTRASONIC_LEFT_CLUSTER
 SG_ ResponseSequence : 64|16@1+ (1,0) [0|65535] "" ULTRASONIC_LEFT_CLUSTER
 SG_ ReceivedCrc : 80|8@1+ (1,0) [0|255] "" ULTRASONIC_LEFT_CLUSTER
 SG_ CalculatedCrc : 88|8@1+ (1,0) [0|255] "" ULTRASONIC_LEFT_CLUSTER

CM_ BO_ 1600 "Cycle=40ms; Channel=CAN4; CAN-FD; NominalBitrate=500kbit/s; DataBitrate=5000kbit/s;  ResponseFor=0x1C4; ACK/NACK with CRC, DLC and counter check;";

BO_ 453 DATA_065_ULTRASONIC_RIGHT_DISTANCE: 64 ULTRASONIC_RIGHT_CLUSTER
 SG_ CRC8 : 0|8@1+ (1,0) [0|255] "" PARK_ASSIST
 SG_ AliveCounter : 8|4@1+ (1,0) [0|15] "" PARK_ASSIST
 SG_ MuxState : 12|4@1+ (1,0) [0|15] "" PARK_ASSIST
 SG_ SIG_1C5_00 : 16|12@1+ (0.1,0.0) [0|4095] "obj" PARK_ASSIST
 SG_ SIG_1C5_01 : 28|12@1+ (0.1,0.0) [0|4095] "V" PARK_ASSIST
 SG_ SIG_1C5_02 : 40|12@1+ (0.1,0.0) [0|4095] "rpm" PARK_ASSIST
 SG_ SIG_1C5_03 : 52|12@1+ (0.1,0.0) [0|4095] "Nm" PARK_ASSIST
 SG_ SIG_1C5_04 : 64|12@1+ (0.1,0.0) [0|4095] "V" PARK_ASSIST
 SG_ SIG_1C5_05 : 76|12@1+ (0.1,0.0) [0|4095] "Nm" PARK_ASSIST
 SG_ SIG_1C5_06 : 88|12@1+ (0.1,0.0) [0|4095] "A" PARK_ASSIST
 SG_ SIG_1C5_07 : 100|12@1+ (0.1,0.0) [0|4095] "deg" PARK_ASSIST
 SG_ SIG_1C5_08 : 112|12@1+ (0.1,0.0) [0|4095] "V" PARK_ASSIST
 SG_ SIG_1C5_09 : 124|12@1+ (0.1,0.0) [0|4095] "km/h" PARK_ASSIST
 SG_ SIG_1C5_10 : 136|12@1+ (0.1,0.0) [0|4095] "m" PARK_ASSIST
 SG_ SIG_1C5_11 : 148|12@1+ (0.1,0.0) [0|4095] "deg" PARK_ASSIST
 SG_ RouteInfoChar_00 : 160|8@1+ (1,0) [0|255] "ascii" PARK_ASSIST
 SG_ RouteInfoChar_01 : 168|8@1+ (1,0) [0|255] "ascii" PARK_ASSIST
 SG_ RouteInfoChar_02 : 176|8@1+ (1,0) [0|255] "ascii" PARK_ASSIST
 SG_ RouteInfoChar_03 : 184|8@1+ (1,0) [0|255] "ascii" PARK_ASSIST
 SG_ RouteInfoChar_04 : 192|8@1+ (1,0) [0|255] "ascii" PARK_ASSIST
 SG_ RouteInfoChar_05 : 200|8@1+ (1,0) [0|255] "ascii" PARK_ASSIST
 SG_ RouteInfoChar_06 : 208|8@1+ (1,0) [0|255] "ascii" PARK_ASSIST
 SG_ RouteInfoChar_07 : 216|8@1+ (1,0) [0|255] "ascii" PARK_ASSIST
 SG_ RouteInfoChar_08 : 224|8@1+ (1,0) [0|255] "ascii" PARK_ASSIST
 SG_ RouteInfoChar_09 : 232|8@1+ (1,0) [0|255] "ascii" PARK_ASSIST
 SG_ RouteInfoChar_10 : 240|8@1+ (1,0) [0|255] "ascii" PARK_ASSIST
 SG_ RouteInfoChar_11 : 248|8@1+ (1,0) [0|255] "ascii" PARK_ASSIST
 SG_ RouteInfoChar_12 : 256|8@1+ (1,0) [0|255] "ascii" PARK_ASSIST
 SG_ RouteInfoChar_13 : 264|8@1+ (1,0) [0|255] "ascii" PARK_ASSIST
 SG_ RouteInfoChar_14 : 272|8@1+ (1,0) [0|255] "ascii" PARK_ASSIST
 SG_ RouteInfoChar_15 : 280|8@1+ (1,0) [0|255] "ascii" PARK_ASSIST
 SG_ RouteInfoChar_16 : 288|8@1+ (1,0) [0|255] "ascii" PARK_ASSIST
 SG_ RouteInfoChar_17 : 296|8@1+ (1,0) [0|255] "ascii" PARK_ASSIST
 SG_ RouteInfoChar_18 : 304|8@1+ (1,0) [0|255] "ascii" PARK_ASSIST
 SG_ RouteInfoChar_19 : 312|8@1+ (1,0) [0|255] "ascii" PARK_ASSIST
 SG_ RouteInfoChar_20 : 320|8@1+ (1,0) [0|255] "ascii" PARK_ASSIST
 SG_ RouteInfoChar_21 : 328|8@1+ (1,0) [0|255] "ascii" PARK_ASSIST
 SG_ RouteInfoChar_22 : 336|8@1+ (1,0) [0|255] "ascii" PARK_ASSIST
 SG_ RouteInfoChar_23 : 344|8@1+ (1,0) [0|255] "ascii" PARK_ASSIST
 SG_ RouteInfoChar_24 : 352|8@1+ (1,0) [0|255] "ascii" PARK_ASSIST
 SG_ RouteInfoChar_25 : 360|8@1+ (1,0) [0|255] "ascii" PARK_ASSIST
 SG_ RouteInfoChar_26 : 368|8@1+ (1,0) [0|255] "ascii" PARK_ASSIST
 SG_ RouteInfoChar_27 : 376|8@1+ (1,0) [0|255] "ascii" PARK_ASSIST
 SG_ RouteInfoChar_28 : 384|8@1+ (1,0) [0|255] "ascii" PARK_ASSIST
 SG_ RouteInfoChar_29 : 392|8@1+ (1,0) [0|255] "ascii" PARK_ASSIST
 SG_ RouteInfoChar_30 : 400|8@1+ (1,0) [0|255] "ascii" PARK_ASSIST
 SG_ RouteInfoChar_31 : 408|8@1+ (1,0) [0|255] "ascii" PARK_ASSIST
 SG_ RouteInfoChar_32 : 416|8@1+ (1,0) [0|255] "ascii" PARK_ASSIST
 SG_ RouteInfoChar_33 : 424|8@1+ (1,0) [0|255] "ascii" PARK_ASSIST
 SG_ RouteInfoChar_34 : 432|8@1+ (1,0) [0|255] "ascii" PARK_ASSIST
 SG_ RouteInfoChar_35 : 440|8@1+ (1,0) [0|255] "ascii" PARK_ASSIST
 SG_ RouteInfoChar_36 : 448|8@1+ (1,0) [0|255] "ascii" PARK_ASSIST
 SG_ RouteInfoChar_37 : 456|8@1+ (1,0) [0|255] "ascii" PARK_ASSIST
 SG_ RouteInfoChar_38 : 464|8@1+ (1,0) [0|255] "ascii" PARK_ASSIST
 SG_ RouteInfoChar_39 : 472|8@1+ (1,0) [0|255] "ascii" PARK_ASSIST
 SG_ RouteInfoChar_40 : 480|8@1+ (1,0) [0|255] "ascii" PARK_ASSIST
 SG_ RouteInfoChar_41 : 488|8@1+ (1,0) [0|255] "ascii" PARK_ASSIST
 SG_ RouteInfoChar_42 : 496|8@1+ (1,0) [0|255] "ascii" PARK_ASSIST
 SG_ RouteInfoChar_43 : 504|8@1+ (1,0) [0|255] "ascii" PARK_ASSIST

CM_ BO_ 453 "Cycle=40ms; Channel=CAN5; CAN-FD; NominalBitrate=500kbit/s; DataBitrate=5000kbit/s;  Data request; receiver answers with response frame; PayloadRouteInfo='ULTRASONIC_RIGHT_CLUSTER -> PARK_ASSIST' in bytes 20-63;";

BO_ 1601 RESP_065_PARK_ASSIST_TO_ULTRASONIC_RIGHT_CLUSTER: 16 PARK_ASSIST
 SG_ CRC8 : 0|8@1+ (1,0) [0|255] "" ULTRASONIC_RIGHT_CLUSTER
 SG_ ResponseCounter : 8|4@1+ (1,0) [0|15] "" ULTRASONIC_RIGHT_CLUSTER
 SG_ AckState : 12|4@1+ (1,0) [0|15] "" ULTRASONIC_RIGHT_CLUSTER
 SG_ ReceivedFrameId : 16|11@1+ (1,0) [0|2047] "" ULTRASONIC_RIGHT_CLUSTER
 SG_ ReceivedCounter : 27|4@1+ (1,0) [0|15] "" ULTRASONIC_RIGHT_CLUSTER
 SG_ ChecksumOk : 31|1@1+ (1,0) [0|1] "" ULTRASONIC_RIGHT_CLUSTER
 SG_ PayloadLength : 32|8@1+ (1,0) [0|64] "byte" ULTRASONIC_RIGHT_CLUSTER
 SG_ ErrorCode : 40|8@1+ (1,0) [0|255] "" ULTRASONIC_RIGHT_CLUSTER
 SG_ ProcessingTimeUs : 48|16@1+ (1,0) [0|65535] "us" ULTRASONIC_RIGHT_CLUSTER
 SG_ ResponseSequence : 64|16@1+ (1,0) [0|65535] "" ULTRASONIC_RIGHT_CLUSTER
 SG_ ReceivedCrc : 80|8@1+ (1,0) [0|255] "" ULTRASONIC_RIGHT_CLUSTER
 SG_ CalculatedCrc : 88|8@1+ (1,0) [0|255] "" ULTRASONIC_RIGHT_CLUSTER

CM_ BO_ 1601 "Cycle=40ms; Channel=CAN5; CAN-FD; NominalBitrate=500kbit/s; DataBitrate=5000kbit/s;  ResponseFor=0x1C5; ACK/NACK with CRC, DLC and counter check;";

BO_ 454 DATA_066_IMU_DYNAMICS: 64 IMU_YAW_RATE_SENSOR
 SG_ CRC8 : 0|8@1+ (1,0) [0|255] "" ADAS_DOMAIN
 SG_ AliveCounter : 8|4@1+ (1,0) [0|15] "" ADAS_DOMAIN
 SG_ MuxState : 12|4@1+ (1,0) [0|15] "" ADAS_DOMAIN
 SG_ SIG_1C6_00 : 16|12@1+ (0.1,0.0) [0|4095] "V" ADAS_DOMAIN
 SG_ SIG_1C6_01 : 28|12@1+ (0.1,0.0) [0|4095] "km/h" ADAS_DOMAIN
 SG_ SIG_1C6_02 : 40|12@1+ (0.1,0.0) [0|4095] "km/h" ADAS_DOMAIN
 SG_ SIG_1C6_03 : 52|12@1+ (0.1,0.0) [0|4095] "m" ADAS_DOMAIN
 SG_ SIG_1C6_04 : 64|12@1+ (0.1,0.0) [0|4095] "V" ADAS_DOMAIN
 SG_ SIG_1C6_05 : 76|12@1+ (0.1,0.0) [0|4095] "deg" ADAS_DOMAIN
 SG_ SIG_1C6_06 : 88|12@1+ (0.1,0.0) [0|4095] "C" ADAS_DOMAIN
 SG_ SIG_1C6_07 : 100|12@1+ (0.1,0.0) [0|4095] "rpm" ADAS_DOMAIN
 SG_ SIG_1C6_08 : 112|12@1+ (0.1,0.0) [0|4095] "km/h" ADAS_DOMAIN
 SG_ SIG_1C6_09 : 124|12@1+ (0.1,0.0) [0|4095] "obj" ADAS_DOMAIN
 SG_ SIG_1C6_10 : 136|12@1+ (0.1,0.0) [0|4095] "V" ADAS_DOMAIN
 SG_ SIG_1C6_11 : 148|12@1+ (0.1,0.0) [0|4095] "C" ADAS_DOMAIN
 SG_ RouteInfoChar_00 : 160|8@1+ (1,0) [0|255] "ascii" ADAS_DOMAIN
 SG_ RouteInfoChar_01 : 168|8@1+ (1,0) [0|255] "ascii" ADAS_DOMAIN
 SG_ RouteInfoChar_02 : 176|8@1+ (1,0) [0|255] "ascii" ADAS_DOMAIN
 SG_ RouteInfoChar_03 : 184|8@1+ (1,0) [0|255] "ascii" ADAS_DOMAIN
 SG_ RouteInfoChar_04 : 192|8@1+ (1,0) [0|255] "ascii" ADAS_DOMAIN
 SG_ RouteInfoChar_05 : 200|8@1+ (1,0) [0|255] "ascii" ADAS_DOMAIN
 SG_ RouteInfoChar_06 : 208|8@1+ (1,0) [0|255] "ascii" ADAS_DOMAIN
 SG_ RouteInfoChar_07 : 216|8@1+ (1,0) [0|255] "ascii" ADAS_DOMAIN
 SG_ RouteInfoChar_08 : 224|8@1+ (1,0) [0|255] "ascii" ADAS_DOMAIN
 SG_ RouteInfoChar_09 : 232|8@1+ (1,0) [0|255] "ascii" ADAS_DOMAIN
 SG_ RouteInfoChar_10 : 240|8@1+ (1,0) [0|255] "ascii" ADAS_DOMAIN
 SG_ RouteInfoChar_11 : 248|8@1+ (1,0) [0|255] "ascii" ADAS_DOMAIN
 SG_ RouteInfoChar_12 : 256|8@1+ (1,0) [0|255] "ascii" ADAS_DOMAIN
 SG_ RouteInfoChar_13 : 264|8@1+ (1,0) [0|255] "ascii" ADAS_DOMAIN
 SG_ RouteInfoChar_14 : 272|8@1+ (1,0) [0|255] "ascii" ADAS_DOMAIN
 SG_ RouteInfoChar_15 : 280|8@1+ (1,0) [0|255] "ascii" ADAS_DOMAIN
 SG_ RouteInfoChar_16 : 288|8@1+ (1,0) [0|255] "ascii" ADAS_DOMAIN
 SG_ RouteInfoChar_17 : 296|8@1+ (1,0) [0|255] "ascii" ADAS_DOMAIN
 SG_ RouteInfoChar_18 : 304|8@1+ (1,0) [0|255] "ascii" ADAS_DOMAIN
 SG_ RouteInfoChar_19 : 312|8@1+ (1,0) [0|255] "ascii" ADAS_DOMAIN
 SG_ RouteInfoChar_20 : 320|8@1+ (1,0) [0|255] "ascii" ADAS_DOMAIN
 SG_ RouteInfoChar_21 : 328|8@1+ (1,0) [0|255] "ascii" ADAS_DOMAIN
 SG_ RouteInfoChar_22 : 336|8@1+ (1,0) [0|255] "ascii" ADAS_DOMAIN
 SG_ RouteInfoChar_23 : 344|8@1+ (1,0) [0|255] "ascii" ADAS_DOMAIN
 SG_ RouteInfoChar_24 : 352|8@1+ (1,0) [0|255] "ascii" ADAS_DOMAIN
 SG_ RouteInfoChar_25 : 360|8@1+ (1,0) [0|255] "ascii" ADAS_DOMAIN
 SG_ RouteInfoChar_26 : 368|8@1+ (1,0) [0|255] "ascii" ADAS_DOMAIN
 SG_ RouteInfoChar_27 : 376|8@1+ (1,0) [0|255] "ascii" ADAS_DOMAIN
 SG_ RouteInfoChar_28 : 384|8@1+ (1,0) [0|255] "ascii" ADAS_DOMAIN
 SG_ RouteInfoChar_29 : 392|8@1+ (1,0) [0|255] "ascii" ADAS_DOMAIN
 SG_ RouteInfoChar_30 : 400|8@1+ (1,0) [0|255] "ascii" ADAS_DOMAIN
 SG_ RouteInfoChar_31 : 408|8@1+ (1,0) [0|255] "ascii" ADAS_DOMAIN
 SG_ RouteInfoChar_32 : 416|8@1+ (1,0) [0|255] "ascii" ADAS_DOMAIN
 SG_ RouteInfoChar_33 : 424|8@1+ (1,0) [0|255] "ascii" ADAS_DOMAIN
 SG_ RouteInfoChar_34 : 432|8@1+ (1,0) [0|255] "ascii" ADAS_DOMAIN
 SG_ RouteInfoChar_35 : 440|8@1+ (1,0) [0|255] "ascii" ADAS_DOMAIN
 SG_ RouteInfoChar_36 : 448|8@1+ (1,0) [0|255] "ascii" ADAS_DOMAIN
 SG_ RouteInfoChar_37 : 456|8@1+ (1,0) [0|255] "ascii" ADAS_DOMAIN
 SG_ RouteInfoChar_38 : 464|8@1+ (1,0) [0|255] "ascii" ADAS_DOMAIN
 SG_ RouteInfoChar_39 : 472|8@1+ (1,0) [0|255] "ascii" ADAS_DOMAIN
 SG_ RouteInfoChar_40 : 480|8@1+ (1,0) [0|255] "ascii" ADAS_DOMAIN
 SG_ RouteInfoChar_41 : 488|8@1+ (1,0) [0|255] "ascii" ADAS_DOMAIN
 SG_ RouteInfoChar_42 : 496|8@1+ (1,0) [0|255] "ascii" ADAS_DOMAIN
 SG_ RouteInfoChar_43 : 504|8@1+ (1,0) [0|255] "ascii" ADAS_DOMAIN

CM_ BO_ 454 "Cycle=10ms; Channel=CAN6; CAN-FD; NominalBitrate=500kbit/s; DataBitrate=5000kbit/s;  Data request; receiver answers with response frame; PayloadRouteInfo='IMU_YAW_RATE_SENSOR -> ADAS_DOMAIN' in bytes 20-63;";

BO_ 1602 RESP_066_ADAS_DOMAIN_TO_IMU_YAW_RATE_SENSOR: 16 ADAS_DOMAIN
 SG_ CRC8 : 0|8@1+ (1,0) [0|255] "" IMU_YAW_RATE_SENSOR
 SG_ ResponseCounter : 8|4@1+ (1,0) [0|15] "" IMU_YAW_RATE_SENSOR
 SG_ AckState : 12|4@1+ (1,0) [0|15] "" IMU_YAW_RATE_SENSOR
 SG_ ReceivedFrameId : 16|11@1+ (1,0) [0|2047] "" IMU_YAW_RATE_SENSOR
 SG_ ReceivedCounter : 27|4@1+ (1,0) [0|15] "" IMU_YAW_RATE_SENSOR
 SG_ ChecksumOk : 31|1@1+ (1,0) [0|1] "" IMU_YAW_RATE_SENSOR
 SG_ PayloadLength : 32|8@1+ (1,0) [0|64] "byte" IMU_YAW_RATE_SENSOR
 SG_ ErrorCode : 40|8@1+ (1,0) [0|255] "" IMU_YAW_RATE_SENSOR
 SG_ ProcessingTimeUs : 48|16@1+ (1,0) [0|65535] "us" IMU_YAW_RATE_SENSOR
 SG_ ResponseSequence : 64|16@1+ (1,0) [0|65535] "" IMU_YAW_RATE_SENSOR
 SG_ ReceivedCrc : 80|8@1+ (1,0) [0|255] "" IMU_YAW_RATE_SENSOR
 SG_ CalculatedCrc : 88|8@1+ (1,0) [0|255] "" IMU_YAW_RATE_SENSOR

CM_ BO_ 1602 "Cycle=10ms; Channel=CAN6; CAN-FD; NominalBitrate=500kbit/s; DataBitrate=5000kbit/s;  ResponseFor=0x1C6; ACK/NACK with CRC, DLC and counter check;";

BO_ 455 DATA_067_WHEEL_SPEED_FL: 64 WHEEL_SPEED_FRONT_LEFT
 SG_ CRC8 : 0|8@1+ (1,0) [0|255] "" BRAKE_CONTROLLER
 SG_ AliveCounter : 8|4@1+ (1,0) [0|15] "" BRAKE_CONTROLLER
 SG_ MuxState : 12|4@1+ (1,0) [0|15] "" BRAKE_CONTROLLER
 SG_ SIG_1C7_00 : 16|12@1+ (0.1,0.0) [0|4095] "C" BRAKE_CONTROLLER
 SG_ SIG_1C7_01 : 28|12@1+ (0.1,0.0) [0|4095] "C" BRAKE_CONTROLLER
 SG_ SIG_1C7_02 : 40|12@1+ (0.1,0.0) [0|4095] "A" BRAKE_CONTROLLER
 SG_ SIG_1C7_03 : 52|12@1+ (0.1,0.0) [0|4095] "deg" BRAKE_CONTROLLER
 SG_ SIG_1C7_04 : 64|12@1+ (0.1,0.0) [0|4095] "km/h" BRAKE_CONTROLLER
 SG_ SIG_1C7_05 : 76|12@1+ (0.1,0.0) [0|4095] "V" BRAKE_CONTROLLER
 SG_ SIG_1C7_06 : 88|12@1+ (0.1,0.0) [0|4095] "C" BRAKE_CONTROLLER
 SG_ SIG_1C7_07 : 100|12@1+ (0.1,0.0) [0|4095] "rpm" BRAKE_CONTROLLER
 SG_ SIG_1C7_08 : 112|12@1+ (0.1,0.0) [0|4095] "rpm" BRAKE_CONTROLLER
 SG_ SIG_1C7_09 : 124|12@1+ (0.1,0.0) [0|4095] "%" BRAKE_CONTROLLER
 SG_ SIG_1C7_10 : 136|12@1+ (0.1,0.0) [0|4095] "C" BRAKE_CONTROLLER
 SG_ SIG_1C7_11 : 148|12@1+ (0.1,0.0) [0|4095] "rpm" BRAKE_CONTROLLER
 SG_ RouteInfoChar_00 : 160|8@1+ (1,0) [0|255] "ascii" BRAKE_CONTROLLER
 SG_ RouteInfoChar_01 : 168|8@1+ (1,0) [0|255] "ascii" BRAKE_CONTROLLER
 SG_ RouteInfoChar_02 : 176|8@1+ (1,0) [0|255] "ascii" BRAKE_CONTROLLER
 SG_ RouteInfoChar_03 : 184|8@1+ (1,0) [0|255] "ascii" BRAKE_CONTROLLER
 SG_ RouteInfoChar_04 : 192|8@1+ (1,0) [0|255] "ascii" BRAKE_CONTROLLER
 SG_ RouteInfoChar_05 : 200|8@1+ (1,0) [0|255] "ascii" BRAKE_CONTROLLER
 SG_ RouteInfoChar_06 : 208|8@1+ (1,0) [0|255] "ascii" BRAKE_CONTROLLER
 SG_ RouteInfoChar_07 : 216|8@1+ (1,0) [0|255] "ascii" BRAKE_CONTROLLER
 SG_ RouteInfoChar_08 : 224|8@1+ (1,0) [0|255] "ascii" BRAKE_CONTROLLER
 SG_ RouteInfoChar_09 : 232|8@1+ (1,0) [0|255] "ascii" BRAKE_CONTROLLER
 SG_ RouteInfoChar_10 : 240|8@1+ (1,0) [0|255] "ascii" BRAKE_CONTROLLER
 SG_ RouteInfoChar_11 : 248|8@1+ (1,0) [0|255] "ascii" BRAKE_CONTROLLER
 SG_ RouteInfoChar_12 : 256|8@1+ (1,0) [0|255] "ascii" BRAKE_CONTROLLER
 SG_ RouteInfoChar_13 : 264|8@1+ (1,0) [0|255] "ascii" BRAKE_CONTROLLER
 SG_ RouteInfoChar_14 : 272|8@1+ (1,0) [0|255] "ascii" BRAKE_CONTROLLER
 SG_ RouteInfoChar_15 : 280|8@1+ (1,0) [0|255] "ascii" BRAKE_CONTROLLER
 SG_ RouteInfoChar_16 : 288|8@1+ (1,0) [0|255] "ascii" BRAKE_CONTROLLER
 SG_ RouteInfoChar_17 : 296|8@1+ (1,0) [0|255] "ascii" BRAKE_CONTROLLER
 SG_ RouteInfoChar_18 : 304|8@1+ (1,0) [0|255] "ascii" BRAKE_CONTROLLER
 SG_ RouteInfoChar_19 : 312|8@1+ (1,0) [0|255] "ascii" BRAKE_CONTROLLER
 SG_ RouteInfoChar_20 : 320|8@1+ (1,0) [0|255] "ascii" BRAKE_CONTROLLER
 SG_ RouteInfoChar_21 : 328|8@1+ (1,0) [0|255] "ascii" BRAKE_CONTROLLER
 SG_ RouteInfoChar_22 : 336|8@1+ (1,0) [0|255] "ascii" BRAKE_CONTROLLER
 SG_ RouteInfoChar_23 : 344|8@1+ (1,0) [0|255] "ascii" BRAKE_CONTROLLER
 SG_ RouteInfoChar_24 : 352|8@1+ (1,0) [0|255] "ascii" BRAKE_CONTROLLER
 SG_ RouteInfoChar_25 : 360|8@1+ (1,0) [0|255] "ascii" BRAKE_CONTROLLER
 SG_ RouteInfoChar_26 : 368|8@1+ (1,0) [0|255] "ascii" BRAKE_CONTROLLER
 SG_ RouteInfoChar_27 : 376|8@1+ (1,0) [0|255] "ascii" BRAKE_CONTROLLER
 SG_ RouteInfoChar_28 : 384|8@1+ (1,0) [0|255] "ascii" BRAKE_CONTROLLER
 SG_ RouteInfoChar_29 : 392|8@1+ (1,0) [0|255] "ascii" BRAKE_CONTROLLER
 SG_ RouteInfoChar_30 : 400|8@1+ (1,0) [0|255] "ascii" BRAKE_CONTROLLER
 SG_ RouteInfoChar_31 : 408|8@1+ (1,0) [0|255] "ascii" BRAKE_CONTROLLER
 SG_ RouteInfoChar_32 : 416|8@1+ (1,0) [0|255] "ascii" BRAKE_CONTROLLER
 SG_ RouteInfoChar_33 : 424|8@1+ (1,0) [0|255] "ascii" BRAKE_CONTROLLER
 SG_ RouteInfoChar_34 : 432|8@1+ (1,0) [0|255] "ascii" BRAKE_CONTROLLER
 SG_ RouteInfoChar_35 : 440|8@1+ (1,0) [0|255] "ascii" BRAKE_CONTROLLER
 SG_ RouteInfoChar_36 : 448|8@1+ (1,0) [0|255] "ascii" BRAKE_CONTROLLER
 SG_ RouteInfoChar_37 : 456|8@1+ (1,0) [0|255] "ascii" BRAKE_CONTROLLER
 SG_ RouteInfoChar_38 : 464|8@1+ (1,0) [0|255] "ascii" BRAKE_CONTROLLER
 SG_ RouteInfoChar_39 : 472|8@1+ (1,0) [0|255] "ascii" BRAKE_CONTROLLER
 SG_ RouteInfoChar_40 : 480|8@1+ (1,0) [0|255] "ascii" BRAKE_CONTROLLER
 SG_ RouteInfoChar_41 : 488|8@1+ (1,0) [0|255] "ascii" BRAKE_CONTROLLER
 SG_ RouteInfoChar_42 : 496|8@1+ (1,0) [0|255] "ascii" BRAKE_CONTROLLER
 SG_ RouteInfoChar_43 : 504|8@1+ (1,0) [0|255] "ascii" BRAKE_CONTROLLER

CM_ BO_ 455 "Cycle=10ms; Channel=CAN7; CAN-FD; NominalBitrate=500kbit/s; DataBitrate=5000kbit/s;  Data request; receiver answers with response frame; PayloadRouteInfo='WHEEL_SPEED_FRONT_LEFT -> BRAKE_CONTROLLER' in bytes 20-63;";

BO_ 1603 RESP_067_BRAKE_CONTROLLER_TO_WHEEL_SPEED_FRONT_LEFT: 16 BRAKE_CONTROLLER
 SG_ CRC8 : 0|8@1+ (1,0) [0|255] "" WHEEL_SPEED_FRONT_LEFT
 SG_ ResponseCounter : 8|4@1+ (1,0) [0|15] "" WHEEL_SPEED_FRONT_LEFT
 SG_ AckState : 12|4@1+ (1,0) [0|15] "" WHEEL_SPEED_FRONT_LEFT
 SG_ ReceivedFrameId : 16|11@1+ (1,0) [0|2047] "" WHEEL_SPEED_FRONT_LEFT
 SG_ ReceivedCounter : 27|4@1+ (1,0) [0|15] "" WHEEL_SPEED_FRONT_LEFT
 SG_ ChecksumOk : 31|1@1+ (1,0) [0|1] "" WHEEL_SPEED_FRONT_LEFT
 SG_ PayloadLength : 32|8@1+ (1,0) [0|64] "byte" WHEEL_SPEED_FRONT_LEFT
 SG_ ErrorCode : 40|8@1+ (1,0) [0|255] "" WHEEL_SPEED_FRONT_LEFT
 SG_ ProcessingTimeUs : 48|16@1+ (1,0) [0|65535] "us" WHEEL_SPEED_FRONT_LEFT
 SG_ ResponseSequence : 64|16@1+ (1,0) [0|65535] "" WHEEL_SPEED_FRONT_LEFT
 SG_ ReceivedCrc : 80|8@1+ (1,0) [0|255] "" WHEEL_SPEED_FRONT_LEFT
 SG_ CalculatedCrc : 88|8@1+ (1,0) [0|255] "" WHEEL_SPEED_FRONT_LEFT

CM_ BO_ 1603 "Cycle=10ms; Channel=CAN7; CAN-FD; NominalBitrate=500kbit/s; DataBitrate=5000kbit/s;  ResponseFor=0x1C7; ACK/NACK with CRC, DLC and counter check;";
