VERSION "Realistic CAN Trace Generator"

NS_ :

BS_:

BU_: ECU_01 ECU_02 ECU_03 ECU_04 ECU_05 ECU_06 ECU_07 ECU_08

BO_ 256 MSG_000_ECU_01_TO_ECU_03: 64 ECU_01
 SG_ CRC8 : 0|8@1+ (1,0) [0|255] "" ECU_03,ECU_02
 SG_ AliveCounter : 8|4@1+ (1,0) [0|15] "" ECU_03,ECU_02
 SG_ MuxState : 12|4@1+ (1,0) [0|15] "" ECU_03,ECU_02
 SG_ SIG_000_00 : 16|12@1+ (0.1,0.0) [0|4095] "V" ECU_03,ECU_02
 SG_ SIG_000_01 : 28|12@1+ (0.1,0.0) [0|4095] "Nm" ECU_03,ECU_02
 SG_ SIG_000_02 : 40|12@1+ (0.1,0.0) [0|4095] "Nm" ECU_03,ECU_02
 SG_ SIG_000_03 : 52|12@1+ (0.1,0.0) [0|4095] "deg" ECU_03,ECU_02
 SG_ SIG_000_04 : 64|12@1+ (0.1,0.0) [0|4095] "rpm" ECU_03,ECU_02
 SG_ SIG_000_05 : 76|12@1+ (0.1,0.0) [0|4095] "rpm" ECU_03,ECU_02
 SG_ SIG_000_06 : 88|12@1+ (0.1,0.0) [0|4095] "%" ECU_03,ECU_02
 SG_ SIG_000_07 : 100|12@1+ (0.1,0.0) [0|4095] "km/h" ECU_03,ECU_02
 SG_ SIG_000_08 : 112|12@1+ (0.1,0.0) [0|4095] "km/h" ECU_03,ECU_02
 SG_ SIG_000_09 : 124|12@1+ (0.1,0.0) [0|4095] "rpm" ECU_03,ECU_02
 SG_ SIG_000_10 : 136|12@1+ (0.1,0.0) [0|4095] "Nm" ECU_03,ECU_02
 SG_ SIG_000_11 : 148|12@1+ (0.1,0.0) [0|4095] "Nm" ECU_03,ECU_02
 SG_ SIG_000_12 : 160|12@1+ (0.1,0.0) [0|4095] "km/h" ECU_03,ECU_02
 SG_ SIG_000_13 : 172|12@1+ (0.1,0.0) [0|4095] "Nm" ECU_03,ECU_02
 SG_ SIG_000_14 : 184|12@1+ (0.1,0.0) [0|4095] "%" ECU_03,ECU_02
 SG_ SIG_000_15 : 196|12@1+ (0.1,0.0) [0|4095] "Nm" ECU_03,ECU_02
 SG_ SIG_000_16 : 208|12@1+ (0.1,0.0) [0|4095] "C" ECU_03,ECU_02
 SG_ SIG_000_17 : 220|12@1+ (0.1,0.0) [0|4095] "V" ECU_03,ECU_02
 SG_ SIG_000_18 : 232|12@1+ (0.1,0.0) [0|4095] "km/h" ECU_03,ECU_02
 SG_ SIG_000_19 : 244|12@1+ (0.1,0.0) [0|4095] "deg" ECU_03,ECU_02
 SG_ SIG_000_20 : 256|12@1+ (0.1,0.0) [0|4095] "%" ECU_03,ECU_02
 SG_ SIG_000_21 : 268|12@1+ (0.1,0.0) [0|4095] "A" ECU_03,ECU_02
 SG_ SIG_000_22 : 280|12@1+ (0.1,0.0) [0|4095] "V" ECU_03,ECU_02
 SG_ SIG_000_23 : 292|12@1+ (0.1,0.0) [0|4095] "deg" ECU_03,ECU_02
 SG_ SIG_000_24 : 304|12@1+ (0.1,0.0) [0|4095] "Nm" ECU_03,ECU_02
CM_ BO_ 256 "Cycle=10ms; Channel=CAN0; CAN-FD; Gateway to CAN1";

BO_ 257 MSG_001_ECU_02_TO_ECU_07: 64 ECU_02
 SG_ CRC8 : 0|8@1+ (1,0) [0|255] "" ECU_07,ECU_03
 SG_ AliveCounter : 8|4@1+ (1,0) [0|15] "" ECU_07,ECU_03
 SG_ MuxState : 12|4@1+ (1,0) [0|15] "" ECU_07,ECU_03
 SG_ SIG_001_00 : 16|12@1+ (0.1,0.0) [0|4095] "rpm" ECU_07,ECU_03
 SG_ SIG_001_01 : 28|12@1+ (0.1,0.0) [0|4095] "%" ECU_07,ECU_03
 SG_ SIG_001_02 : 40|12@1+ (0.1,0.0) [0|4095] "rpm" ECU_07,ECU_03
 SG_ SIG_001_03 : 52|12@1+ (0.1,0.0) [0|4095] "A" ECU_07,ECU_03
 SG_ SIG_001_04 : 64|12@1+ (0.1,0.0) [0|4095] "A" ECU_07,ECU_03
 SG_ SIG_001_05 : 76|12@1+ (0.1,0.0) [0|4095] "V" ECU_07,ECU_03
 SG_ SIG_001_06 : 88|12@1+ (0.1,0.0) [0|4095] "km/h" ECU_07,ECU_03
 SG_ SIG_001_07 : 100|12@1+ (0.1,0.0) [0|4095] "C" ECU_07,ECU_03
 SG_ SIG_001_08 : 112|12@1+ (0.1,0.0) [0|4095] "rpm" ECU_07,ECU_03
 SG_ SIG_001_09 : 124|12@1+ (0.1,0.0) [0|4095] "%" ECU_07,ECU_03
 SG_ SIG_001_10 : 136|12@1+ (0.1,0.0) [0|4095] "rpm" ECU_07,ECU_03
 SG_ SIG_001_11 : 148|12@1+ (0.1,0.0) [0|4095] "V" ECU_07,ECU_03
 SG_ SIG_001_12 : 160|12@1+ (0.1,0.0) [0|4095] "A" ECU_07,ECU_03
 SG_ SIG_001_13 : 172|12@1+ (0.1,0.0) [0|4095] "Nm" ECU_07,ECU_03
 SG_ SIG_001_14 : 184|12@1+ (0.1,0.0) [0|4095] "rpm" ECU_07,ECU_03
 SG_ SIG_001_15 : 196|12@1+ (0.1,0.0) [0|4095] "km/h" ECU_07,ECU_03
 SG_ SIG_001_16 : 208|12@1+ (0.1,0.0) [0|4095] "Nm" ECU_07,ECU_03
 SG_ SIG_001_17 : 220|12@1+ (0.1,0.0) [0|4095] "V" ECU_07,ECU_03
 SG_ SIG_001_18 : 232|12@1+ (0.1,0.0) [0|4095] "rpm" ECU_07,ECU_03
 SG_ SIG_001_19 : 244|12@1+ (0.1,0.0) [0|4095] "Nm" ECU_07,ECU_03
 SG_ SIG_001_20 : 256|12@1+ (0.1,0.0) [0|4095] "rpm" ECU_07,ECU_03
 SG_ SIG_001_21 : 268|12@1+ (0.1,0.0) [0|4095] "%" ECU_07,ECU_03
 SG_ SIG_001_22 : 280|12@1+ (0.1,0.0) [0|4095] "V" ECU_07,ECU_03
 SG_ SIG_001_23 : 292|12@1+ (0.1,0.0) [0|4095] "C" ECU_07,ECU_03
 SG_ SIG_001_24 : 304|12@1+ (0.1,0.0) [0|4095] "A" ECU_07,ECU_03
CM_ BO_ 257 "Cycle=20ms; Channel=CAN0; CAN-FD;";

BO_ 258 MSG_002_ECU_03_TO_ECU_04: 64 ECU_03
 SG_ CRC8 : 0|8@1+ (1,0) [0|255] "" ECU_04,ECU_07
 SG_ AliveCounter : 8|4@1+ (1,0) [0|15] "" ECU_04,ECU_07
 SG_ MuxState : 12|4@1+ (1,0) [0|15] "" ECU_04,ECU_07
 SG_ SIG_002_00 : 16|12@1+ (0.1,0.0) [0|4095] "A" ECU_04,ECU_07
 SG_ SIG_002_01 : 28|12@1+ (0.1,0.0) [0|4095] "Nm" ECU_04,ECU_07
 SG_ SIG_002_02 : 40|12@1+ (0.1,0.0) [0|4095] "V" ECU_04,ECU_07
 SG_ SIG_002_03 : 52|12@1+ (0.1,0.0) [0|4095] "rpm" ECU_04,ECU_07
 SG_ SIG_002_04 : 64|12@1+ (0.1,0.0) [0|4095] "deg" ECU_04,ECU_07
 SG_ SIG_002_05 : 76|12@1+ (0.1,0.0) [0|4095] "Nm" ECU_04,ECU_07
 SG_ SIG_002_06 : 88|12@1+ (0.1,0.0) [0|4095] "deg" ECU_04,ECU_07
 SG_ SIG_002_07 : 100|12@1+ (0.1,0.0) [0|4095] "C" ECU_04,ECU_07
 SG_ SIG_002_08 : 112|12@1+ (0.1,0.0) [0|4095] "%" ECU_04,ECU_07
 SG_ SIG_002_09 : 124|12@1+ (0.1,0.0) [0|4095] "V" ECU_04,ECU_07
 SG_ SIG_002_10 : 136|12@1+ (0.1,0.0) [0|4095] "Nm" ECU_04,ECU_07
 SG_ SIG_002_11 : 148|12@1+ (0.1,0.0) [0|4095] "A" ECU_04,ECU_07
 SG_ SIG_002_12 : 160|12@1+ (0.1,0.0) [0|4095] "km/h" ECU_04,ECU_07
 SG_ SIG_002_13 : 172|12@1+ (0.1,0.0) [0|4095] "Nm" ECU_04,ECU_07
 SG_ SIG_002_14 : 184|12@1+ (0.1,0.0) [0|4095] "km/h" ECU_04,ECU_07
 SG_ SIG_002_15 : 196|12@1+ (0.1,0.0) [0|4095] "A" ECU_04,ECU_07
 SG_ SIG_002_16 : 208|12@1+ (0.1,0.0) [0|4095] "%" ECU_04,ECU_07
 SG_ SIG_002_17 : 220|12@1+ (0.1,0.0) [0|4095] "V" ECU_04,ECU_07
 SG_ SIG_002_18 : 232|12@1+ (0.1,0.0) [0|4095] "rpm" ECU_04,ECU_07
 SG_ SIG_002_19 : 244|12@1+ (0.1,0.0) [0|4095] "Nm" ECU_04,ECU_07
 SG_ SIG_002_20 : 256|12@1+ (0.1,0.0) [0|4095] "A" ECU_04,ECU_07
 SG_ SIG_002_21 : 268|12@1+ (0.1,0.0) [0|4095] "Nm" ECU_04,ECU_07
 SG_ SIG_002_22 : 280|12@1+ (0.1,0.0) [0|4095] "C" ECU_04,ECU_07
 SG_ SIG_002_23 : 292|12@1+ (0.1,0.0) [0|4095] "%" ECU_04,ECU_07
 SG_ SIG_002_24 : 304|12@1+ (0.1,0.0) [0|4095] "C" ECU_04,ECU_07
CM_ BO_ 258 "Cycle=50ms; Channel=CAN1; CAN-FD;";

BO_ 259 MSG_003_ECU_04_TO_ECU_03: 64 ECU_04
 SG_ CRC8 : 0|8@1+ (1,0) [0|255] "" ECU_03,ECU_06
 SG_ AliveCounter : 8|4@1+ (1,0) [0|15] "" ECU_03,ECU_06
 SG_ MuxState : 12|4@1+ (1,0) [0|15] "" ECU_03,ECU_06
 SG_ SIG_003_00 : 16|12@1+ (0.1,0.0) [0|4095] "deg" ECU_03,ECU_06
 SG_ SIG_003_01 : 28|12@1+ (0.1,0.0) [0|4095] "Nm" ECU_03,ECU_06
 SG_ SIG_003_02 : 40|12@1+ (0.1,0.0) [0|4095] "V" ECU_03,ECU_06
 SG_ SIG_003_03 : 52|12@1+ (0.1,0.0) [0|4095] "%" ECU_03,ECU_06
 SG_ SIG_003_04 : 64|12@1+ (0.1,0.0) [0|4095] "%" ECU_03,ECU_06
 SG_ SIG_003_05 : 76|12@1+ (0.1,0.0) [0|4095] "A" ECU_03,ECU_06
 SG_ SIG_003_06 : 88|12@1+ (0.1,0.0) [0|4095] "Nm" ECU_03,ECU_06
 SG_ SIG_003_07 : 100|12@1+ (0.1,0.0) [0|4095] "deg" ECU_03,ECU_06
 SG_ SIG_003_08 : 112|12@1+ (0.1,0.0) [0|4095] "C" ECU_03,ECU_06
 SG_ SIG_003_09 : 124|12@1+ (0.1,0.0) [0|4095] "rpm" ECU_03,ECU_06
 SG_ SIG_003_10 : 136|12@1+ (0.1,0.0) [0|4095] "km/h" ECU_03,ECU_06
 SG_ SIG_003_11 : 148|12@1+ (0.1,0.0) [0|4095] "rpm" ECU_03,ECU_06
 SG_ SIG_003_12 : 160|12@1+ (0.1,0.0) [0|4095] "deg" ECU_03,ECU_06
 SG_ SIG_003_13 : 172|12@1+ (0.1,0.0) [0|4095] "deg" ECU_03,ECU_06
 SG_ SIG_003_14 : 184|12@1+ (0.1,0.0) [0|4095] "%" ECU_03,ECU_06
 SG_ SIG_003_15 : 196|12@1+ (0.1,0.0) [0|4095] "rpm" ECU_03,ECU_06
 SG_ SIG_003_16 : 208|12@1+ (0.1,0.0) [0|4095] "%" ECU_03,ECU_06
 SG_ SIG_003_17 : 220|12@1+ (0.1,0.0) [0|4095] "%" ECU_03,ECU_06
 SG_ SIG_003_18 : 232|12@1+ (0.1,0.0) [0|4095] "C" ECU_03,ECU_06
 SG_ SIG_003_19 : 244|12@1+ (0.1,0.0) [0|4095] "V" ECU_03,ECU_06
 SG_ SIG_003_20 : 256|12@1+ (0.1,0.0) [0|4095] "km/h" ECU_03,ECU_06
 SG_ SIG_003_21 : 268|12@1+ (0.1,0.0) [0|4095] "rpm" ECU_03,ECU_06
 SG_ SIG_003_22 : 280|12@1+ (0.1,0.0) [0|4095] "V" ECU_03,ECU_06
 SG_ SIG_003_23 : 292|12@1+ (0.1,0.0) [0|4095] "A" ECU_03,ECU_06
 SG_ SIG_003_24 : 304|12@1+ (0.1,0.0) [0|4095] "rpm" ECU_03,ECU_06
CM_ BO_ 259 "Cycle=100ms; Channel=CAN1; CAN-FD;";

BO_ 260 MSG_004_ECU_05_TO_ECU_06: 64 ECU_05
 SG_ CRC8 : 0|8@1+ (1,0) [0|255] "" ECU_06,ECU_08
 SG_ AliveCounter : 8|4@1+ (1,0) [0|15] "" ECU_06,ECU_08
 SG_ MuxState : 12|4@1+ (1,0) [0|15] "" ECU_06,ECU_08
 SG_ SIG_004_00 : 16|12@1+ (0.1,0.0) [0|4095] "deg" ECU_06,ECU_08
 SG_ SIG_004_01 : 28|12@1+ (0.1,0.0) [0|4095] "C" ECU_06,ECU_08
 SG_ SIG_004_02 : 40|12@1+ (0.1,0.0) [0|4095] "km/h" ECU_06,ECU_08
 SG_ SIG_004_03 : 52|12@1+ (0.1,0.0) [0|4095] "V" ECU_06,ECU_08
 SG_ SIG_004_04 : 64|12@1+ (0.1,0.0) [0|4095] "deg" ECU_06,ECU_08
 SG_ SIG_004_05 : 76|12@1+ (0.1,0.0) [0|4095] "rpm" ECU_06,ECU_08
 SG_ SIG_004_06 : 88|12@1+ (0.1,0.0) [0|4095] "V" ECU_06,ECU_08
 SG_ SIG_004_07 : 100|12@1+ (0.1,0.0) [0|4095] "Nm" ECU_06,ECU_08
 SG_ SIG_004_08 : 112|12@1+ (0.1,0.0) [0|4095] "deg" ECU_06,ECU_08
 SG_ SIG_004_09 : 124|12@1+ (0.1,0.0) [0|4095] "A" ECU_06,ECU_08
 SG_ SIG_004_10 : 136|12@1+ (0.1,0.0) [0|4095] "deg" ECU_06,ECU_08
 SG_ SIG_004_11 : 148|12@1+ (0.1,0.0) [0|4095] "km/h" ECU_06,ECU_08
 SG_ SIG_004_12 : 160|12@1+ (0.1,0.0) [0|4095] "A" ECU_06,ECU_08
 SG_ SIG_004_13 : 172|12@1+ (0.1,0.0) [0|4095] "C" ECU_06,ECU_08
 SG_ SIG_004_14 : 184|12@1+ (0.1,0.0) [0|4095] "km/h" ECU_06,ECU_08
 SG_ SIG_004_15 : 196|12@1+ (0.1,0.0) [0|4095] "rpm" ECU_06,ECU_08
 SG_ SIG_004_16 : 208|12@1+ (0.1,0.0) [0|4095] "A" ECU_06,ECU_08
 SG_ SIG_004_17 : 220|12@1+ (0.1,0.0) [0|4095] "V" ECU_06,ECU_08
 SG_ SIG_004_18 : 232|12@1+ (0.1,0.0) [0|4095] "Nm" ECU_06,ECU_08
 SG_ SIG_004_19 : 244|12@1+ (0.1,0.0) [0|4095] "km/h" ECU_06,ECU_08
 SG_ SIG_004_20 : 256|12@1+ (0.1,0.0) [0|4095] "Nm" ECU_06,ECU_08
 SG_ SIG_004_21 : 268|12@1+ (0.1,0.0) [0|4095] "rpm" ECU_06,ECU_08
 SG_ SIG_004_22 : 280|12@1+ (0.1,0.0) [0|4095] "rpm" ECU_06,ECU_08
 SG_ SIG_004_23 : 292|12@1+ (0.1,0.0) [0|4095] "C" ECU_06,ECU_08
 SG_ SIG_004_24 : 304|12@1+ (0.1,0.0) [0|4095] "rpm" ECU_06,ECU_08
CM_ BO_ 260 "Cycle=10ms; Channel=CAN1; CAN-FD;";
