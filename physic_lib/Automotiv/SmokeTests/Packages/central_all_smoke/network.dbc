VERSION "Realistic CAN Trace Generator"

NS_ :

BS_:

BU_: ADAS_DOMAIN LIDAR_FRONT VEHICLE_MOTION_CONTROLLER

BO_ 801 DATA_000_LIDAR_TO_ADAS: 64 LIDAR_FRONT
 SG_ CRC8 : 0|8@1+ (1,0) [0|255] "" ADAS_DOMAIN
 SG_ AliveCounter : 8|4@1+ (1,0) [0|15] "" ADAS_DOMAIN
 SG_ MuxState : 12|4@1+ (1,0) [0|15] "" ADAS_DOMAIN
 SG_ SIG_321_00 : 16|12@1+ (0.1,0.0) [0|4095] "rpm" ADAS_DOMAIN
 SG_ SIG_321_01 : 28|12@1+ (0.1,0.0) [0|4095] "km/h" ADAS_DOMAIN
 SG_ SIG_321_02 : 40|12@1+ (0.1,0.0) [0|4095] "V" ADAS_DOMAIN
 SG_ SIG_321_03 : 52|12@1+ (0.1,0.0) [0|4095] "Nm" ADAS_DOMAIN
 SG_ SIG_321_04 : 64|12@1+ (0.1,0.0) [0|4095] "Nm" ADAS_DOMAIN
 SG_ SIG_321_05 : 76|12@1+ (0.1,0.0) [0|4095] "deg" ADAS_DOMAIN
 SG_ SIG_321_06 : 88|12@1+ (0.1,0.0) [0|4095] "rpm" ADAS_DOMAIN
 SG_ SIG_321_07 : 100|12@1+ (0.1,0.0) [0|4095] "m" ADAS_DOMAIN
 SG_ SIG_321_08 : 112|12@1+ (0.1,0.0) [0|4095] "rpm" ADAS_DOMAIN
 SG_ SIG_321_09 : 124|12@1+ (0.1,0.0) [0|4095] "obj" ADAS_DOMAIN
 SG_ SIG_321_10 : 136|12@1+ (0.1,0.0) [0|4095] "%" ADAS_DOMAIN
 SG_ SIG_321_11 : 148|12@1+ (0.1,0.0) [0|4095] "km/h" ADAS_DOMAIN
 SG_ RouteInfoChar_00 : 160|8@1+ (1,0) [0|255] "ascii" ADAS_DOMAIN
 SG_ RouteInfoChar_01 : 168|8@1+ (1,0) [0|255] "ascii" ADAS_DOMAIN
 SG_ RouteInfoChar_02 : 176|8@1+ (1,0) [0|255] "ascii" ADAS_DOMAIN
 SG_ RouteInfoChar_03 : 184|8@1+ (1,0) [0|255] "ascii" ADAS_DOMAIN
 SG_ RouteInfoChar_04 : 192|8@1+ (1,0) [0|255] "ascii" ADAS_DOMAIN
 SG_ RouteInfoChar_05 : 200|8@1+ (1,0) [0|255] "ascii" ADAS_DOMAIN
 SG_ RouteInfoChar_06 : 208|8@1+ (1,0) [0|255] "ascii" ADAS_DOMAIN
 SG_ RouteInfoChar_07 : 216|8@1+ (1,0) [0|255] "ascii" ADAS_DOMAIN
 SG_ RouteInfoChar_08 : 224|8@1+ (1,0) [0|255] "ascii" ADAS_DOMAIN
 SG_ RouteInfoChar_09 : 232|8@1+ (1,0) [0|255] "ascii" ADAS_DOMAIN
 SG_ RouteInfoChar_10 : 240|8@1+ (1,0) [0|255] "ascii" ADAS_DOMAIN
 SG_ RouteInfoChar_11 : 248|8@1+ (1,0) [0|255] "ascii" ADAS_DOMAIN
 SG_ RouteInfoChar_12 : 256|8@1+ (1,0) [0|255] "ascii" ADAS_DOMAIN
 SG_ RouteInfoChar_13 : 264|8@1+ (1,0) [0|255] "ascii" ADAS_DOMAIN
 SG_ RouteInfoChar_14 : 272|8@1+ (1,0) [0|255] "ascii" ADAS_DOMAIN
 SG_ RouteInfoChar_15 : 280|8@1+ (1,0) [0|255] "ascii" ADAS_DOMAIN
 SG_ RouteInfoChar_16 : 288|8@1+ (1,0) [0|255] "ascii" ADAS_DOMAIN
 SG_ RouteInfoChar_17 : 296|8@1+ (1,0) [0|255] "ascii" ADAS_DOMAIN
 SG_ RouteInfoChar_18 : 304|8@1+ (1,0) [0|255] "ascii" ADAS_DOMAIN
 SG_ RouteInfoChar_19 : 312|8@1+ (1,0) [0|255] "ascii" ADAS_DOMAIN
 SG_ RouteInfoChar_20 : 320|8@1+ (1,0) [0|255] "ascii" ADAS_DOMAIN
 SG_ RouteInfoChar_21 : 328|8@1+ (1,0) [0|255] "ascii" ADAS_DOMAIN
 SG_ RouteInfoChar_22 : 336|8@1+ (1,0) [0|255] "ascii" ADAS_DOMAIN
 SG_ RouteInfoChar_23 : 344|8@1+ (1,0) [0|255] "ascii" ADAS_DOMAIN
 SG_ RouteInfoChar_24 : 352|8@1+ (1,0) [0|255] "ascii" ADAS_DOMAIN
 SG_ RouteInfoChar_25 : 360|8@1+ (1,0) [0|255] "ascii" ADAS_DOMAIN
 SG_ RouteInfoChar_26 : 368|8@1+ (1,0) [0|255] "ascii" ADAS_DOMAIN
 SG_ RouteInfoChar_27 : 376|8@1+ (1,0) [0|255] "ascii" ADAS_DOMAIN
 SG_ RouteInfoChar_28 : 384|8@1+ (1,0) [0|255] "ascii" ADAS_DOMAIN
 SG_ RouteInfoChar_29 : 392|8@1+ (1,0) [0|255] "ascii" ADAS_DOMAIN
 SG_ RouteInfoChar_30 : 400|8@1+ (1,0) [0|255] "ascii" ADAS_DOMAIN
 SG_ RouteInfoChar_31 : 408|8@1+ (1,0) [0|255] "ascii" ADAS_DOMAIN
 SG_ RouteInfoChar_32 : 416|8@1+ (1,0) [0|255] "ascii" ADAS_DOMAIN
 SG_ RouteInfoChar_33 : 424|8@1+ (1,0) [0|255] "ascii" ADAS_DOMAIN
 SG_ RouteInfoChar_34 : 432|8@1+ (1,0) [0|255] "ascii" ADAS_DOMAIN
 SG_ RouteInfoChar_35 : 440|8@1+ (1,0) [0|255] "ascii" ADAS_DOMAIN
 SG_ RouteInfoChar_36 : 448|8@1+ (1,0) [0|255] "ascii" ADAS_DOMAIN
 SG_ RouteInfoChar_37 : 456|8@1+ (1,0) [0|255] "ascii" ADAS_DOMAIN
 SG_ RouteInfoChar_38 : 464|8@1+ (1,0) [0|255] "ascii" ADAS_DOMAIN
 SG_ RouteInfoChar_39 : 472|8@1+ (1,0) [0|255] "ascii" ADAS_DOMAIN
 SG_ RouteInfoChar_40 : 480|8@1+ (1,0) [0|255] "ascii" ADAS_DOMAIN
 SG_ RouteInfoChar_41 : 488|8@1+ (1,0) [0|255] "ascii" ADAS_DOMAIN
 SG_ RouteInfoChar_42 : 496|8@1+ (1,0) [0|255] "ascii" ADAS_DOMAIN
 SG_ RouteInfoChar_43 : 504|8@1+ (1,0) [0|255] "ascii" ADAS_DOMAIN
CM_ BO_ 801 "Cycle=20ms; Channel=CAN0; CAN-FD; NominalBitrate=500kbit/s; DataBitrate=500kbit/s;  Data request; receiver answers with response frame; PayloadRouteInfo='LIDAR_FRONT -> ADAS_DOMAIN' in bytes 20-63; Gateway to CAN1";

BO_ 1536 RESP_000_ADAS_DOMAIN_TO_LIDAR_FRONT: 16 ADAS_DOMAIN
 SG_ CRC8 : 0|8@1+ (1,0) [0|255] "" LIDAR_FRONT
 SG_ ResponseCounter : 8|4@1+ (1,0) [0|15] "" LIDAR_FRONT
 SG_ AckState : 12|4@1+ (1,0) [0|15] "" LIDAR_FRONT
 SG_ ReceivedFrameId : 16|11@1+ (1,0) [0|2047] "" LIDAR_FRONT
 SG_ ReceivedCounter : 27|4@1+ (1,0) [0|15] "" LIDAR_FRONT
 SG_ ChecksumOk : 31|1@1+ (1,0) [0|1] "" LIDAR_FRONT
 SG_ PayloadLength : 32|8@1+ (1,0) [0|64] "byte" LIDAR_FRONT
 SG_ ErrorCode : 40|8@1+ (1,0) [0|255] "" LIDAR_FRONT
 SG_ ProcessingTimeUs : 48|16@1+ (1,0) [0|65535] "us" LIDAR_FRONT
 SG_ ResponseSequence : 64|16@1+ (1,0) [0|65535] "" LIDAR_FRONT
 SG_ ReceivedCrc : 80|8@1+ (1,0) [0|255] "" LIDAR_FRONT
 SG_ CalculatedCrc : 88|8@1+ (1,0) [0|255] "" LIDAR_FRONT
CM_ BO_ 1536 "Cycle=20ms; Channel=CAN0; CAN-FD; NominalBitrate=500kbit/s; DataBitrate=500kbit/s;  ResponseFor=0x321; ACK/NACK with CRC, DLC and counter check;";

BO_ 802 DATA_001_ADAS_TO_VMC: 64 ADAS_DOMAIN
 SG_ CRC8 : 0|8@1+ (1,0) [0|255] "" VEHICLE_MOTION_CONTROLLER
 SG_ AliveCounter : 8|4@1+ (1,0) [0|15] "" VEHICLE_MOTION_CONTROLLER
 SG_ MuxState : 12|4@1+ (1,0) [0|15] "" VEHICLE_MOTION_CONTROLLER
 SG_ SIG_322_00 : 16|12@1+ (0.1,0.0) [0|4095] "km/h" VEHICLE_MOTION_CONTROLLER
 SG_ SIG_322_01 : 28|12@1+ (0.1,0.0) [0|4095] "rpm" VEHICLE_MOTION_CONTROLLER
 SG_ SIG_322_02 : 40|12@1+ (0.1,0.0) [0|4095] "Nm" VEHICLE_MOTION_CONTROLLER
 SG_ SIG_322_03 : 52|12@1+ (0.1,0.0) [0|4095] "Nm" VEHICLE_MOTION_CONTROLLER
 SG_ SIG_322_04 : 64|12@1+ (0.1,0.0) [0|4095] "m" VEHICLE_MOTION_CONTROLLER
 SG_ SIG_322_05 : 76|12@1+ (0.1,0.0) [0|4095] "obj" VEHICLE_MOTION_CONTROLLER
 SG_ SIG_322_06 : 88|12@1+ (0.1,0.0) [0|4095] "km/h" VEHICLE_MOTION_CONTROLLER
 SG_ SIG_322_07 : 100|12@1+ (0.1,0.0) [0|4095] "m" VEHICLE_MOTION_CONTROLLER
 SG_ SIG_322_08 : 112|12@1+ (0.1,0.0) [0|4095] "Nm" VEHICLE_MOTION_CONTROLLER
 SG_ SIG_322_09 : 124|12@1+ (0.1,0.0) [0|4095] "m" VEHICLE_MOTION_CONTROLLER
 SG_ SIG_322_10 : 136|12@1+ (0.1,0.0) [0|4095] "%" VEHICLE_MOTION_CONTROLLER
 SG_ SIG_322_11 : 148|12@1+ (0.1,0.0) [0|4095] "Nm" VEHICLE_MOTION_CONTROLLER
 SG_ RouteInfoChar_00 : 160|8@1+ (1,0) [0|255] "ascii" VEHICLE_MOTION_CONTROLLER
 SG_ RouteInfoChar_01 : 168|8@1+ (1,0) [0|255] "ascii" VEHICLE_MOTION_CONTROLLER
 SG_ RouteInfoChar_02 : 176|8@1+ (1,0) [0|255] "ascii" VEHICLE_MOTION_CONTROLLER
 SG_ RouteInfoChar_03 : 184|8@1+ (1,0) [0|255] "ascii" VEHICLE_MOTION_CONTROLLER
 SG_ RouteInfoChar_04 : 192|8@1+ (1,0) [0|255] "ascii" VEHICLE_MOTION_CONTROLLER
 SG_ RouteInfoChar_05 : 200|8@1+ (1,0) [0|255] "ascii" VEHICLE_MOTION_CONTROLLER
 SG_ RouteInfoChar_06 : 208|8@1+ (1,0) [0|255] "ascii" VEHICLE_MOTION_CONTROLLER
 SG_ RouteInfoChar_07 : 216|8@1+ (1,0) [0|255] "ascii" VEHICLE_MOTION_CONTROLLER
 SG_ RouteInfoChar_08 : 224|8@1+ (1,0) [0|255] "ascii" VEHICLE_MOTION_CONTROLLER
 SG_ RouteInfoChar_09 : 232|8@1+ (1,0) [0|255] "ascii" VEHICLE_MOTION_CONTROLLER
 SG_ RouteInfoChar_10 : 240|8@1+ (1,0) [0|255] "ascii" VEHICLE_MOTION_CONTROLLER
 SG_ RouteInfoChar_11 : 248|8@1+ (1,0) [0|255] "ascii" VEHICLE_MOTION_CONTROLLER
 SG_ RouteInfoChar_12 : 256|8@1+ (1,0) [0|255] "ascii" VEHICLE_MOTION_CONTROLLER
 SG_ RouteInfoChar_13 : 264|8@1+ (1,0) [0|255] "ascii" VEHICLE_MOTION_CONTROLLER
 SG_ RouteInfoChar_14 : 272|8@1+ (1,0) [0|255] "ascii" VEHICLE_MOTION_CONTROLLER
 SG_ RouteInfoChar_15 : 280|8@1+ (1,0) [0|255] "ascii" VEHICLE_MOTION_CONTROLLER
 SG_ RouteInfoChar_16 : 288|8@1+ (1,0) [0|255] "ascii" VEHICLE_MOTION_CONTROLLER
 SG_ RouteInfoChar_17 : 296|8@1+ (1,0) [0|255] "ascii" VEHICLE_MOTION_CONTROLLER
 SG_ RouteInfoChar_18 : 304|8@1+ (1,0) [0|255] "ascii" VEHICLE_MOTION_CONTROLLER
 SG_ RouteInfoChar_19 : 312|8@1+ (1,0) [0|255] "ascii" VEHICLE_MOTION_CONTROLLER
 SG_ RouteInfoChar_20 : 320|8@1+ (1,0) [0|255] "ascii" VEHICLE_MOTION_CONTROLLER
 SG_ RouteInfoChar_21 : 328|8@1+ (1,0) [0|255] "ascii" VEHICLE_MOTION_CONTROLLER
 SG_ RouteInfoChar_22 : 336|8@1+ (1,0) [0|255] "ascii" VEHICLE_MOTION_CONTROLLER
 SG_ RouteInfoChar_23 : 344|8@1+ (1,0) [0|255] "ascii" VEHICLE_MOTION_CONTROLLER
 SG_ RouteInfoChar_24 : 352|8@1+ (1,0) [0|255] "ascii" VEHICLE_MOTION_CONTROLLER
 SG_ RouteInfoChar_25 : 360|8@1+ (1,0) [0|255] "ascii" VEHICLE_MOTION_CONTROLLER
 SG_ RouteInfoChar_26 : 368|8@1+ (1,0) [0|255] "ascii" VEHICLE_MOTION_CONTROLLER
 SG_ RouteInfoChar_27 : 376|8@1+ (1,0) [0|255] "ascii" VEHICLE_MOTION_CONTROLLER
 SG_ RouteInfoChar_28 : 384|8@1+ (1,0) [0|255] "ascii" VEHICLE_MOTION_CONTROLLER
 SG_ RouteInfoChar_29 : 392|8@1+ (1,0) [0|255] "ascii" VEHICLE_MOTION_CONTROLLER
 SG_ RouteInfoChar_30 : 400|8@1+ (1,0) [0|255] "ascii" VEHICLE_MOTION_CONTROLLER
 SG_ RouteInfoChar_31 : 408|8@1+ (1,0) [0|255] "ascii" VEHICLE_MOTION_CONTROLLER
 SG_ RouteInfoChar_32 : 416|8@1+ (1,0) [0|255] "ascii" VEHICLE_MOTION_CONTROLLER
 SG_ RouteInfoChar_33 : 424|8@1+ (1,0) [0|255] "ascii" VEHICLE_MOTION_CONTROLLER
 SG_ RouteInfoChar_34 : 432|8@1+ (1,0) [0|255] "ascii" VEHICLE_MOTION_CONTROLLER
 SG_ RouteInfoChar_35 : 440|8@1+ (1,0) [0|255] "ascii" VEHICLE_MOTION_CONTROLLER
 SG_ RouteInfoChar_36 : 448|8@1+ (1,0) [0|255] "ascii" VEHICLE_MOTION_CONTROLLER
 SG_ RouteInfoChar_37 : 456|8@1+ (1,0) [0|255] "ascii" VEHICLE_MOTION_CONTROLLER
 SG_ RouteInfoChar_38 : 464|8@1+ (1,0) [0|255] "ascii" VEHICLE_MOTION_CONTROLLER
 SG_ RouteInfoChar_39 : 472|8@1+ (1,0) [0|255] "ascii" VEHICLE_MOTION_CONTROLLER
 SG_ RouteInfoChar_40 : 480|8@1+ (1,0) [0|255] "ascii" VEHICLE_MOTION_CONTROLLER
 SG_ RouteInfoChar_41 : 488|8@1+ (1,0) [0|255] "ascii" VEHICLE_MOTION_CONTROLLER
 SG_ RouteInfoChar_42 : 496|8@1+ (1,0) [0|255] "ascii" VEHICLE_MOTION_CONTROLLER
 SG_ RouteInfoChar_43 : 504|8@1+ (1,0) [0|255] "ascii" VEHICLE_MOTION_CONTROLLER
CM_ BO_ 802 "Cycle=20ms; Channel=CAN3; CAN-FD; NominalBitrate=500kbit/s; DataBitrate=500kbit/s;  Data request; receiver answers with response frame; PayloadRouteInfo='ADAS_DOMAIN -> VEHICLE_MOTION_CONTROLLER' in bytes 20-63;";

BO_ 1537 RESP_001_VEHICLE_MOTION_CONTROLLER_TO_ADAS_DOMAIN: 16 VEHICLE_MOTION_CONTROLLER
 SG_ CRC8 : 0|8@1+ (1,0) [0|255] "" ADAS_DOMAIN
 SG_ ResponseCounter : 8|4@1+ (1,0) [0|15] "" ADAS_DOMAIN
 SG_ AckState : 12|4@1+ (1,0) [0|15] "" ADAS_DOMAIN
 SG_ ReceivedFrameId : 16|11@1+ (1,0) [0|2047] "" ADAS_DOMAIN
 SG_ ReceivedCounter : 27|4@1+ (1,0) [0|15] "" ADAS_DOMAIN
 SG_ ChecksumOk : 31|1@1+ (1,0) [0|1] "" ADAS_DOMAIN
 SG_ PayloadLength : 32|8@1+ (1,0) [0|64] "byte" ADAS_DOMAIN
 SG_ ErrorCode : 40|8@1+ (1,0) [0|255] "" ADAS_DOMAIN
 SG_ ProcessingTimeUs : 48|16@1+ (1,0) [0|65535] "us" ADAS_DOMAIN
 SG_ ResponseSequence : 64|16@1+ (1,0) [0|65535] "" ADAS_DOMAIN
 SG_ ReceivedCrc : 80|8@1+ (1,0) [0|255] "" ADAS_DOMAIN
 SG_ CalculatedCrc : 88|8@1+ (1,0) [0|255] "" ADAS_DOMAIN
CM_ BO_ 1537 "Cycle=20ms; Channel=CAN3; CAN-FD; NominalBitrate=500kbit/s; DataBitrate=500kbit/s;  ResponseFor=0x322; ACK/NACK with CRC, DLC and counter check;";
