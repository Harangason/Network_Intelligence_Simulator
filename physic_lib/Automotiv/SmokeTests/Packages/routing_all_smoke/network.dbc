VERSION "Generated realistic CAN database"

NS_ :

BS_:

BU_: ADAS_DOMAIN BRAKE_CONTROLLER CAMERA_FRONT_WIDE IMU_YAW_RATE_SENSOR LIDAR_FRONT PARK_ASSIST RADAR_FRONT_LONG_RANGE RADAR_REAR_CROSS_TRAFFIC ULTRASONIC_LEFT_CLUSTER ULTRASONIC_RIGHT_CLUSTER VEHICLE_MOTION_CONTROLLER WHEEL_SPEED_FRONT_LEFT

BO_ 256 DATA_000_LIDAR_OBJECT_LIST: 64 LIDAR_FRONT
 SG_ CRC8 : 0|8@1+ (1,0) [0|255] "" ADAS_DOMAIN
 SG_ AliveCounter : 8|4@1+ (1,0) [0|15] "" ADAS_DOMAIN
 SG_ MuxState : 12|4@1+ (1,0) [0|15] "" ADAS_DOMAIN
 SG_ SIG_00 : 16|12@1+ (0.1,0.0) [0|4095] "km/h" ADAS_DOMAIN
 SG_ SIG_01 : 28|12@1+ (0.1,0.0) [0|4095] "rpm" ADAS_DOMAIN
 SG_ SIG_02 : 40|12@1+ (0.1,0.0) [0|4095] "deg" ADAS_DOMAIN
 SG_ SIG_03 : 52|12@1+ (0.1,0.0) [0|4095] "Nm" ADAS_DOMAIN
 SG_ SIG_04 : 64|12@1+ (0.1,0.0) [0|4095] "V" ADAS_DOMAIN
 SG_ SIG_05 : 76|12@1+ (0.1,0.0) [0|4095] "A" ADAS_DOMAIN
 SG_ SIG_06 : 88|12@1+ (0.1,0.0) [0|4095] "%" ADAS_DOMAIN
 SG_ SIG_07 : 100|12@1+ (0.1,0.0) [0|4095] "C" ADAS_DOMAIN
 SG_ SIG_08 : 112|12@1+ (0.1,0.0) [0|4095] "m" ADAS_DOMAIN
 SG_ SIG_09 : 124|12@1+ (0.1,0.0) [0|4095] "obj" ADAS_DOMAIN
 SG_ SIG_10 : 136|12@1+ (0.1,0.0) [0|4095] "km/h" ADAS_DOMAIN
 SG_ SIG_11 : 148|12@1+ (0.1,0.0) [0|4095] "rpm" ADAS_DOMAIN
 SG_ RouteInfoChar_00 : 160|8@1+ (1.0,0.0) [0|255] "ascii" ADAS_DOMAIN
 SG_ RouteInfoChar_01 : 168|8@1+ (1.0,0.0) [0|255] "ascii" ADAS_DOMAIN
 SG_ RouteInfoChar_02 : 176|8@1+ (1.0,0.0) [0|255] "ascii" ADAS_DOMAIN
 SG_ RouteInfoChar_03 : 184|8@1+ (1.0,0.0) [0|255] "ascii" ADAS_DOMAIN
 SG_ RouteInfoChar_04 : 192|8@1+ (1.0,0.0) [0|255] "ascii" ADAS_DOMAIN
 SG_ RouteInfoChar_05 : 200|8@1+ (1.0,0.0) [0|255] "ascii" ADAS_DOMAIN
 SG_ RouteInfoChar_06 : 208|8@1+ (1.0,0.0) [0|255] "ascii" ADAS_DOMAIN
 SG_ RouteInfoChar_07 : 216|8@1+ (1.0,0.0) [0|255] "ascii" ADAS_DOMAIN
 SG_ RouteInfoChar_08 : 224|8@1+ (1.0,0.0) [0|255] "ascii" ADAS_DOMAIN
 SG_ RouteInfoChar_09 : 232|8@1+ (1.0,0.0) [0|255] "ascii" ADAS_DOMAIN
 SG_ RouteInfoChar_10 : 240|8@1+ (1.0,0.0) [0|255] "ascii" ADAS_DOMAIN
 SG_ RouteInfoChar_11 : 248|8@1+ (1.0,0.0) [0|255] "ascii" ADAS_DOMAIN
 SG_ RouteInfoChar_12 : 256|8@1+ (1.0,0.0) [0|255] "ascii" ADAS_DOMAIN
 SG_ RouteInfoChar_13 : 264|8@1+ (1.0,0.0) [0|255] "ascii" ADAS_DOMAIN
 SG_ RouteInfoChar_14 : 272|8@1+ (1.0,0.0) [0|255] "ascii" ADAS_DOMAIN
 SG_ RouteInfoChar_15 : 280|8@1+ (1.0,0.0) [0|255] "ascii" ADAS_DOMAIN
 SG_ RouteInfoChar_16 : 288|8@1+ (1.0,0.0) [0|255] "ascii" ADAS_DOMAIN
 SG_ RouteInfoChar_17 : 296|8@1+ (1.0,0.0) [0|255] "ascii" ADAS_DOMAIN
 SG_ RouteInfoChar_18 : 304|8@1+ (1.0,0.0) [0|255] "ascii" ADAS_DOMAIN
 SG_ RouteInfoChar_19 : 312|8@1+ (1.0,0.0) [0|255] "ascii" ADAS_DOMAIN
 SG_ RouteInfoChar_20 : 320|8@1+ (1.0,0.0) [0|255] "ascii" ADAS_DOMAIN
 SG_ RouteInfoChar_21 : 328|8@1+ (1.0,0.0) [0|255] "ascii" ADAS_DOMAIN
 SG_ RouteInfoChar_22 : 336|8@1+ (1.0,0.0) [0|255] "ascii" ADAS_DOMAIN
 SG_ RouteInfoChar_23 : 344|8@1+ (1.0,0.0) [0|255] "ascii" ADAS_DOMAIN
 SG_ RouteInfoChar_24 : 352|8@1+ (1.0,0.0) [0|255] "ascii" ADAS_DOMAIN
 SG_ RouteInfoChar_25 : 360|8@1+ (1.0,0.0) [0|255] "ascii" ADAS_DOMAIN
 SG_ RouteInfoChar_26 : 368|8@1+ (1.0,0.0) [0|255] "ascii" ADAS_DOMAIN
 SG_ RouteInfoChar_27 : 376|8@1+ (1.0,0.0) [0|255] "ascii" ADAS_DOMAIN
 SG_ RouteInfoChar_28 : 384|8@1+ (1.0,0.0) [0|255] "ascii" ADAS_DOMAIN
 SG_ RouteInfoChar_29 : 392|8@1+ (1.0,0.0) [0|255] "ascii" ADAS_DOMAIN
 SG_ RouteInfoChar_30 : 400|8@1+ (1.0,0.0) [0|255] "ascii" ADAS_DOMAIN
 SG_ RouteInfoChar_31 : 408|8@1+ (1.0,0.0) [0|255] "ascii" ADAS_DOMAIN
 SG_ RouteInfoChar_32 : 416|8@1+ (1.0,0.0) [0|255] "ascii" ADAS_DOMAIN
 SG_ RouteInfoChar_33 : 424|8@1+ (1.0,0.0) [0|255] "ascii" ADAS_DOMAIN
 SG_ RouteInfoChar_34 : 432|8@1+ (1.0,0.0) [0|255] "ascii" ADAS_DOMAIN
 SG_ RouteInfoChar_35 : 440|8@1+ (1.0,0.0) [0|255] "ascii" ADAS_DOMAIN
 SG_ RouteInfoChar_36 : 448|8@1+ (1.0,0.0) [0|255] "ascii" ADAS_DOMAIN
 SG_ RouteInfoChar_37 : 456|8@1+ (1.0,0.0) [0|255] "ascii" ADAS_DOMAIN
 SG_ RouteInfoChar_38 : 464|8@1+ (1.0,0.0) [0|255] "ascii" ADAS_DOMAIN
 SG_ RouteInfoChar_39 : 472|8@1+ (1.0,0.0) [0|255] "ascii" ADAS_DOMAIN
 SG_ RouteInfoChar_40 : 480|8@1+ (1.0,0.0) [0|255] "ascii" ADAS_DOMAIN
 SG_ RouteInfoChar_41 : 488|8@1+ (1.0,0.0) [0|255] "ascii" ADAS_DOMAIN
 SG_ RouteInfoChar_42 : 496|8@1+ (1.0,0.0) [0|255] "ascii" ADAS_DOMAIN
 SG_ RouteInfoChar_43 : 504|8@1+ (1.0,0.0) [0|255] "ascii" ADAS_DOMAIN
CM_ BO_ 256 "Cycle=20ms; Channel=CAN0; CAN-FD; NominalBitrate=500kbit/s; DataBitrate=500kbit/s; PayloadRouteInfo='LIDAR_FRONT -> ADAS_DOMAIN' in bytes 20-63; Gateway to CAN1";

BO_ 1536 RESP_000_ADAS_DOMAIN_TO_LIDAR_FRONT: 16 ADAS_DOMAIN
 SG_ CRC8 : 0|8@1+ (1,0) [0|255] "" LIDAR_FRONT
 SG_ ResponseCounter : 8|4@1+ (1,0) [0|15] "" LIDAR_FRONT
 SG_ AckState : 12|4@1+ (1,0) [0|15] "" LIDAR_FRONT
 SG_ ReceivedFrameId : 16|11@1+ (1,0) [0|2047] "" LIDAR_FRONT
 SG_ ReceivedCounter : 27|4@1+ (1,0) [0|15] "" LIDAR_FRONT
 SG_ ChecksumOk : 31|1@1+ (0,0) [0|1] "" LIDAR_FRONT
 SG_ PayloadLength : 32|8@1+ (1,0) [0|64] "byte" LIDAR_FRONT
 SG_ ErrorCode : 40|8@1+ (1,0) [0|255] "" LIDAR_FRONT
 SG_ ProcessingTimeUs : 48|16@1+ (1,0) [0|65535] "us" LIDAR_FRONT
 SG_ ResponseSequence : 64|16@1+ (1,0) [0|65535] "" LIDAR_FRONT
 SG_ ReceivedCrc : 80|8@1+ (1,0) [0|255] "" LIDAR_FRONT
 SG_ CalculatedCrc : 88|8@1+ (1,0) [0|255] "" LIDAR_FRONT
CM_ BO_ 1536 "Cycle=20ms; Channel=CAN0; CAN-FD; NominalBitrate=500kbit/s; DataBitrate=500kbit/s; ResponseFor=0x100; ACK/NACK with CRC, DLC and counter check";

BO_ 257 DATA_001_CAMERA_LANE_MODEL: 64 CAMERA_FRONT_WIDE
 SG_ CRC8 : 0|8@1+ (1,0) [0|255] "" ADAS_DOMAIN
 SG_ AliveCounter : 8|4@1+ (1,0) [0|15] "" ADAS_DOMAIN
 SG_ MuxState : 12|4@1+ (1,0) [0|15] "" ADAS_DOMAIN
 SG_ SIG_00 : 16|12@1+ (0.1,0.0) [0|4095] "km/h" ADAS_DOMAIN
 SG_ SIG_01 : 28|12@1+ (0.1,0.0) [0|4095] "rpm" ADAS_DOMAIN
 SG_ SIG_02 : 40|12@1+ (0.1,0.0) [0|4095] "deg" ADAS_DOMAIN
 SG_ SIG_03 : 52|12@1+ (0.1,0.0) [0|4095] "Nm" ADAS_DOMAIN
 SG_ SIG_04 : 64|12@1+ (0.1,0.0) [0|4095] "V" ADAS_DOMAIN
 SG_ SIG_05 : 76|12@1+ (0.1,0.0) [0|4095] "A" ADAS_DOMAIN
 SG_ SIG_06 : 88|12@1+ (0.1,0.0) [0|4095] "%" ADAS_DOMAIN
 SG_ SIG_07 : 100|12@1+ (0.1,0.0) [0|4095] "C" ADAS_DOMAIN
 SG_ SIG_08 : 112|12@1+ (0.1,0.0) [0|4095] "m" ADAS_DOMAIN
 SG_ SIG_09 : 124|12@1+ (0.1,0.0) [0|4095] "obj" ADAS_DOMAIN
 SG_ SIG_10 : 136|12@1+ (0.1,0.0) [0|4095] "km/h" ADAS_DOMAIN
 SG_ SIG_11 : 148|12@1+ (0.1,0.0) [0|4095] "rpm" ADAS_DOMAIN
 SG_ RouteInfoChar_00 : 160|8@1+ (1.0,0.0) [0|255] "ascii" ADAS_DOMAIN
 SG_ RouteInfoChar_01 : 168|8@1+ (1.0,0.0) [0|255] "ascii" ADAS_DOMAIN
 SG_ RouteInfoChar_02 : 176|8@1+ (1.0,0.0) [0|255] "ascii" ADAS_DOMAIN
 SG_ RouteInfoChar_03 : 184|8@1+ (1.0,0.0) [0|255] "ascii" ADAS_DOMAIN
 SG_ RouteInfoChar_04 : 192|8@1+ (1.0,0.0) [0|255] "ascii" ADAS_DOMAIN
 SG_ RouteInfoChar_05 : 200|8@1+ (1.0,0.0) [0|255] "ascii" ADAS_DOMAIN
 SG_ RouteInfoChar_06 : 208|8@1+ (1.0,0.0) [0|255] "ascii" ADAS_DOMAIN
 SG_ RouteInfoChar_07 : 216|8@1+ (1.0,0.0) [0|255] "ascii" ADAS_DOMAIN
 SG_ RouteInfoChar_08 : 224|8@1+ (1.0,0.0) [0|255] "ascii" ADAS_DOMAIN
 SG_ RouteInfoChar_09 : 232|8@1+ (1.0,0.0) [0|255] "ascii" ADAS_DOMAIN
 SG_ RouteInfoChar_10 : 240|8@1+ (1.0,0.0) [0|255] "ascii" ADAS_DOMAIN
 SG_ RouteInfoChar_11 : 248|8@1+ (1.0,0.0) [0|255] "ascii" ADAS_DOMAIN
 SG_ RouteInfoChar_12 : 256|8@1+ (1.0,0.0) [0|255] "ascii" ADAS_DOMAIN
 SG_ RouteInfoChar_13 : 264|8@1+ (1.0,0.0) [0|255] "ascii" ADAS_DOMAIN
 SG_ RouteInfoChar_14 : 272|8@1+ (1.0,0.0) [0|255] "ascii" ADAS_DOMAIN
 SG_ RouteInfoChar_15 : 280|8@1+ (1.0,0.0) [0|255] "ascii" ADAS_DOMAIN
 SG_ RouteInfoChar_16 : 288|8@1+ (1.0,0.0) [0|255] "ascii" ADAS_DOMAIN
 SG_ RouteInfoChar_17 : 296|8@1+ (1.0,0.0) [0|255] "ascii" ADAS_DOMAIN
 SG_ RouteInfoChar_18 : 304|8@1+ (1.0,0.0) [0|255] "ascii" ADAS_DOMAIN
 SG_ RouteInfoChar_19 : 312|8@1+ (1.0,0.0) [0|255] "ascii" ADAS_DOMAIN
 SG_ RouteInfoChar_20 : 320|8@1+ (1.0,0.0) [0|255] "ascii" ADAS_DOMAIN
 SG_ RouteInfoChar_21 : 328|8@1+ (1.0,0.0) [0|255] "ascii" ADAS_DOMAIN
 SG_ RouteInfoChar_22 : 336|8@1+ (1.0,0.0) [0|255] "ascii" ADAS_DOMAIN
 SG_ RouteInfoChar_23 : 344|8@1+ (1.0,0.0) [0|255] "ascii" ADAS_DOMAIN
 SG_ RouteInfoChar_24 : 352|8@1+ (1.0,0.0) [0|255] "ascii" ADAS_DOMAIN
 SG_ RouteInfoChar_25 : 360|8@1+ (1.0,0.0) [0|255] "ascii" ADAS_DOMAIN
 SG_ RouteInfoChar_26 : 368|8@1+ (1.0,0.0) [0|255] "ascii" ADAS_DOMAIN
 SG_ RouteInfoChar_27 : 376|8@1+ (1.0,0.0) [0|255] "ascii" ADAS_DOMAIN
 SG_ RouteInfoChar_28 : 384|8@1+ (1.0,0.0) [0|255] "ascii" ADAS_DOMAIN
 SG_ RouteInfoChar_29 : 392|8@1+ (1.0,0.0) [0|255] "ascii" ADAS_DOMAIN
 SG_ RouteInfoChar_30 : 400|8@1+ (1.0,0.0) [0|255] "ascii" ADAS_DOMAIN
 SG_ RouteInfoChar_31 : 408|8@1+ (1.0,0.0) [0|255] "ascii" ADAS_DOMAIN
 SG_ RouteInfoChar_32 : 416|8@1+ (1.0,0.0) [0|255] "ascii" ADAS_DOMAIN
 SG_ RouteInfoChar_33 : 424|8@1+ (1.0,0.0) [0|255] "ascii" ADAS_DOMAIN
 SG_ RouteInfoChar_34 : 432|8@1+ (1.0,0.0) [0|255] "ascii" ADAS_DOMAIN
 SG_ RouteInfoChar_35 : 440|8@1+ (1.0,0.0) [0|255] "ascii" ADAS_DOMAIN
 SG_ RouteInfoChar_36 : 448|8@1+ (1.0,0.0) [0|255] "ascii" ADAS_DOMAIN
 SG_ RouteInfoChar_37 : 456|8@1+ (1.0,0.0) [0|255] "ascii" ADAS_DOMAIN
 SG_ RouteInfoChar_38 : 464|8@1+ (1.0,0.0) [0|255] "ascii" ADAS_DOMAIN
 SG_ RouteInfoChar_39 : 472|8@1+ (1.0,0.0) [0|255] "ascii" ADAS_DOMAIN
 SG_ RouteInfoChar_40 : 480|8@1+ (1.0,0.0) [0|255] "ascii" ADAS_DOMAIN
 SG_ RouteInfoChar_41 : 488|8@1+ (1.0,0.0) [0|255] "ascii" ADAS_DOMAIN
 SG_ RouteInfoChar_42 : 496|8@1+ (1.0,0.0) [0|255] "ascii" ADAS_DOMAIN
 SG_ RouteInfoChar_43 : 504|8@1+ (1.0,0.0) [0|255] "ascii" ADAS_DOMAIN
CM_ BO_ 257 "Cycle=33ms; Channel=CAN1; CAN-FD; NominalBitrate=500kbit/s; DataBitrate=500kbit/s; PayloadRouteInfo='CAMERA_FRONT_WIDE -> ADAS_DOMAIN' in bytes 20-63";

BO_ 1537 RESP_001_ADAS_DOMAIN_TO_CAMERA_FRONT_WIDE: 16 ADAS_DOMAIN
 SG_ CRC8 : 0|8@1+ (1,0) [0|255] "" CAMERA_FRONT_WIDE
 SG_ ResponseCounter : 8|4@1+ (1,0) [0|15] "" CAMERA_FRONT_WIDE
 SG_ AckState : 12|4@1+ (1,0) [0|15] "" CAMERA_FRONT_WIDE
 SG_ ReceivedFrameId : 16|11@1+ (1,0) [0|2047] "" CAMERA_FRONT_WIDE
 SG_ ReceivedCounter : 27|4@1+ (1,0) [0|15] "" CAMERA_FRONT_WIDE
 SG_ ChecksumOk : 31|1@1+ (0,0) [0|1] "" CAMERA_FRONT_WIDE
 SG_ PayloadLength : 32|8@1+ (1,0) [0|64] "byte" CAMERA_FRONT_WIDE
 SG_ ErrorCode : 40|8@1+ (1,0) [0|255] "" CAMERA_FRONT_WIDE
 SG_ ProcessingTimeUs : 48|16@1+ (1,0) [0|65535] "us" CAMERA_FRONT_WIDE
 SG_ ResponseSequence : 64|16@1+ (1,0) [0|65535] "" CAMERA_FRONT_WIDE
 SG_ ReceivedCrc : 80|8@1+ (1,0) [0|255] "" CAMERA_FRONT_WIDE
 SG_ CalculatedCrc : 88|8@1+ (1,0) [0|255] "" CAMERA_FRONT_WIDE
CM_ BO_ 1537 "Cycle=33ms; Channel=CAN1; CAN-FD; NominalBitrate=500kbit/s; DataBitrate=500kbit/s; ResponseFor=0x101; ACK/NACK with CRC, DLC and counter check";

BO_ 258 DATA_002_RADAR_TARGET_LIST: 64 RADAR_FRONT_LONG_RANGE
 SG_ CRC8 : 0|8@1+ (1,0) [0|255] "" ADAS_DOMAIN
 SG_ AliveCounter : 8|4@1+ (1,0) [0|15] "" ADAS_DOMAIN
 SG_ MuxState : 12|4@1+ (1,0) [0|15] "" ADAS_DOMAIN
 SG_ SIG_00 : 16|12@1+ (0.1,0.0) [0|4095] "km/h" ADAS_DOMAIN
 SG_ SIG_01 : 28|12@1+ (0.1,0.0) [0|4095] "rpm" ADAS_DOMAIN
 SG_ SIG_02 : 40|12@1+ (0.1,0.0) [0|4095] "deg" ADAS_DOMAIN
 SG_ SIG_03 : 52|12@1+ (0.1,0.0) [0|4095] "Nm" ADAS_DOMAIN
 SG_ SIG_04 : 64|12@1+ (0.1,0.0) [0|4095] "V" ADAS_DOMAIN
 SG_ SIG_05 : 76|12@1+ (0.1,0.0) [0|4095] "A" ADAS_DOMAIN
 SG_ SIG_06 : 88|12@1+ (0.1,0.0) [0|4095] "%" ADAS_DOMAIN
 SG_ SIG_07 : 100|12@1+ (0.1,0.0) [0|4095] "C" ADAS_DOMAIN
 SG_ SIG_08 : 112|12@1+ (0.1,0.0) [0|4095] "m" ADAS_DOMAIN
 SG_ SIG_09 : 124|12@1+ (0.1,0.0) [0|4095] "obj" ADAS_DOMAIN
 SG_ SIG_10 : 136|12@1+ (0.1,0.0) [0|4095] "km/h" ADAS_DOMAIN
 SG_ SIG_11 : 148|12@1+ (0.1,0.0) [0|4095] "rpm" ADAS_DOMAIN
 SG_ RouteInfoChar_00 : 160|8@1+ (1.0,0.0) [0|255] "ascii" ADAS_DOMAIN
 SG_ RouteInfoChar_01 : 168|8@1+ (1.0,0.0) [0|255] "ascii" ADAS_DOMAIN
 SG_ RouteInfoChar_02 : 176|8@1+ (1.0,0.0) [0|255] "ascii" ADAS_DOMAIN
 SG_ RouteInfoChar_03 : 184|8@1+ (1.0,0.0) [0|255] "ascii" ADAS_DOMAIN
 SG_ RouteInfoChar_04 : 192|8@1+ (1.0,0.0) [0|255] "ascii" ADAS_DOMAIN
 SG_ RouteInfoChar_05 : 200|8@1+ (1.0,0.0) [0|255] "ascii" ADAS_DOMAIN
 SG_ RouteInfoChar_06 : 208|8@1+ (1.0,0.0) [0|255] "ascii" ADAS_DOMAIN
 SG_ RouteInfoChar_07 : 216|8@1+ (1.0,0.0) [0|255] "ascii" ADAS_DOMAIN
 SG_ RouteInfoChar_08 : 224|8@1+ (1.0,0.0) [0|255] "ascii" ADAS_DOMAIN
 SG_ RouteInfoChar_09 : 232|8@1+ (1.0,0.0) [0|255] "ascii" ADAS_DOMAIN
 SG_ RouteInfoChar_10 : 240|8@1+ (1.0,0.0) [0|255] "ascii" ADAS_DOMAIN
 SG_ RouteInfoChar_11 : 248|8@1+ (1.0,0.0) [0|255] "ascii" ADAS_DOMAIN
 SG_ RouteInfoChar_12 : 256|8@1+ (1.0,0.0) [0|255] "ascii" ADAS_DOMAIN
 SG_ RouteInfoChar_13 : 264|8@1+ (1.0,0.0) [0|255] "ascii" ADAS_DOMAIN
 SG_ RouteInfoChar_14 : 272|8@1+ (1.0,0.0) [0|255] "ascii" ADAS_DOMAIN
 SG_ RouteInfoChar_15 : 280|8@1+ (1.0,0.0) [0|255] "ascii" ADAS_DOMAIN
 SG_ RouteInfoChar_16 : 288|8@1+ (1.0,0.0) [0|255] "ascii" ADAS_DOMAIN
 SG_ RouteInfoChar_17 : 296|8@1+ (1.0,0.0) [0|255] "ascii" ADAS_DOMAIN
 SG_ RouteInfoChar_18 : 304|8@1+ (1.0,0.0) [0|255] "ascii" ADAS_DOMAIN
 SG_ RouteInfoChar_19 : 312|8@1+ (1.0,0.0) [0|255] "ascii" ADAS_DOMAIN
 SG_ RouteInfoChar_20 : 320|8@1+ (1.0,0.0) [0|255] "ascii" ADAS_DOMAIN
 SG_ RouteInfoChar_21 : 328|8@1+ (1.0,0.0) [0|255] "ascii" ADAS_DOMAIN
 SG_ RouteInfoChar_22 : 336|8@1+ (1.0,0.0) [0|255] "ascii" ADAS_DOMAIN
 SG_ RouteInfoChar_23 : 344|8@1+ (1.0,0.0) [0|255] "ascii" ADAS_DOMAIN
 SG_ RouteInfoChar_24 : 352|8@1+ (1.0,0.0) [0|255] "ascii" ADAS_DOMAIN
 SG_ RouteInfoChar_25 : 360|8@1+ (1.0,0.0) [0|255] "ascii" ADAS_DOMAIN
 SG_ RouteInfoChar_26 : 368|8@1+ (1.0,0.0) [0|255] "ascii" ADAS_DOMAIN
 SG_ RouteInfoChar_27 : 376|8@1+ (1.0,0.0) [0|255] "ascii" ADAS_DOMAIN
 SG_ RouteInfoChar_28 : 384|8@1+ (1.0,0.0) [0|255] "ascii" ADAS_DOMAIN
 SG_ RouteInfoChar_29 : 392|8@1+ (1.0,0.0) [0|255] "ascii" ADAS_DOMAIN
 SG_ RouteInfoChar_30 : 400|8@1+ (1.0,0.0) [0|255] "ascii" ADAS_DOMAIN
 SG_ RouteInfoChar_31 : 408|8@1+ (1.0,0.0) [0|255] "ascii" ADAS_DOMAIN
 SG_ RouteInfoChar_32 : 416|8@1+ (1.0,0.0) [0|255] "ascii" ADAS_DOMAIN
 SG_ RouteInfoChar_33 : 424|8@1+ (1.0,0.0) [0|255] "ascii" ADAS_DOMAIN
 SG_ RouteInfoChar_34 : 432|8@1+ (1.0,0.0) [0|255] "ascii" ADAS_DOMAIN
 SG_ RouteInfoChar_35 : 440|8@1+ (1.0,0.0) [0|255] "ascii" ADAS_DOMAIN
 SG_ RouteInfoChar_36 : 448|8@1+ (1.0,0.0) [0|255] "ascii" ADAS_DOMAIN
 SG_ RouteInfoChar_37 : 456|8@1+ (1.0,0.0) [0|255] "ascii" ADAS_DOMAIN
 SG_ RouteInfoChar_38 : 464|8@1+ (1.0,0.0) [0|255] "ascii" ADAS_DOMAIN
 SG_ RouteInfoChar_39 : 472|8@1+ (1.0,0.0) [0|255] "ascii" ADAS_DOMAIN
 SG_ RouteInfoChar_40 : 480|8@1+ (1.0,0.0) [0|255] "ascii" ADAS_DOMAIN
 SG_ RouteInfoChar_41 : 488|8@1+ (1.0,0.0) [0|255] "ascii" ADAS_DOMAIN
 SG_ RouteInfoChar_42 : 496|8@1+ (1.0,0.0) [0|255] "ascii" ADAS_DOMAIN
 SG_ RouteInfoChar_43 : 504|8@1+ (1.0,0.0) [0|255] "ascii" ADAS_DOMAIN
CM_ BO_ 258 "Cycle=20ms; Channel=CAN2; CAN-FD; NominalBitrate=500kbit/s; DataBitrate=500kbit/s; PayloadRouteInfo='RADAR_FRONT_LONG_RANGE -> ADAS_DOMAIN' in bytes 20-63";

BO_ 1538 RESP_002_ADAS_DOMAIN_TO_RADAR_FRONT_LONG_RANGE: 16 ADAS_DOMAIN
 SG_ CRC8 : 0|8@1+ (1,0) [0|255] "" RADAR_FRONT_LONG_RANGE
 SG_ ResponseCounter : 8|4@1+ (1,0) [0|15] "" RADAR_FRONT_LONG_RANGE
 SG_ AckState : 12|4@1+ (1,0) [0|15] "" RADAR_FRONT_LONG_RANGE
 SG_ ReceivedFrameId : 16|11@1+ (1,0) [0|2047] "" RADAR_FRONT_LONG_RANGE
 SG_ ReceivedCounter : 27|4@1+ (1,0) [0|15] "" RADAR_FRONT_LONG_RANGE
 SG_ ChecksumOk : 31|1@1+ (0,0) [0|1] "" RADAR_FRONT_LONG_RANGE
 SG_ PayloadLength : 32|8@1+ (1,0) [0|64] "byte" RADAR_FRONT_LONG_RANGE
 SG_ ErrorCode : 40|8@1+ (1,0) [0|255] "" RADAR_FRONT_LONG_RANGE
 SG_ ProcessingTimeUs : 48|16@1+ (1,0) [0|65535] "us" RADAR_FRONT_LONG_RANGE
 SG_ ResponseSequence : 64|16@1+ (1,0) [0|65535] "" RADAR_FRONT_LONG_RANGE
 SG_ ReceivedCrc : 80|8@1+ (1,0) [0|255] "" RADAR_FRONT_LONG_RANGE
 SG_ CalculatedCrc : 88|8@1+ (1,0) [0|255] "" RADAR_FRONT_LONG_RANGE
CM_ BO_ 1538 "Cycle=20ms; Channel=CAN2; CAN-FD; NominalBitrate=500kbit/s; DataBitrate=500kbit/s; ResponseFor=0x102; ACK/NACK with CRC, DLC and counter check";

BO_ 259 DATA_003_REAR_CROSS_TRAFFIC: 64 RADAR_REAR_CROSS_TRAFFIC
 SG_ CRC8 : 0|8@1+ (1,0) [0|255] "" ADAS_DOMAIN
 SG_ AliveCounter : 8|4@1+ (1,0) [0|15] "" ADAS_DOMAIN
 SG_ MuxState : 12|4@1+ (1,0) [0|15] "" ADAS_DOMAIN
 SG_ SIG_00 : 16|12@1+ (0.1,0.0) [0|4095] "km/h" ADAS_DOMAIN
 SG_ SIG_01 : 28|12@1+ (0.1,0.0) [0|4095] "rpm" ADAS_DOMAIN
 SG_ SIG_02 : 40|12@1+ (0.1,0.0) [0|4095] "deg" ADAS_DOMAIN
 SG_ SIG_03 : 52|12@1+ (0.1,0.0) [0|4095] "Nm" ADAS_DOMAIN
 SG_ SIG_04 : 64|12@1+ (0.1,0.0) [0|4095] "V" ADAS_DOMAIN
 SG_ SIG_05 : 76|12@1+ (0.1,0.0) [0|4095] "A" ADAS_DOMAIN
 SG_ SIG_06 : 88|12@1+ (0.1,0.0) [0|4095] "%" ADAS_DOMAIN
 SG_ SIG_07 : 100|12@1+ (0.1,0.0) [0|4095] "C" ADAS_DOMAIN
 SG_ SIG_08 : 112|12@1+ (0.1,0.0) [0|4095] "m" ADAS_DOMAIN
 SG_ SIG_09 : 124|12@1+ (0.1,0.0) [0|4095] "obj" ADAS_DOMAIN
 SG_ SIG_10 : 136|12@1+ (0.1,0.0) [0|4095] "km/h" ADAS_DOMAIN
 SG_ SIG_11 : 148|12@1+ (0.1,0.0) [0|4095] "rpm" ADAS_DOMAIN
 SG_ RouteInfoChar_00 : 160|8@1+ (1.0,0.0) [0|255] "ascii" ADAS_DOMAIN
 SG_ RouteInfoChar_01 : 168|8@1+ (1.0,0.0) [0|255] "ascii" ADAS_DOMAIN
 SG_ RouteInfoChar_02 : 176|8@1+ (1.0,0.0) [0|255] "ascii" ADAS_DOMAIN
 SG_ RouteInfoChar_03 : 184|8@1+ (1.0,0.0) [0|255] "ascii" ADAS_DOMAIN
 SG_ RouteInfoChar_04 : 192|8@1+ (1.0,0.0) [0|255] "ascii" ADAS_DOMAIN
 SG_ RouteInfoChar_05 : 200|8@1+ (1.0,0.0) [0|255] "ascii" ADAS_DOMAIN
 SG_ RouteInfoChar_06 : 208|8@1+ (1.0,0.0) [0|255] "ascii" ADAS_DOMAIN
 SG_ RouteInfoChar_07 : 216|8@1+ (1.0,0.0) [0|255] "ascii" ADAS_DOMAIN
 SG_ RouteInfoChar_08 : 224|8@1+ (1.0,0.0) [0|255] "ascii" ADAS_DOMAIN
 SG_ RouteInfoChar_09 : 232|8@1+ (1.0,0.0) [0|255] "ascii" ADAS_DOMAIN
 SG_ RouteInfoChar_10 : 240|8@1+ (1.0,0.0) [0|255] "ascii" ADAS_DOMAIN
 SG_ RouteInfoChar_11 : 248|8@1+ (1.0,0.0) [0|255] "ascii" ADAS_DOMAIN
 SG_ RouteInfoChar_12 : 256|8@1+ (1.0,0.0) [0|255] "ascii" ADAS_DOMAIN
 SG_ RouteInfoChar_13 : 264|8@1+ (1.0,0.0) [0|255] "ascii" ADAS_DOMAIN
 SG_ RouteInfoChar_14 : 272|8@1+ (1.0,0.0) [0|255] "ascii" ADAS_DOMAIN
 SG_ RouteInfoChar_15 : 280|8@1+ (1.0,0.0) [0|255] "ascii" ADAS_DOMAIN
 SG_ RouteInfoChar_16 : 288|8@1+ (1.0,0.0) [0|255] "ascii" ADAS_DOMAIN
 SG_ RouteInfoChar_17 : 296|8@1+ (1.0,0.0) [0|255] "ascii" ADAS_DOMAIN
 SG_ RouteInfoChar_18 : 304|8@1+ (1.0,0.0) [0|255] "ascii" ADAS_DOMAIN
 SG_ RouteInfoChar_19 : 312|8@1+ (1.0,0.0) [0|255] "ascii" ADAS_DOMAIN
 SG_ RouteInfoChar_20 : 320|8@1+ (1.0,0.0) [0|255] "ascii" ADAS_DOMAIN
 SG_ RouteInfoChar_21 : 328|8@1+ (1.0,0.0) [0|255] "ascii" ADAS_DOMAIN
 SG_ RouteInfoChar_22 : 336|8@1+ (1.0,0.0) [0|255] "ascii" ADAS_DOMAIN
 SG_ RouteInfoChar_23 : 344|8@1+ (1.0,0.0) [0|255] "ascii" ADAS_DOMAIN
 SG_ RouteInfoChar_24 : 352|8@1+ (1.0,0.0) [0|255] "ascii" ADAS_DOMAIN
 SG_ RouteInfoChar_25 : 360|8@1+ (1.0,0.0) [0|255] "ascii" ADAS_DOMAIN
 SG_ RouteInfoChar_26 : 368|8@1+ (1.0,0.0) [0|255] "ascii" ADAS_DOMAIN
 SG_ RouteInfoChar_27 : 376|8@1+ (1.0,0.0) [0|255] "ascii" ADAS_DOMAIN
 SG_ RouteInfoChar_28 : 384|8@1+ (1.0,0.0) [0|255] "ascii" ADAS_DOMAIN
 SG_ RouteInfoChar_29 : 392|8@1+ (1.0,0.0) [0|255] "ascii" ADAS_DOMAIN
 SG_ RouteInfoChar_30 : 400|8@1+ (1.0,0.0) [0|255] "ascii" ADAS_DOMAIN
 SG_ RouteInfoChar_31 : 408|8@1+ (1.0,0.0) [0|255] "ascii" ADAS_DOMAIN
 SG_ RouteInfoChar_32 : 416|8@1+ (1.0,0.0) [0|255] "ascii" ADAS_DOMAIN
 SG_ RouteInfoChar_33 : 424|8@1+ (1.0,0.0) [0|255] "ascii" ADAS_DOMAIN
 SG_ RouteInfoChar_34 : 432|8@1+ (1.0,0.0) [0|255] "ascii" ADAS_DOMAIN
 SG_ RouteInfoChar_35 : 440|8@1+ (1.0,0.0) [0|255] "ascii" ADAS_DOMAIN
 SG_ RouteInfoChar_36 : 448|8@1+ (1.0,0.0) [0|255] "ascii" ADAS_DOMAIN
 SG_ RouteInfoChar_37 : 456|8@1+ (1.0,0.0) [0|255] "ascii" ADAS_DOMAIN
 SG_ RouteInfoChar_38 : 464|8@1+ (1.0,0.0) [0|255] "ascii" ADAS_DOMAIN
 SG_ RouteInfoChar_39 : 472|8@1+ (1.0,0.0) [0|255] "ascii" ADAS_DOMAIN
 SG_ RouteInfoChar_40 : 480|8@1+ (1.0,0.0) [0|255] "ascii" ADAS_DOMAIN
 SG_ RouteInfoChar_41 : 488|8@1+ (1.0,0.0) [0|255] "ascii" ADAS_DOMAIN
 SG_ RouteInfoChar_42 : 496|8@1+ (1.0,0.0) [0|255] "ascii" ADAS_DOMAIN
 SG_ RouteInfoChar_43 : 504|8@1+ (1.0,0.0) [0|255] "ascii" ADAS_DOMAIN
CM_ BO_ 259 "Cycle=50ms; Channel=CAN3; CAN-FD; NominalBitrate=500kbit/s; DataBitrate=500kbit/s; PayloadRouteInfo='RADAR_REAR_CROSS_TRAFFIC -> ADAS_DOMAIN' in bytes 20-63";

BO_ 1539 RESP_003_ADAS_DOMAIN_TO_RADAR_REAR_CROSS_TRAFFIC: 16 ADAS_DOMAIN
 SG_ CRC8 : 0|8@1+ (1,0) [0|255] "" RADAR_REAR_CROSS_TRAFFIC
 SG_ ResponseCounter : 8|4@1+ (1,0) [0|15] "" RADAR_REAR_CROSS_TRAFFIC
 SG_ AckState : 12|4@1+ (1,0) [0|15] "" RADAR_REAR_CROSS_TRAFFIC
 SG_ ReceivedFrameId : 16|11@1+ (1,0) [0|2047] "" RADAR_REAR_CROSS_TRAFFIC
 SG_ ReceivedCounter : 27|4@1+ (1,0) [0|15] "" RADAR_REAR_CROSS_TRAFFIC
 SG_ ChecksumOk : 31|1@1+ (0,0) [0|1] "" RADAR_REAR_CROSS_TRAFFIC
 SG_ PayloadLength : 32|8@1+ (1,0) [0|64] "byte" RADAR_REAR_CROSS_TRAFFIC
 SG_ ErrorCode : 40|8@1+ (1,0) [0|255] "" RADAR_REAR_CROSS_TRAFFIC
 SG_ ProcessingTimeUs : 48|16@1+ (1,0) [0|65535] "us" RADAR_REAR_CROSS_TRAFFIC
 SG_ ResponseSequence : 64|16@1+ (1,0) [0|65535] "" RADAR_REAR_CROSS_TRAFFIC
 SG_ ReceivedCrc : 80|8@1+ (1,0) [0|255] "" RADAR_REAR_CROSS_TRAFFIC
 SG_ CalculatedCrc : 88|8@1+ (1,0) [0|255] "" RADAR_REAR_CROSS_TRAFFIC
CM_ BO_ 1539 "Cycle=50ms; Channel=CAN3; CAN-FD; NominalBitrate=500kbit/s; DataBitrate=500kbit/s; ResponseFor=0x103; ACK/NACK with CRC, DLC and counter check";

BO_ 260 DATA_004_ULTRASONIC_LEFT_DISTANCE: 64 ULTRASONIC_LEFT_CLUSTER
 SG_ CRC8 : 0|8@1+ (1,0) [0|255] "" PARK_ASSIST
 SG_ AliveCounter : 8|4@1+ (1,0) [0|15] "" PARK_ASSIST
 SG_ MuxState : 12|4@1+ (1,0) [0|15] "" PARK_ASSIST
 SG_ SIG_00 : 16|12@1+ (0.1,0.0) [0|4095] "km/h" PARK_ASSIST
 SG_ SIG_01 : 28|12@1+ (0.1,0.0) [0|4095] "rpm" PARK_ASSIST
 SG_ SIG_02 : 40|12@1+ (0.1,0.0) [0|4095] "deg" PARK_ASSIST
 SG_ SIG_03 : 52|12@1+ (0.1,0.0) [0|4095] "Nm" PARK_ASSIST
 SG_ SIG_04 : 64|12@1+ (0.1,0.0) [0|4095] "V" PARK_ASSIST
 SG_ SIG_05 : 76|12@1+ (0.1,0.0) [0|4095] "A" PARK_ASSIST
 SG_ SIG_06 : 88|12@1+ (0.1,0.0) [0|4095] "%" PARK_ASSIST
 SG_ SIG_07 : 100|12@1+ (0.1,0.0) [0|4095] "C" PARK_ASSIST
 SG_ SIG_08 : 112|12@1+ (0.1,0.0) [0|4095] "m" PARK_ASSIST
 SG_ SIG_09 : 124|12@1+ (0.1,0.0) [0|4095] "obj" PARK_ASSIST
 SG_ SIG_10 : 136|12@1+ (0.1,0.0) [0|4095] "km/h" PARK_ASSIST
 SG_ SIG_11 : 148|12@1+ (0.1,0.0) [0|4095] "rpm" PARK_ASSIST
 SG_ RouteInfoChar_00 : 160|8@1+ (1.0,0.0) [0|255] "ascii" PARK_ASSIST
 SG_ RouteInfoChar_01 : 168|8@1+ (1.0,0.0) [0|255] "ascii" PARK_ASSIST
 SG_ RouteInfoChar_02 : 176|8@1+ (1.0,0.0) [0|255] "ascii" PARK_ASSIST
 SG_ RouteInfoChar_03 : 184|8@1+ (1.0,0.0) [0|255] "ascii" PARK_ASSIST
 SG_ RouteInfoChar_04 : 192|8@1+ (1.0,0.0) [0|255] "ascii" PARK_ASSIST
 SG_ RouteInfoChar_05 : 200|8@1+ (1.0,0.0) [0|255] "ascii" PARK_ASSIST
 SG_ RouteInfoChar_06 : 208|8@1+ (1.0,0.0) [0|255] "ascii" PARK_ASSIST
 SG_ RouteInfoChar_07 : 216|8@1+ (1.0,0.0) [0|255] "ascii" PARK_ASSIST
 SG_ RouteInfoChar_08 : 224|8@1+ (1.0,0.0) [0|255] "ascii" PARK_ASSIST
 SG_ RouteInfoChar_09 : 232|8@1+ (1.0,0.0) [0|255] "ascii" PARK_ASSIST
 SG_ RouteInfoChar_10 : 240|8@1+ (1.0,0.0) [0|255] "ascii" PARK_ASSIST
 SG_ RouteInfoChar_11 : 248|8@1+ (1.0,0.0) [0|255] "ascii" PARK_ASSIST
 SG_ RouteInfoChar_12 : 256|8@1+ (1.0,0.0) [0|255] "ascii" PARK_ASSIST
 SG_ RouteInfoChar_13 : 264|8@1+ (1.0,0.0) [0|255] "ascii" PARK_ASSIST
 SG_ RouteInfoChar_14 : 272|8@1+ (1.0,0.0) [0|255] "ascii" PARK_ASSIST
 SG_ RouteInfoChar_15 : 280|8@1+ (1.0,0.0) [0|255] "ascii" PARK_ASSIST
 SG_ RouteInfoChar_16 : 288|8@1+ (1.0,0.0) [0|255] "ascii" PARK_ASSIST
 SG_ RouteInfoChar_17 : 296|8@1+ (1.0,0.0) [0|255] "ascii" PARK_ASSIST
 SG_ RouteInfoChar_18 : 304|8@1+ (1.0,0.0) [0|255] "ascii" PARK_ASSIST
 SG_ RouteInfoChar_19 : 312|8@1+ (1.0,0.0) [0|255] "ascii" PARK_ASSIST
 SG_ RouteInfoChar_20 : 320|8@1+ (1.0,0.0) [0|255] "ascii" PARK_ASSIST
 SG_ RouteInfoChar_21 : 328|8@1+ (1.0,0.0) [0|255] "ascii" PARK_ASSIST
 SG_ RouteInfoChar_22 : 336|8@1+ (1.0,0.0) [0|255] "ascii" PARK_ASSIST
 SG_ RouteInfoChar_23 : 344|8@1+ (1.0,0.0) [0|255] "ascii" PARK_ASSIST
 SG_ RouteInfoChar_24 : 352|8@1+ (1.0,0.0) [0|255] "ascii" PARK_ASSIST
 SG_ RouteInfoChar_25 : 360|8@1+ (1.0,0.0) [0|255] "ascii" PARK_ASSIST
 SG_ RouteInfoChar_26 : 368|8@1+ (1.0,0.0) [0|255] "ascii" PARK_ASSIST
 SG_ RouteInfoChar_27 : 376|8@1+ (1.0,0.0) [0|255] "ascii" PARK_ASSIST
 SG_ RouteInfoChar_28 : 384|8@1+ (1.0,0.0) [0|255] "ascii" PARK_ASSIST
 SG_ RouteInfoChar_29 : 392|8@1+ (1.0,0.0) [0|255] "ascii" PARK_ASSIST
 SG_ RouteInfoChar_30 : 400|8@1+ (1.0,0.0) [0|255] "ascii" PARK_ASSIST
 SG_ RouteInfoChar_31 : 408|8@1+ (1.0,0.0) [0|255] "ascii" PARK_ASSIST
 SG_ RouteInfoChar_32 : 416|8@1+ (1.0,0.0) [0|255] "ascii" PARK_ASSIST
 SG_ RouteInfoChar_33 : 424|8@1+ (1.0,0.0) [0|255] "ascii" PARK_ASSIST
 SG_ RouteInfoChar_34 : 432|8@1+ (1.0,0.0) [0|255] "ascii" PARK_ASSIST
 SG_ RouteInfoChar_35 : 440|8@1+ (1.0,0.0) [0|255] "ascii" PARK_ASSIST
 SG_ RouteInfoChar_36 : 448|8@1+ (1.0,0.0) [0|255] "ascii" PARK_ASSIST
 SG_ RouteInfoChar_37 : 456|8@1+ (1.0,0.0) [0|255] "ascii" PARK_ASSIST
 SG_ RouteInfoChar_38 : 464|8@1+ (1.0,0.0) [0|255] "ascii" PARK_ASSIST
 SG_ RouteInfoChar_39 : 472|8@1+ (1.0,0.0) [0|255] "ascii" PARK_ASSIST
 SG_ RouteInfoChar_40 : 480|8@1+ (1.0,0.0) [0|255] "ascii" PARK_ASSIST
 SG_ RouteInfoChar_41 : 488|8@1+ (1.0,0.0) [0|255] "ascii" PARK_ASSIST
 SG_ RouteInfoChar_42 : 496|8@1+ (1.0,0.0) [0|255] "ascii" PARK_ASSIST
 SG_ RouteInfoChar_43 : 504|8@1+ (1.0,0.0) [0|255] "ascii" PARK_ASSIST
CM_ BO_ 260 "Cycle=40ms; Channel=CAN4; CAN-FD; NominalBitrate=500kbit/s; DataBitrate=500kbit/s; PayloadRouteInfo='ULTRASONIC_LEFT_CLUSTER -> PARK_ASSIST' in bytes 20-63";

BO_ 1540 RESP_004_PARK_ASSIST_TO_ULTRASONIC_LEFT_CLUSTER: 16 PARK_ASSIST
 SG_ CRC8 : 0|8@1+ (1,0) [0|255] "" ULTRASONIC_LEFT_CLUSTER
 SG_ ResponseCounter : 8|4@1+ (1,0) [0|15] "" ULTRASONIC_LEFT_CLUSTER
 SG_ AckState : 12|4@1+ (1,0) [0|15] "" ULTRASONIC_LEFT_CLUSTER
 SG_ ReceivedFrameId : 16|11@1+ (1,0) [0|2047] "" ULTRASONIC_LEFT_CLUSTER
 SG_ ReceivedCounter : 27|4@1+ (1,0) [0|15] "" ULTRASONIC_LEFT_CLUSTER
 SG_ ChecksumOk : 31|1@1+ (0,0) [0|1] "" ULTRASONIC_LEFT_CLUSTER
 SG_ PayloadLength : 32|8@1+ (1,0) [0|64] "byte" ULTRASONIC_LEFT_CLUSTER
 SG_ ErrorCode : 40|8@1+ (1,0) [0|255] "" ULTRASONIC_LEFT_CLUSTER
 SG_ ProcessingTimeUs : 48|16@1+ (1,0) [0|65535] "us" ULTRASONIC_LEFT_CLUSTER
 SG_ ResponseSequence : 64|16@1+ (1,0) [0|65535] "" ULTRASONIC_LEFT_CLUSTER
 SG_ ReceivedCrc : 80|8@1+ (1,0) [0|255] "" ULTRASONIC_LEFT_CLUSTER
 SG_ CalculatedCrc : 88|8@1+ (1,0) [0|255] "" ULTRASONIC_LEFT_CLUSTER
CM_ BO_ 1540 "Cycle=40ms; Channel=CAN4; CAN-FD; NominalBitrate=500kbit/s; DataBitrate=500kbit/s; ResponseFor=0x104; ACK/NACK with CRC, DLC and counter check";

BO_ 261 DATA_005_ULTRASONIC_RIGHT_DISTANCE: 64 ULTRASONIC_RIGHT_CLUSTER
 SG_ CRC8 : 0|8@1+ (1,0) [0|255] "" PARK_ASSIST
 SG_ AliveCounter : 8|4@1+ (1,0) [0|15] "" PARK_ASSIST
 SG_ MuxState : 12|4@1+ (1,0) [0|15] "" PARK_ASSIST
 SG_ SIG_00 : 16|12@1+ (0.1,0.0) [0|4095] "km/h" PARK_ASSIST
 SG_ SIG_01 : 28|12@1+ (0.1,0.0) [0|4095] "rpm" PARK_ASSIST
 SG_ SIG_02 : 40|12@1+ (0.1,0.0) [0|4095] "deg" PARK_ASSIST
 SG_ SIG_03 : 52|12@1+ (0.1,0.0) [0|4095] "Nm" PARK_ASSIST
 SG_ SIG_04 : 64|12@1+ (0.1,0.0) [0|4095] "V" PARK_ASSIST
 SG_ SIG_05 : 76|12@1+ (0.1,0.0) [0|4095] "A" PARK_ASSIST
 SG_ SIG_06 : 88|12@1+ (0.1,0.0) [0|4095] "%" PARK_ASSIST
 SG_ SIG_07 : 100|12@1+ (0.1,0.0) [0|4095] "C" PARK_ASSIST
 SG_ SIG_08 : 112|12@1+ (0.1,0.0) [0|4095] "m" PARK_ASSIST
 SG_ SIG_09 : 124|12@1+ (0.1,0.0) [0|4095] "obj" PARK_ASSIST
 SG_ SIG_10 : 136|12@1+ (0.1,0.0) [0|4095] "km/h" PARK_ASSIST
 SG_ SIG_11 : 148|12@1+ (0.1,0.0) [0|4095] "rpm" PARK_ASSIST
 SG_ RouteInfoChar_00 : 160|8@1+ (1.0,0.0) [0|255] "ascii" PARK_ASSIST
 SG_ RouteInfoChar_01 : 168|8@1+ (1.0,0.0) [0|255] "ascii" PARK_ASSIST
 SG_ RouteInfoChar_02 : 176|8@1+ (1.0,0.0) [0|255] "ascii" PARK_ASSIST
 SG_ RouteInfoChar_03 : 184|8@1+ (1.0,0.0) [0|255] "ascii" PARK_ASSIST
 SG_ RouteInfoChar_04 : 192|8@1+ (1.0,0.0) [0|255] "ascii" PARK_ASSIST
 SG_ RouteInfoChar_05 : 200|8@1+ (1.0,0.0) [0|255] "ascii" PARK_ASSIST
 SG_ RouteInfoChar_06 : 208|8@1+ (1.0,0.0) [0|255] "ascii" PARK_ASSIST
 SG_ RouteInfoChar_07 : 216|8@1+ (1.0,0.0) [0|255] "ascii" PARK_ASSIST
 SG_ RouteInfoChar_08 : 224|8@1+ (1.0,0.0) [0|255] "ascii" PARK_ASSIST
 SG_ RouteInfoChar_09 : 232|8@1+ (1.0,0.0) [0|255] "ascii" PARK_ASSIST
 SG_ RouteInfoChar_10 : 240|8@1+ (1.0,0.0) [0|255] "ascii" PARK_ASSIST
 SG_ RouteInfoChar_11 : 248|8@1+ (1.0,0.0) [0|255] "ascii" PARK_ASSIST
 SG_ RouteInfoChar_12 : 256|8@1+ (1.0,0.0) [0|255] "ascii" PARK_ASSIST
 SG_ RouteInfoChar_13 : 264|8@1+ (1.0,0.0) [0|255] "ascii" PARK_ASSIST
 SG_ RouteInfoChar_14 : 272|8@1+ (1.0,0.0) [0|255] "ascii" PARK_ASSIST
 SG_ RouteInfoChar_15 : 280|8@1+ (1.0,0.0) [0|255] "ascii" PARK_ASSIST
 SG_ RouteInfoChar_16 : 288|8@1+ (1.0,0.0) [0|255] "ascii" PARK_ASSIST
 SG_ RouteInfoChar_17 : 296|8@1+ (1.0,0.0) [0|255] "ascii" PARK_ASSIST
 SG_ RouteInfoChar_18 : 304|8@1+ (1.0,0.0) [0|255] "ascii" PARK_ASSIST
 SG_ RouteInfoChar_19 : 312|8@1+ (1.0,0.0) [0|255] "ascii" PARK_ASSIST
 SG_ RouteInfoChar_20 : 320|8@1+ (1.0,0.0) [0|255] "ascii" PARK_ASSIST
 SG_ RouteInfoChar_21 : 328|8@1+ (1.0,0.0) [0|255] "ascii" PARK_ASSIST
 SG_ RouteInfoChar_22 : 336|8@1+ (1.0,0.0) [0|255] "ascii" PARK_ASSIST
 SG_ RouteInfoChar_23 : 344|8@1+ (1.0,0.0) [0|255] "ascii" PARK_ASSIST
 SG_ RouteInfoChar_24 : 352|8@1+ (1.0,0.0) [0|255] "ascii" PARK_ASSIST
 SG_ RouteInfoChar_25 : 360|8@1+ (1.0,0.0) [0|255] "ascii" PARK_ASSIST
 SG_ RouteInfoChar_26 : 368|8@1+ (1.0,0.0) [0|255] "ascii" PARK_ASSIST
 SG_ RouteInfoChar_27 : 376|8@1+ (1.0,0.0) [0|255] "ascii" PARK_ASSIST
 SG_ RouteInfoChar_28 : 384|8@1+ (1.0,0.0) [0|255] "ascii" PARK_ASSIST
 SG_ RouteInfoChar_29 : 392|8@1+ (1.0,0.0) [0|255] "ascii" PARK_ASSIST
 SG_ RouteInfoChar_30 : 400|8@1+ (1.0,0.0) [0|255] "ascii" PARK_ASSIST
 SG_ RouteInfoChar_31 : 408|8@1+ (1.0,0.0) [0|255] "ascii" PARK_ASSIST
 SG_ RouteInfoChar_32 : 416|8@1+ (1.0,0.0) [0|255] "ascii" PARK_ASSIST
 SG_ RouteInfoChar_33 : 424|8@1+ (1.0,0.0) [0|255] "ascii" PARK_ASSIST
 SG_ RouteInfoChar_34 : 432|8@1+ (1.0,0.0) [0|255] "ascii" PARK_ASSIST
 SG_ RouteInfoChar_35 : 440|8@1+ (1.0,0.0) [0|255] "ascii" PARK_ASSIST
 SG_ RouteInfoChar_36 : 448|8@1+ (1.0,0.0) [0|255] "ascii" PARK_ASSIST
 SG_ RouteInfoChar_37 : 456|8@1+ (1.0,0.0) [0|255] "ascii" PARK_ASSIST
 SG_ RouteInfoChar_38 : 464|8@1+ (1.0,0.0) [0|255] "ascii" PARK_ASSIST
 SG_ RouteInfoChar_39 : 472|8@1+ (1.0,0.0) [0|255] "ascii" PARK_ASSIST
 SG_ RouteInfoChar_40 : 480|8@1+ (1.0,0.0) [0|255] "ascii" PARK_ASSIST
 SG_ RouteInfoChar_41 : 488|8@1+ (1.0,0.0) [0|255] "ascii" PARK_ASSIST
 SG_ RouteInfoChar_42 : 496|8@1+ (1.0,0.0) [0|255] "ascii" PARK_ASSIST
 SG_ RouteInfoChar_43 : 504|8@1+ (1.0,0.0) [0|255] "ascii" PARK_ASSIST
CM_ BO_ 261 "Cycle=40ms; Channel=CAN5; CAN-FD; NominalBitrate=500kbit/s; DataBitrate=500kbit/s; PayloadRouteInfo='ULTRASONIC_RIGHT_CLUSTER -> PARK_ASSIST' in bytes 20-63";

BO_ 1541 RESP_005_PARK_ASSIST_TO_ULTRASONIC_RIGHT_CLUSTER: 16 PARK_ASSIST
 SG_ CRC8 : 0|8@1+ (1,0) [0|255] "" ULTRASONIC_RIGHT_CLUSTER
 SG_ ResponseCounter : 8|4@1+ (1,0) [0|15] "" ULTRASONIC_RIGHT_CLUSTER
 SG_ AckState : 12|4@1+ (1,0) [0|15] "" ULTRASONIC_RIGHT_CLUSTER
 SG_ ReceivedFrameId : 16|11@1+ (1,0) [0|2047] "" ULTRASONIC_RIGHT_CLUSTER
 SG_ ReceivedCounter : 27|4@1+ (1,0) [0|15] "" ULTRASONIC_RIGHT_CLUSTER
 SG_ ChecksumOk : 31|1@1+ (0,0) [0|1] "" ULTRASONIC_RIGHT_CLUSTER
 SG_ PayloadLength : 32|8@1+ (1,0) [0|64] "byte" ULTRASONIC_RIGHT_CLUSTER
 SG_ ErrorCode : 40|8@1+ (1,0) [0|255] "" ULTRASONIC_RIGHT_CLUSTER
 SG_ ProcessingTimeUs : 48|16@1+ (1,0) [0|65535] "us" ULTRASONIC_RIGHT_CLUSTER
 SG_ ResponseSequence : 64|16@1+ (1,0) [0|65535] "" ULTRASONIC_RIGHT_CLUSTER
 SG_ ReceivedCrc : 80|8@1+ (1,0) [0|255] "" ULTRASONIC_RIGHT_CLUSTER
 SG_ CalculatedCrc : 88|8@1+ (1,0) [0|255] "" ULTRASONIC_RIGHT_CLUSTER
CM_ BO_ 1541 "Cycle=40ms; Channel=CAN5; CAN-FD; NominalBitrate=500kbit/s; DataBitrate=500kbit/s; ResponseFor=0x105; ACK/NACK with CRC, DLC and counter check";

BO_ 262 DATA_006_IMU_DYNAMICS: 64 IMU_YAW_RATE_SENSOR
 SG_ CRC8 : 0|8@1+ (1,0) [0|255] "" ADAS_DOMAIN
 SG_ AliveCounter : 8|4@1+ (1,0) [0|15] "" ADAS_DOMAIN
 SG_ MuxState : 12|4@1+ (1,0) [0|15] "" ADAS_DOMAIN
 SG_ SIG_00 : 16|12@1+ (0.1,0.0) [0|4095] "km/h" ADAS_DOMAIN
 SG_ SIG_01 : 28|12@1+ (0.1,0.0) [0|4095] "rpm" ADAS_DOMAIN
 SG_ SIG_02 : 40|12@1+ (0.1,0.0) [0|4095] "deg" ADAS_DOMAIN
 SG_ SIG_03 : 52|12@1+ (0.1,0.0) [0|4095] "Nm" ADAS_DOMAIN
 SG_ SIG_04 : 64|12@1+ (0.1,0.0) [0|4095] "V" ADAS_DOMAIN
 SG_ SIG_05 : 76|12@1+ (0.1,0.0) [0|4095] "A" ADAS_DOMAIN
 SG_ SIG_06 : 88|12@1+ (0.1,0.0) [0|4095] "%" ADAS_DOMAIN
 SG_ SIG_07 : 100|12@1+ (0.1,0.0) [0|4095] "C" ADAS_DOMAIN
 SG_ SIG_08 : 112|12@1+ (0.1,0.0) [0|4095] "m" ADAS_DOMAIN
 SG_ SIG_09 : 124|12@1+ (0.1,0.0) [0|4095] "obj" ADAS_DOMAIN
 SG_ SIG_10 : 136|12@1+ (0.1,0.0) [0|4095] "km/h" ADAS_DOMAIN
 SG_ SIG_11 : 148|12@1+ (0.1,0.0) [0|4095] "rpm" ADAS_DOMAIN
 SG_ RouteInfoChar_00 : 160|8@1+ (1.0,0.0) [0|255] "ascii" ADAS_DOMAIN
 SG_ RouteInfoChar_01 : 168|8@1+ (1.0,0.0) [0|255] "ascii" ADAS_DOMAIN
 SG_ RouteInfoChar_02 : 176|8@1+ (1.0,0.0) [0|255] "ascii" ADAS_DOMAIN
 SG_ RouteInfoChar_03 : 184|8@1+ (1.0,0.0) [0|255] "ascii" ADAS_DOMAIN
 SG_ RouteInfoChar_04 : 192|8@1+ (1.0,0.0) [0|255] "ascii" ADAS_DOMAIN
 SG_ RouteInfoChar_05 : 200|8@1+ (1.0,0.0) [0|255] "ascii" ADAS_DOMAIN
 SG_ RouteInfoChar_06 : 208|8@1+ (1.0,0.0) [0|255] "ascii" ADAS_DOMAIN
 SG_ RouteInfoChar_07 : 216|8@1+ (1.0,0.0) [0|255] "ascii" ADAS_DOMAIN
 SG_ RouteInfoChar_08 : 224|8@1+ (1.0,0.0) [0|255] "ascii" ADAS_DOMAIN
 SG_ RouteInfoChar_09 : 232|8@1+ (1.0,0.0) [0|255] "ascii" ADAS_DOMAIN
 SG_ RouteInfoChar_10 : 240|8@1+ (1.0,0.0) [0|255] "ascii" ADAS_DOMAIN
 SG_ RouteInfoChar_11 : 248|8@1+ (1.0,0.0) [0|255] "ascii" ADAS_DOMAIN
 SG_ RouteInfoChar_12 : 256|8@1+ (1.0,0.0) [0|255] "ascii" ADAS_DOMAIN
 SG_ RouteInfoChar_13 : 264|8@1+ (1.0,0.0) [0|255] "ascii" ADAS_DOMAIN
 SG_ RouteInfoChar_14 : 272|8@1+ (1.0,0.0) [0|255] "ascii" ADAS_DOMAIN
 SG_ RouteInfoChar_15 : 280|8@1+ (1.0,0.0) [0|255] "ascii" ADAS_DOMAIN
 SG_ RouteInfoChar_16 : 288|8@1+ (1.0,0.0) [0|255] "ascii" ADAS_DOMAIN
 SG_ RouteInfoChar_17 : 296|8@1+ (1.0,0.0) [0|255] "ascii" ADAS_DOMAIN
 SG_ RouteInfoChar_18 : 304|8@1+ (1.0,0.0) [0|255] "ascii" ADAS_DOMAIN
 SG_ RouteInfoChar_19 : 312|8@1+ (1.0,0.0) [0|255] "ascii" ADAS_DOMAIN
 SG_ RouteInfoChar_20 : 320|8@1+ (1.0,0.0) [0|255] "ascii" ADAS_DOMAIN
 SG_ RouteInfoChar_21 : 328|8@1+ (1.0,0.0) [0|255] "ascii" ADAS_DOMAIN
 SG_ RouteInfoChar_22 : 336|8@1+ (1.0,0.0) [0|255] "ascii" ADAS_DOMAIN
 SG_ RouteInfoChar_23 : 344|8@1+ (1.0,0.0) [0|255] "ascii" ADAS_DOMAIN
 SG_ RouteInfoChar_24 : 352|8@1+ (1.0,0.0) [0|255] "ascii" ADAS_DOMAIN
 SG_ RouteInfoChar_25 : 360|8@1+ (1.0,0.0) [0|255] "ascii" ADAS_DOMAIN
 SG_ RouteInfoChar_26 : 368|8@1+ (1.0,0.0) [0|255] "ascii" ADAS_DOMAIN
 SG_ RouteInfoChar_27 : 376|8@1+ (1.0,0.0) [0|255] "ascii" ADAS_DOMAIN
 SG_ RouteInfoChar_28 : 384|8@1+ (1.0,0.0) [0|255] "ascii" ADAS_DOMAIN
 SG_ RouteInfoChar_29 : 392|8@1+ (1.0,0.0) [0|255] "ascii" ADAS_DOMAIN
 SG_ RouteInfoChar_30 : 400|8@1+ (1.0,0.0) [0|255] "ascii" ADAS_DOMAIN
 SG_ RouteInfoChar_31 : 408|8@1+ (1.0,0.0) [0|255] "ascii" ADAS_DOMAIN
 SG_ RouteInfoChar_32 : 416|8@1+ (1.0,0.0) [0|255] "ascii" ADAS_DOMAIN
 SG_ RouteInfoChar_33 : 424|8@1+ (1.0,0.0) [0|255] "ascii" ADAS_DOMAIN
 SG_ RouteInfoChar_34 : 432|8@1+ (1.0,0.0) [0|255] "ascii" ADAS_DOMAIN
 SG_ RouteInfoChar_35 : 440|8@1+ (1.0,0.0) [0|255] "ascii" ADAS_DOMAIN
 SG_ RouteInfoChar_36 : 448|8@1+ (1.0,0.0) [0|255] "ascii" ADAS_DOMAIN
 SG_ RouteInfoChar_37 : 456|8@1+ (1.0,0.0) [0|255] "ascii" ADAS_DOMAIN
 SG_ RouteInfoChar_38 : 464|8@1+ (1.0,0.0) [0|255] "ascii" ADAS_DOMAIN
 SG_ RouteInfoChar_39 : 472|8@1+ (1.0,0.0) [0|255] "ascii" ADAS_DOMAIN
 SG_ RouteInfoChar_40 : 480|8@1+ (1.0,0.0) [0|255] "ascii" ADAS_DOMAIN
 SG_ RouteInfoChar_41 : 488|8@1+ (1.0,0.0) [0|255] "ascii" ADAS_DOMAIN
 SG_ RouteInfoChar_42 : 496|8@1+ (1.0,0.0) [0|255] "ascii" ADAS_DOMAIN
 SG_ RouteInfoChar_43 : 504|8@1+ (1.0,0.0) [0|255] "ascii" ADAS_DOMAIN
CM_ BO_ 262 "Cycle=10ms; Channel=CAN6; CAN-FD; NominalBitrate=500kbit/s; DataBitrate=500kbit/s; PayloadRouteInfo='IMU_YAW_RATE_SENSOR -> ADAS_DOMAIN' in bytes 20-63";

BO_ 1542 RESP_006_ADAS_DOMAIN_TO_IMU_YAW_RATE_SENSOR: 16 ADAS_DOMAIN
 SG_ CRC8 : 0|8@1+ (1,0) [0|255] "" IMU_YAW_RATE_SENSOR
 SG_ ResponseCounter : 8|4@1+ (1,0) [0|15] "" IMU_YAW_RATE_SENSOR
 SG_ AckState : 12|4@1+ (1,0) [0|15] "" IMU_YAW_RATE_SENSOR
 SG_ ReceivedFrameId : 16|11@1+ (1,0) [0|2047] "" IMU_YAW_RATE_SENSOR
 SG_ ReceivedCounter : 27|4@1+ (1,0) [0|15] "" IMU_YAW_RATE_SENSOR
 SG_ ChecksumOk : 31|1@1+ (0,0) [0|1] "" IMU_YAW_RATE_SENSOR
 SG_ PayloadLength : 32|8@1+ (1,0) [0|64] "byte" IMU_YAW_RATE_SENSOR
 SG_ ErrorCode : 40|8@1+ (1,0) [0|255] "" IMU_YAW_RATE_SENSOR
 SG_ ProcessingTimeUs : 48|16@1+ (1,0) [0|65535] "us" IMU_YAW_RATE_SENSOR
 SG_ ResponseSequence : 64|16@1+ (1,0) [0|65535] "" IMU_YAW_RATE_SENSOR
 SG_ ReceivedCrc : 80|8@1+ (1,0) [0|255] "" IMU_YAW_RATE_SENSOR
 SG_ CalculatedCrc : 88|8@1+ (1,0) [0|255] "" IMU_YAW_RATE_SENSOR
CM_ BO_ 1542 "Cycle=10ms; Channel=CAN6; CAN-FD; NominalBitrate=500kbit/s; DataBitrate=500kbit/s; ResponseFor=0x106; ACK/NACK with CRC, DLC and counter check";

BO_ 263 DATA_007_WHEEL_SPEED_FL: 64 WHEEL_SPEED_FRONT_LEFT
 SG_ CRC8 : 0|8@1+ (1,0) [0|255] "" BRAKE_CONTROLLER
 SG_ AliveCounter : 8|4@1+ (1,0) [0|15] "" BRAKE_CONTROLLER
 SG_ MuxState : 12|4@1+ (1,0) [0|15] "" BRAKE_CONTROLLER
 SG_ SIG_00 : 16|12@1+ (0.1,0.0) [0|4095] "km/h" BRAKE_CONTROLLER
 SG_ SIG_01 : 28|12@1+ (0.1,0.0) [0|4095] "rpm" BRAKE_CONTROLLER
 SG_ SIG_02 : 40|12@1+ (0.1,0.0) [0|4095] "deg" BRAKE_CONTROLLER
 SG_ SIG_03 : 52|12@1+ (0.1,0.0) [0|4095] "Nm" BRAKE_CONTROLLER
 SG_ SIG_04 : 64|12@1+ (0.1,0.0) [0|4095] "V" BRAKE_CONTROLLER
 SG_ SIG_05 : 76|12@1+ (0.1,0.0) [0|4095] "A" BRAKE_CONTROLLER
 SG_ SIG_06 : 88|12@1+ (0.1,0.0) [0|4095] "%" BRAKE_CONTROLLER
 SG_ SIG_07 : 100|12@1+ (0.1,0.0) [0|4095] "C" BRAKE_CONTROLLER
 SG_ SIG_08 : 112|12@1+ (0.1,0.0) [0|4095] "m" BRAKE_CONTROLLER
 SG_ SIG_09 : 124|12@1+ (0.1,0.0) [0|4095] "obj" BRAKE_CONTROLLER
 SG_ SIG_10 : 136|12@1+ (0.1,0.0) [0|4095] "km/h" BRAKE_CONTROLLER
 SG_ SIG_11 : 148|12@1+ (0.1,0.0) [0|4095] "rpm" BRAKE_CONTROLLER
 SG_ RouteInfoChar_00 : 160|8@1+ (1.0,0.0) [0|255] "ascii" BRAKE_CONTROLLER
 SG_ RouteInfoChar_01 : 168|8@1+ (1.0,0.0) [0|255] "ascii" BRAKE_CONTROLLER
 SG_ RouteInfoChar_02 : 176|8@1+ (1.0,0.0) [0|255] "ascii" BRAKE_CONTROLLER
 SG_ RouteInfoChar_03 : 184|8@1+ (1.0,0.0) [0|255] "ascii" BRAKE_CONTROLLER
 SG_ RouteInfoChar_04 : 192|8@1+ (1.0,0.0) [0|255] "ascii" BRAKE_CONTROLLER
 SG_ RouteInfoChar_05 : 200|8@1+ (1.0,0.0) [0|255] "ascii" BRAKE_CONTROLLER
 SG_ RouteInfoChar_06 : 208|8@1+ (1.0,0.0) [0|255] "ascii" BRAKE_CONTROLLER
 SG_ RouteInfoChar_07 : 216|8@1+ (1.0,0.0) [0|255] "ascii" BRAKE_CONTROLLER
 SG_ RouteInfoChar_08 : 224|8@1+ (1.0,0.0) [0|255] "ascii" BRAKE_CONTROLLER
 SG_ RouteInfoChar_09 : 232|8@1+ (1.0,0.0) [0|255] "ascii" BRAKE_CONTROLLER
 SG_ RouteInfoChar_10 : 240|8@1+ (1.0,0.0) [0|255] "ascii" BRAKE_CONTROLLER
 SG_ RouteInfoChar_11 : 248|8@1+ (1.0,0.0) [0|255] "ascii" BRAKE_CONTROLLER
 SG_ RouteInfoChar_12 : 256|8@1+ (1.0,0.0) [0|255] "ascii" BRAKE_CONTROLLER
 SG_ RouteInfoChar_13 : 264|8@1+ (1.0,0.0) [0|255] "ascii" BRAKE_CONTROLLER
 SG_ RouteInfoChar_14 : 272|8@1+ (1.0,0.0) [0|255] "ascii" BRAKE_CONTROLLER
 SG_ RouteInfoChar_15 : 280|8@1+ (1.0,0.0) [0|255] "ascii" BRAKE_CONTROLLER
 SG_ RouteInfoChar_16 : 288|8@1+ (1.0,0.0) [0|255] "ascii" BRAKE_CONTROLLER
 SG_ RouteInfoChar_17 : 296|8@1+ (1.0,0.0) [0|255] "ascii" BRAKE_CONTROLLER
 SG_ RouteInfoChar_18 : 304|8@1+ (1.0,0.0) [0|255] "ascii" BRAKE_CONTROLLER
 SG_ RouteInfoChar_19 : 312|8@1+ (1.0,0.0) [0|255] "ascii" BRAKE_CONTROLLER
 SG_ RouteInfoChar_20 : 320|8@1+ (1.0,0.0) [0|255] "ascii" BRAKE_CONTROLLER
 SG_ RouteInfoChar_21 : 328|8@1+ (1.0,0.0) [0|255] "ascii" BRAKE_CONTROLLER
 SG_ RouteInfoChar_22 : 336|8@1+ (1.0,0.0) [0|255] "ascii" BRAKE_CONTROLLER
 SG_ RouteInfoChar_23 : 344|8@1+ (1.0,0.0) [0|255] "ascii" BRAKE_CONTROLLER
 SG_ RouteInfoChar_24 : 352|8@1+ (1.0,0.0) [0|255] "ascii" BRAKE_CONTROLLER
 SG_ RouteInfoChar_25 : 360|8@1+ (1.0,0.0) [0|255] "ascii" BRAKE_CONTROLLER
 SG_ RouteInfoChar_26 : 368|8@1+ (1.0,0.0) [0|255] "ascii" BRAKE_CONTROLLER
 SG_ RouteInfoChar_27 : 376|8@1+ (1.0,0.0) [0|255] "ascii" BRAKE_CONTROLLER
 SG_ RouteInfoChar_28 : 384|8@1+ (1.0,0.0) [0|255] "ascii" BRAKE_CONTROLLER
 SG_ RouteInfoChar_29 : 392|8@1+ (1.0,0.0) [0|255] "ascii" BRAKE_CONTROLLER
 SG_ RouteInfoChar_30 : 400|8@1+ (1.0,0.0) [0|255] "ascii" BRAKE_CONTROLLER
 SG_ RouteInfoChar_31 : 408|8@1+ (1.0,0.0) [0|255] "ascii" BRAKE_CONTROLLER
 SG_ RouteInfoChar_32 : 416|8@1+ (1.0,0.0) [0|255] "ascii" BRAKE_CONTROLLER
 SG_ RouteInfoChar_33 : 424|8@1+ (1.0,0.0) [0|255] "ascii" BRAKE_CONTROLLER
 SG_ RouteInfoChar_34 : 432|8@1+ (1.0,0.0) [0|255] "ascii" BRAKE_CONTROLLER
 SG_ RouteInfoChar_35 : 440|8@1+ (1.0,0.0) [0|255] "ascii" BRAKE_CONTROLLER
 SG_ RouteInfoChar_36 : 448|8@1+ (1.0,0.0) [0|255] "ascii" BRAKE_CONTROLLER
 SG_ RouteInfoChar_37 : 456|8@1+ (1.0,0.0) [0|255] "ascii" BRAKE_CONTROLLER
 SG_ RouteInfoChar_38 : 464|8@1+ (1.0,0.0) [0|255] "ascii" BRAKE_CONTROLLER
 SG_ RouteInfoChar_39 : 472|8@1+ (1.0,0.0) [0|255] "ascii" BRAKE_CONTROLLER
 SG_ RouteInfoChar_40 : 480|8@1+ (1.0,0.0) [0|255] "ascii" BRAKE_CONTROLLER
 SG_ RouteInfoChar_41 : 488|8@1+ (1.0,0.0) [0|255] "ascii" BRAKE_CONTROLLER
 SG_ RouteInfoChar_42 : 496|8@1+ (1.0,0.0) [0|255] "ascii" BRAKE_CONTROLLER
 SG_ RouteInfoChar_43 : 504|8@1+ (1.0,0.0) [0|255] "ascii" BRAKE_CONTROLLER
CM_ BO_ 263 "Cycle=10ms; Channel=CAN7; CAN-FD; NominalBitrate=500kbit/s; DataBitrate=500kbit/s; PayloadRouteInfo='WHEEL_SPEED_FRONT_LEFT -> BRAKE_CONTROLLER' in bytes 20-63";

BO_ 1543 RESP_007_BRAKE_CONTROLLER_TO_WHEEL_SPEED_FRONT_LEFT: 16 BRAKE_CONTROLLER
 SG_ CRC8 : 0|8@1+ (1,0) [0|255] "" WHEEL_SPEED_FRONT_LEFT
 SG_ ResponseCounter : 8|4@1+ (1,0) [0|15] "" WHEEL_SPEED_FRONT_LEFT
 SG_ AckState : 12|4@1+ (1,0) [0|15] "" WHEEL_SPEED_FRONT_LEFT
 SG_ ReceivedFrameId : 16|11@1+ (1,0) [0|2047] "" WHEEL_SPEED_FRONT_LEFT
 SG_ ReceivedCounter : 27|4@1+ (1,0) [0|15] "" WHEEL_SPEED_FRONT_LEFT
 SG_ ChecksumOk : 31|1@1+ (0,0) [0|1] "" WHEEL_SPEED_FRONT_LEFT
 SG_ PayloadLength : 32|8@1+ (1,0) [0|64] "byte" WHEEL_SPEED_FRONT_LEFT
 SG_ ErrorCode : 40|8@1+ (1,0) [0|255] "" WHEEL_SPEED_FRONT_LEFT
 SG_ ProcessingTimeUs : 48|16@1+ (1,0) [0|65535] "us" WHEEL_SPEED_FRONT_LEFT
 SG_ ResponseSequence : 64|16@1+ (1,0) [0|65535] "" WHEEL_SPEED_FRONT_LEFT
 SG_ ReceivedCrc : 80|8@1+ (1,0) [0|255] "" WHEEL_SPEED_FRONT_LEFT
 SG_ CalculatedCrc : 88|8@1+ (1,0) [0|255] "" WHEEL_SPEED_FRONT_LEFT
CM_ BO_ 1543 "Cycle=10ms; Channel=CAN7; CAN-FD; NominalBitrate=500kbit/s; DataBitrate=500kbit/s; ResponseFor=0x107; ACK/NACK with CRC, DLC and counter check";

BO_ 264 DATA_008_BRAKE_STATUS: 64 BRAKE_CONTROLLER
 SG_ CRC8 : 0|8@1+ (1,0) [0|255] "" ADAS_DOMAIN
 SG_ AliveCounter : 8|4@1+ (1,0) [0|15] "" ADAS_DOMAIN
 SG_ MuxState : 12|4@1+ (1,0) [0|15] "" ADAS_DOMAIN
 SG_ SIG_00 : 16|12@1+ (0.1,0.0) [0|4095] "km/h" ADAS_DOMAIN
 SG_ SIG_01 : 28|12@1+ (0.1,0.0) [0|4095] "rpm" ADAS_DOMAIN
 SG_ SIG_02 : 40|12@1+ (0.1,0.0) [0|4095] "deg" ADAS_DOMAIN
 SG_ SIG_03 : 52|12@1+ (0.1,0.0) [0|4095] "Nm" ADAS_DOMAIN
 SG_ SIG_04 : 64|12@1+ (0.1,0.0) [0|4095] "V" ADAS_DOMAIN
 SG_ SIG_05 : 76|12@1+ (0.1,0.0) [0|4095] "A" ADAS_DOMAIN
 SG_ SIG_06 : 88|12@1+ (0.1,0.0) [0|4095] "%" ADAS_DOMAIN
 SG_ SIG_07 : 100|12@1+ (0.1,0.0) [0|4095] "C" ADAS_DOMAIN
 SG_ SIG_08 : 112|12@1+ (0.1,0.0) [0|4095] "m" ADAS_DOMAIN
 SG_ SIG_09 : 124|12@1+ (0.1,0.0) [0|4095] "obj" ADAS_DOMAIN
 SG_ SIG_10 : 136|12@1+ (0.1,0.0) [0|4095] "km/h" ADAS_DOMAIN
 SG_ SIG_11 : 148|12@1+ (0.1,0.0) [0|4095] "rpm" ADAS_DOMAIN
 SG_ RouteInfoChar_00 : 160|8@1+ (1.0,0.0) [0|255] "ascii" ADAS_DOMAIN
 SG_ RouteInfoChar_01 : 168|8@1+ (1.0,0.0) [0|255] "ascii" ADAS_DOMAIN
 SG_ RouteInfoChar_02 : 176|8@1+ (1.0,0.0) [0|255] "ascii" ADAS_DOMAIN
 SG_ RouteInfoChar_03 : 184|8@1+ (1.0,0.0) [0|255] "ascii" ADAS_DOMAIN
 SG_ RouteInfoChar_04 : 192|8@1+ (1.0,0.0) [0|255] "ascii" ADAS_DOMAIN
 SG_ RouteInfoChar_05 : 200|8@1+ (1.0,0.0) [0|255] "ascii" ADAS_DOMAIN
 SG_ RouteInfoChar_06 : 208|8@1+ (1.0,0.0) [0|255] "ascii" ADAS_DOMAIN
 SG_ RouteInfoChar_07 : 216|8@1+ (1.0,0.0) [0|255] "ascii" ADAS_DOMAIN
 SG_ RouteInfoChar_08 : 224|8@1+ (1.0,0.0) [0|255] "ascii" ADAS_DOMAIN
 SG_ RouteInfoChar_09 : 232|8@1+ (1.0,0.0) [0|255] "ascii" ADAS_DOMAIN
 SG_ RouteInfoChar_10 : 240|8@1+ (1.0,0.0) [0|255] "ascii" ADAS_DOMAIN
 SG_ RouteInfoChar_11 : 248|8@1+ (1.0,0.0) [0|255] "ascii" ADAS_DOMAIN
 SG_ RouteInfoChar_12 : 256|8@1+ (1.0,0.0) [0|255] "ascii" ADAS_DOMAIN
 SG_ RouteInfoChar_13 : 264|8@1+ (1.0,0.0) [0|255] "ascii" ADAS_DOMAIN
 SG_ RouteInfoChar_14 : 272|8@1+ (1.0,0.0) [0|255] "ascii" ADAS_DOMAIN
 SG_ RouteInfoChar_15 : 280|8@1+ (1.0,0.0) [0|255] "ascii" ADAS_DOMAIN
 SG_ RouteInfoChar_16 : 288|8@1+ (1.0,0.0) [0|255] "ascii" ADAS_DOMAIN
 SG_ RouteInfoChar_17 : 296|8@1+ (1.0,0.0) [0|255] "ascii" ADAS_DOMAIN
 SG_ RouteInfoChar_18 : 304|8@1+ (1.0,0.0) [0|255] "ascii" ADAS_DOMAIN
 SG_ RouteInfoChar_19 : 312|8@1+ (1.0,0.0) [0|255] "ascii" ADAS_DOMAIN
 SG_ RouteInfoChar_20 : 320|8@1+ (1.0,0.0) [0|255] "ascii" ADAS_DOMAIN
 SG_ RouteInfoChar_21 : 328|8@1+ (1.0,0.0) [0|255] "ascii" ADAS_DOMAIN
 SG_ RouteInfoChar_22 : 336|8@1+ (1.0,0.0) [0|255] "ascii" ADAS_DOMAIN
 SG_ RouteInfoChar_23 : 344|8@1+ (1.0,0.0) [0|255] "ascii" ADAS_DOMAIN
 SG_ RouteInfoChar_24 : 352|8@1+ (1.0,0.0) [0|255] "ascii" ADAS_DOMAIN
 SG_ RouteInfoChar_25 : 360|8@1+ (1.0,0.0) [0|255] "ascii" ADAS_DOMAIN
 SG_ RouteInfoChar_26 : 368|8@1+ (1.0,0.0) [0|255] "ascii" ADAS_DOMAIN
 SG_ RouteInfoChar_27 : 376|8@1+ (1.0,0.0) [0|255] "ascii" ADAS_DOMAIN
 SG_ RouteInfoChar_28 : 384|8@1+ (1.0,0.0) [0|255] "ascii" ADAS_DOMAIN
 SG_ RouteInfoChar_29 : 392|8@1+ (1.0,0.0) [0|255] "ascii" ADAS_DOMAIN
 SG_ RouteInfoChar_30 : 400|8@1+ (1.0,0.0) [0|255] "ascii" ADAS_DOMAIN
 SG_ RouteInfoChar_31 : 408|8@1+ (1.0,0.0) [0|255] "ascii" ADAS_DOMAIN
 SG_ RouteInfoChar_32 : 416|8@1+ (1.0,0.0) [0|255] "ascii" ADAS_DOMAIN
 SG_ RouteInfoChar_33 : 424|8@1+ (1.0,0.0) [0|255] "ascii" ADAS_DOMAIN
 SG_ RouteInfoChar_34 : 432|8@1+ (1.0,0.0) [0|255] "ascii" ADAS_DOMAIN
 SG_ RouteInfoChar_35 : 440|8@1+ (1.0,0.0) [0|255] "ascii" ADAS_DOMAIN
 SG_ RouteInfoChar_36 : 448|8@1+ (1.0,0.0) [0|255] "ascii" ADAS_DOMAIN
 SG_ RouteInfoChar_37 : 456|8@1+ (1.0,0.0) [0|255] "ascii" ADAS_DOMAIN
 SG_ RouteInfoChar_38 : 464|8@1+ (1.0,0.0) [0|255] "ascii" ADAS_DOMAIN
 SG_ RouteInfoChar_39 : 472|8@1+ (1.0,0.0) [0|255] "ascii" ADAS_DOMAIN
 SG_ RouteInfoChar_40 : 480|8@1+ (1.0,0.0) [0|255] "ascii" ADAS_DOMAIN
 SG_ RouteInfoChar_41 : 488|8@1+ (1.0,0.0) [0|255] "ascii" ADAS_DOMAIN
 SG_ RouteInfoChar_42 : 496|8@1+ (1.0,0.0) [0|255] "ascii" ADAS_DOMAIN
 SG_ RouteInfoChar_43 : 504|8@1+ (1.0,0.0) [0|255] "ascii" ADAS_DOMAIN
CM_ BO_ 264 "Cycle=20ms; Channel=CAN8; CAN-FD; NominalBitrate=500kbit/s; DataBitrate=500kbit/s; PayloadRouteInfo='BRAKE_CONTROLLER -> ADAS_DOMAIN' in bytes 20-63";

BO_ 1544 RESP_008_ADAS_DOMAIN_TO_BRAKE_CONTROLLER: 16 ADAS_DOMAIN
 SG_ CRC8 : 0|8@1+ (1,0) [0|255] "" BRAKE_CONTROLLER
 SG_ ResponseCounter : 8|4@1+ (1,0) [0|15] "" BRAKE_CONTROLLER
 SG_ AckState : 12|4@1+ (1,0) [0|15] "" BRAKE_CONTROLLER
 SG_ ReceivedFrameId : 16|11@1+ (1,0) [0|2047] "" BRAKE_CONTROLLER
 SG_ ReceivedCounter : 27|4@1+ (1,0) [0|15] "" BRAKE_CONTROLLER
 SG_ ChecksumOk : 31|1@1+ (0,0) [0|1] "" BRAKE_CONTROLLER
 SG_ PayloadLength : 32|8@1+ (1,0) [0|64] "byte" BRAKE_CONTROLLER
 SG_ ErrorCode : 40|8@1+ (1,0) [0|255] "" BRAKE_CONTROLLER
 SG_ ProcessingTimeUs : 48|16@1+ (1,0) [0|65535] "us" BRAKE_CONTROLLER
 SG_ ResponseSequence : 64|16@1+ (1,0) [0|65535] "" BRAKE_CONTROLLER
 SG_ ReceivedCrc : 80|8@1+ (1,0) [0|255] "" BRAKE_CONTROLLER
 SG_ CalculatedCrc : 88|8@1+ (1,0) [0|255] "" BRAKE_CONTROLLER
CM_ BO_ 1544 "Cycle=20ms; Channel=CAN8; CAN-FD; NominalBitrate=500kbit/s; DataBitrate=500kbit/s; ResponseFor=0x108; ACK/NACK with CRC, DLC and counter check";

BO_ 265 DATA_009_ADAS_MOTION_REQUEST: 64 ADAS_DOMAIN
 SG_ CRC8 : 0|8@1+ (1,0) [0|255] "" VEHICLE_MOTION_CONTROLLER
 SG_ AliveCounter : 8|4@1+ (1,0) [0|15] "" VEHICLE_MOTION_CONTROLLER
 SG_ MuxState : 12|4@1+ (1,0) [0|15] "" VEHICLE_MOTION_CONTROLLER
 SG_ SIG_00 : 16|12@1+ (0.1,0.0) [0|4095] "km/h" VEHICLE_MOTION_CONTROLLER
 SG_ SIG_01 : 28|12@1+ (0.1,0.0) [0|4095] "rpm" VEHICLE_MOTION_CONTROLLER
 SG_ SIG_02 : 40|12@1+ (0.1,0.0) [0|4095] "deg" VEHICLE_MOTION_CONTROLLER
 SG_ SIG_03 : 52|12@1+ (0.1,0.0) [0|4095] "Nm" VEHICLE_MOTION_CONTROLLER
 SG_ SIG_04 : 64|12@1+ (0.1,0.0) [0|4095] "V" VEHICLE_MOTION_CONTROLLER
 SG_ SIG_05 : 76|12@1+ (0.1,0.0) [0|4095] "A" VEHICLE_MOTION_CONTROLLER
 SG_ SIG_06 : 88|12@1+ (0.1,0.0) [0|4095] "%" VEHICLE_MOTION_CONTROLLER
 SG_ SIG_07 : 100|12@1+ (0.1,0.0) [0|4095] "C" VEHICLE_MOTION_CONTROLLER
 SG_ SIG_08 : 112|12@1+ (0.1,0.0) [0|4095] "m" VEHICLE_MOTION_CONTROLLER
 SG_ SIG_09 : 124|12@1+ (0.1,0.0) [0|4095] "obj" VEHICLE_MOTION_CONTROLLER
 SG_ SIG_10 : 136|12@1+ (0.1,0.0) [0|4095] "km/h" VEHICLE_MOTION_CONTROLLER
 SG_ SIG_11 : 148|12@1+ (0.1,0.0) [0|4095] "rpm" VEHICLE_MOTION_CONTROLLER
 SG_ RouteInfoChar_00 : 160|8@1+ (1.0,0.0) [0|255] "ascii" VEHICLE_MOTION_CONTROLLER
 SG_ RouteInfoChar_01 : 168|8@1+ (1.0,0.0) [0|255] "ascii" VEHICLE_MOTION_CONTROLLER
 SG_ RouteInfoChar_02 : 176|8@1+ (1.0,0.0) [0|255] "ascii" VEHICLE_MOTION_CONTROLLER
 SG_ RouteInfoChar_03 : 184|8@1+ (1.0,0.0) [0|255] "ascii" VEHICLE_MOTION_CONTROLLER
 SG_ RouteInfoChar_04 : 192|8@1+ (1.0,0.0) [0|255] "ascii" VEHICLE_MOTION_CONTROLLER
 SG_ RouteInfoChar_05 : 200|8@1+ (1.0,0.0) [0|255] "ascii" VEHICLE_MOTION_CONTROLLER
 SG_ RouteInfoChar_06 : 208|8@1+ (1.0,0.0) [0|255] "ascii" VEHICLE_MOTION_CONTROLLER
 SG_ RouteInfoChar_07 : 216|8@1+ (1.0,0.0) [0|255] "ascii" VEHICLE_MOTION_CONTROLLER
 SG_ RouteInfoChar_08 : 224|8@1+ (1.0,0.0) [0|255] "ascii" VEHICLE_MOTION_CONTROLLER
 SG_ RouteInfoChar_09 : 232|8@1+ (1.0,0.0) [0|255] "ascii" VEHICLE_MOTION_CONTROLLER
 SG_ RouteInfoChar_10 : 240|8@1+ (1.0,0.0) [0|255] "ascii" VEHICLE_MOTION_CONTROLLER
 SG_ RouteInfoChar_11 : 248|8@1+ (1.0,0.0) [0|255] "ascii" VEHICLE_MOTION_CONTROLLER
 SG_ RouteInfoChar_12 : 256|8@1+ (1.0,0.0) [0|255] "ascii" VEHICLE_MOTION_CONTROLLER
 SG_ RouteInfoChar_13 : 264|8@1+ (1.0,0.0) [0|255] "ascii" VEHICLE_MOTION_CONTROLLER
 SG_ RouteInfoChar_14 : 272|8@1+ (1.0,0.0) [0|255] "ascii" VEHICLE_MOTION_CONTROLLER
 SG_ RouteInfoChar_15 : 280|8@1+ (1.0,0.0) [0|255] "ascii" VEHICLE_MOTION_CONTROLLER
 SG_ RouteInfoChar_16 : 288|8@1+ (1.0,0.0) [0|255] "ascii" VEHICLE_MOTION_CONTROLLER
 SG_ RouteInfoChar_17 : 296|8@1+ (1.0,0.0) [0|255] "ascii" VEHICLE_MOTION_CONTROLLER
 SG_ RouteInfoChar_18 : 304|8@1+ (1.0,0.0) [0|255] "ascii" VEHICLE_MOTION_CONTROLLER
 SG_ RouteInfoChar_19 : 312|8@1+ (1.0,0.0) [0|255] "ascii" VEHICLE_MOTION_CONTROLLER
 SG_ RouteInfoChar_20 : 320|8@1+ (1.0,0.0) [0|255] "ascii" VEHICLE_MOTION_CONTROLLER
 SG_ RouteInfoChar_21 : 328|8@1+ (1.0,0.0) [0|255] "ascii" VEHICLE_MOTION_CONTROLLER
 SG_ RouteInfoChar_22 : 336|8@1+ (1.0,0.0) [0|255] "ascii" VEHICLE_MOTION_CONTROLLER
 SG_ RouteInfoChar_23 : 344|8@1+ (1.0,0.0) [0|255] "ascii" VEHICLE_MOTION_CONTROLLER
 SG_ RouteInfoChar_24 : 352|8@1+ (1.0,0.0) [0|255] "ascii" VEHICLE_MOTION_CONTROLLER
 SG_ RouteInfoChar_25 : 360|8@1+ (1.0,0.0) [0|255] "ascii" VEHICLE_MOTION_CONTROLLER
 SG_ RouteInfoChar_26 : 368|8@1+ (1.0,0.0) [0|255] "ascii" VEHICLE_MOTION_CONTROLLER
 SG_ RouteInfoChar_27 : 376|8@1+ (1.0,0.0) [0|255] "ascii" VEHICLE_MOTION_CONTROLLER
 SG_ RouteInfoChar_28 : 384|8@1+ (1.0,0.0) [0|255] "ascii" VEHICLE_MOTION_CONTROLLER
 SG_ RouteInfoChar_29 : 392|8@1+ (1.0,0.0) [0|255] "ascii" VEHICLE_MOTION_CONTROLLER
 SG_ RouteInfoChar_30 : 400|8@1+ (1.0,0.0) [0|255] "ascii" VEHICLE_MOTION_CONTROLLER
 SG_ RouteInfoChar_31 : 408|8@1+ (1.0,0.0) [0|255] "ascii" VEHICLE_MOTION_CONTROLLER
 SG_ RouteInfoChar_32 : 416|8@1+ (1.0,0.0) [0|255] "ascii" VEHICLE_MOTION_CONTROLLER
 SG_ RouteInfoChar_33 : 424|8@1+ (1.0,0.0) [0|255] "ascii" VEHICLE_MOTION_CONTROLLER
 SG_ RouteInfoChar_34 : 432|8@1+ (1.0,0.0) [0|255] "ascii" VEHICLE_MOTION_CONTROLLER
 SG_ RouteInfoChar_35 : 440|8@1+ (1.0,0.0) [0|255] "ascii" VEHICLE_MOTION_CONTROLLER
 SG_ RouteInfoChar_36 : 448|8@1+ (1.0,0.0) [0|255] "ascii" VEHICLE_MOTION_CONTROLLER
 SG_ RouteInfoChar_37 : 456|8@1+ (1.0,0.0) [0|255] "ascii" VEHICLE_MOTION_CONTROLLER
 SG_ RouteInfoChar_38 : 464|8@1+ (1.0,0.0) [0|255] "ascii" VEHICLE_MOTION_CONTROLLER
 SG_ RouteInfoChar_39 : 472|8@1+ (1.0,0.0) [0|255] "ascii" VEHICLE_MOTION_CONTROLLER
 SG_ RouteInfoChar_40 : 480|8@1+ (1.0,0.0) [0|255] "ascii" VEHICLE_MOTION_CONTROLLER
 SG_ RouteInfoChar_41 : 488|8@1+ (1.0,0.0) [0|255] "ascii" VEHICLE_MOTION_CONTROLLER
 SG_ RouteInfoChar_42 : 496|8@1+ (1.0,0.0) [0|255] "ascii" VEHICLE_MOTION_CONTROLLER
 SG_ RouteInfoChar_43 : 504|8@1+ (1.0,0.0) [0|255] "ascii" VEHICLE_MOTION_CONTROLLER
CM_ BO_ 265 "Cycle=20ms; Channel=CAN9; CAN-FD; NominalBitrate=500kbit/s; DataBitrate=500kbit/s; PayloadRouteInfo='ADAS_DOMAIN -> VEHICLE_MOTION_CONTROLLER' in bytes 20-63";

BO_ 1545 RESP_009_VEHICLE_MOTION_CONTROLLER_TO_ADAS_DOMAIN: 16 VEHICLE_MOTION_CONTROLLER
 SG_ CRC8 : 0|8@1+ (1,0) [0|255] "" ADAS_DOMAIN
 SG_ ResponseCounter : 8|4@1+ (1,0) [0|15] "" ADAS_DOMAIN
 SG_ AckState : 12|4@1+ (1,0) [0|15] "" ADAS_DOMAIN
 SG_ ReceivedFrameId : 16|11@1+ (1,0) [0|2047] "" ADAS_DOMAIN
 SG_ ReceivedCounter : 27|4@1+ (1,0) [0|15] "" ADAS_DOMAIN
 SG_ ChecksumOk : 31|1@1+ (0,0) [0|1] "" ADAS_DOMAIN
 SG_ PayloadLength : 32|8@1+ (1,0) [0|64] "byte" ADAS_DOMAIN
 SG_ ErrorCode : 40|8@1+ (1,0) [0|255] "" ADAS_DOMAIN
 SG_ ProcessingTimeUs : 48|16@1+ (1,0) [0|65535] "us" ADAS_DOMAIN
 SG_ ResponseSequence : 64|16@1+ (1,0) [0|65535] "" ADAS_DOMAIN
 SG_ ReceivedCrc : 80|8@1+ (1,0) [0|255] "" ADAS_DOMAIN
 SG_ CalculatedCrc : 88|8@1+ (1,0) [0|255] "" ADAS_DOMAIN
CM_ BO_ 1545 "Cycle=20ms; Channel=CAN9; CAN-FD; NominalBitrate=500kbit/s; DataBitrate=500kbit/s; ResponseFor=0x109; ACK/NACK with CRC, DLC and counter check";
