AUTOSAR XML (schema 4.0)
package /GeneratedCanSystem
  can cluster GeneratedCanCluster
    20 x can frame, all with can-addressing-mode=STANDARD:
      DATA_000_LIDAR_OBJECT_LIST: identifier=256, frame-length=64
        pdu DATA_000_LIDAR_OBJECT_LIST_PDU: sender=LIDAR_FRONT, receiver=ADAS_DOMAIN
          59 x i signal:
            CRC8: start-position=0, length=8
            AliveCounter: start-position=8, length=4
            MuxState: start-position=12, length=4
            SIG_00: start-position=16, length=12
            SIG_01: start-position=28, length=12
            SIG_02: start-position=40, length=12
            SIG_03: start-position=52, length=12
            SIG_04: start-position=64, length=12
            SIG_05: start-position=76, length=12
            SIG_06: start-position=88, length=12
            SIG_07: start-position=100, length=12
            SIG_08: start-position=112, length=12
            SIG_09: start-position=124, length=12
            SIG_10: start-position=136, length=12
            SIG_11: start-position=148, length=12
            RouteInfoChar_00: start-position=160, length=8
            RouteInfoChar_01: start-position=168, length=8
            RouteInfoChar_02: start-position=176, length=8
            RouteInfoChar_03: start-position=184, length=8
            RouteInfoChar_04: start-position=192, length=8
            RouteInfoChar_05: start-position=200, length=8
            RouteInfoChar_06: start-position=208, length=8
            RouteInfoChar_07: start-position=216, length=8
            RouteInfoChar_08: start-position=224, length=8
            RouteInfoChar_09: start-position=232, length=8
            RouteInfoChar_10: start-position=240, length=8
            RouteInfoChar_11: start-position=248, length=8
            RouteInfoChar_12: start-position=256, length=8
            RouteInfoChar_13: start-position=264, length=8
            RouteInfoChar_14: start-position=272, length=8
            RouteInfoChar_15: start-position=280, length=8
            RouteInfoChar_16: start-position=288, length=8
            RouteInfoChar_17: start-position=296, length=8
            RouteInfoChar_18: start-position=304, length=8
            RouteInfoChar_19: start-position=312, length=8
            RouteInfoChar_20: start-position=320, length=8
            RouteInfoChar_21: start-position=328, length=8
            RouteInfoChar_22: start-position=336, length=8
            RouteInfoChar_23: start-position=344, length=8
            RouteInfoChar_24: start-position=352, length=8
            RouteInfoChar_25: start-position=360, length=8
            RouteInfoChar_26: start-position=368, length=8
            RouteInfoChar_27: start-position=376, length=8
            RouteInfoChar_28: start-position=384, length=8
            RouteInfoChar_29: start-position=392, length=8
            RouteInfoChar_30: start-position=400, length=8
            RouteInfoChar_31: start-position=408, length=8
            RouteInfoChar_32: start-position=416, length=8
            RouteInfoChar_33: start-position=424, length=8
            RouteInfoChar_34: start-position=432, length=8
            RouteInfoChar_35: start-position=440, length=8
            RouteInfoChar_36: start-position=448, length=8
            RouteInfoChar_37: start-position=456, length=8
            RouteInfoChar_38: start-position=464, length=8
            RouteInfoChar_39: start-position=472, length=8
            RouteInfoChar_40: start-position=480, length=8
            RouteInfoChar_41: start-position=488, length=8
            RouteInfoChar_42: start-position=496, length=8
            RouteInfoChar_43: start-position=504, length=8
      RESP_000_ADAS_DOMAIN_TO_LIDAR_FRONT: identifier=1536, frame-length=16
        pdu RESP_000_ADAS_DOMAIN_TO_LIDAR_FRONT_PDU: sender=ADAS_DOMAIN, receiver=LIDAR_FRONT
          12 x i signal:
            CRC8: start-position=0, length=8
            ResponseCounter: start-position=8, length=4
            AckState: start-position=12, length=4
            ReceivedFrameId: start-position=16, length=11
            ReceivedCounter: start-position=27, length=4
            ChecksumOk: start-position=31, length=1
            PayloadLength: start-position=32, length=8
            ErrorCode: start-position=40, length=8
            ProcessingTimeUs: start-position=48, length=16
            ResponseSequence: start-position=64, length=16
            ReceivedCrc: start-position=80, length=8
            CalculatedCrc: start-position=88, length=8
      DATA_001_CAMERA_LANE_MODEL: identifier=257, frame-length=64
        pdu DATA_001_CAMERA_LANE_MODEL_PDU: sender=CAMERA_FRONT_WIDE, receiver=ADAS_DOMAIN
          59 x i signal:
            CRC8: start-position=0, length=8
            AliveCounter: start-position=8, length=4
            MuxState: start-position=12, length=4
            SIG_00: start-position=16, length=12
            SIG_01: start-position=28, length=12
            SIG_02: start-position=40, length=12
            SIG_03: start-position=52, length=12
            SIG_04: start-position=64, length=12
            SIG_05: start-position=76, length=12
            SIG_06: start-position=88, length=12
            SIG_07: start-position=100, length=12
            SIG_08: start-position=112, length=12
            SIG_09: start-position=124, length=12
            SIG_10: start-position=136, length=12
            SIG_11: start-position=148, length=12
            RouteInfoChar_00: start-position=160, length=8
            RouteInfoChar_01: start-position=168, length=8
            RouteInfoChar_02: start-position=176, length=8
            RouteInfoChar_03: start-position=184, length=8
            RouteInfoChar_04: start-position=192, length=8
            RouteInfoChar_05: start-position=200, length=8
            RouteInfoChar_06: start-position=208, length=8
            RouteInfoChar_07: start-position=216, length=8
            RouteInfoChar_08: start-position=224, length=8
            RouteInfoChar_09: start-position=232, length=8
            RouteInfoChar_10: start-position=240, length=8
            RouteInfoChar_11: start-position=248, length=8
            RouteInfoChar_12: start-position=256, length=8
            RouteInfoChar_13: start-position=264, length=8
            RouteInfoChar_14: start-position=272, length=8
            RouteInfoChar_15: start-position=280, length=8
            RouteInfoChar_16: start-position=288, length=8
            RouteInfoChar_17: start-position=296, length=8
            RouteInfoChar_18: start-position=304, length=8
            RouteInfoChar_19: start-position=312, length=8
            RouteInfoChar_20: start-position=320, length=8
            RouteInfoChar_21: start-position=328, length=8
            RouteInfoChar_22: start-position=336, length=8
            RouteInfoChar_23: start-position=344, length=8
            RouteInfoChar_24: start-position=352, length=8
            RouteInfoChar_25: start-position=360, length=8
            RouteInfoChar_26: start-position=368, length=8
            RouteInfoChar_27: start-position=376, length=8
            RouteInfoChar_28: start-position=384, length=8
            RouteInfoChar_29: start-position=392, length=8
            RouteInfoChar_30: start-position=400, length=8
            RouteInfoChar_31: start-position=408, length=8
            RouteInfoChar_32: start-position=416, length=8
            RouteInfoChar_33: start-position=424, length=8
            RouteInfoChar_34: start-position=432, length=8
            RouteInfoChar_35: start-position=440, length=8
            RouteInfoChar_36: start-position=448, length=8
            RouteInfoChar_37: start-position=456, length=8
            RouteInfoChar_38: start-position=464, length=8
            RouteInfoChar_39: start-position=472, length=8
            RouteInfoChar_40: start-position=480, length=8
            RouteInfoChar_41: start-position=488, length=8
            RouteInfoChar_42: start-position=496, length=8
            RouteInfoChar_43: start-position=504, length=8
      RESP_001_ADAS_DOMAIN_TO_CAMERA_FRONT_WIDE: identifier=1537, frame-length=16
        pdu RESP_001_ADAS_DOMAIN_TO_CAMERA_FRONT_WIDE_PDU: sender=ADAS_DOMAIN, receiver=CAMERA_FRONT_WIDE
          12 x i signal:
            CRC8: start-position=0, length=8
            ResponseCounter: start-position=8, length=4
            AckState: start-position=12, length=4
            ReceivedFrameId: start-position=16, length=11
            ReceivedCounter: start-position=27, length=4
            ChecksumOk: start-position=31, length=1
            PayloadLength: start-position=32, length=8
            ErrorCode: start-position=40, length=8
            ProcessingTimeUs: start-position=48, length=16
            ResponseSequence: start-position=64, length=16
            ReceivedCrc: start-position=80, length=8
            CalculatedCrc: start-position=88, length=8
      DATA_002_RADAR_TARGET_LIST: identifier=258, frame-length=64
        pdu DATA_002_RADAR_TARGET_LIST_PDU: sender=RADAR_FRONT_LONG_RANGE, receiver=ADAS_DOMAIN
          59 x i signal:
            CRC8: start-position=0, length=8
            AliveCounter: start-position=8, length=4
            MuxState: start-position=12, length=4
            SIG_00: start-position=16, length=12
            SIG_01: start-position=28, length=12
            SIG_02: start-position=40, length=12
            SIG_03: start-position=52, length=12
            SIG_04: start-position=64, length=12
            SIG_05: start-position=76, length=12
            SIG_06: start-position=88, length=12
            SIG_07: start-position=100, length=12
            SIG_08: start-position=112, length=12
            SIG_09: start-position=124, length=12
            SIG_10: start-position=136, length=12
            SIG_11: start-position=148, length=12
            RouteInfoChar_00: start-position=160, length=8
            RouteInfoChar_01: start-position=168, length=8
            RouteInfoChar_02: start-position=176, length=8
            RouteInfoChar_03: start-position=184, length=8
            RouteInfoChar_04: start-position=192, length=8
            RouteInfoChar_05: start-position=200, length=8
            RouteInfoChar_06: start-position=208, length=8
            RouteInfoChar_07: start-position=216, length=8
            RouteInfoChar_08: start-position=224, length=8
            RouteInfoChar_09: start-position=232, length=8
            RouteInfoChar_10: start-position=240, length=8
            RouteInfoChar_11: start-position=248, length=8
            RouteInfoChar_12: start-position=256, length=8
            RouteInfoChar_13: start-position=264, length=8
            RouteInfoChar_14: start-position=272, length=8
            RouteInfoChar_15: start-position=280, length=8
            RouteInfoChar_16: start-position=288, length=8
            RouteInfoChar_17: start-position=296, length=8
            RouteInfoChar_18: start-position=304, length=8
            RouteInfoChar_19: start-position=312, length=8
            RouteInfoChar_20: start-position=320, length=8
            RouteInfoChar_21: start-position=328, length=8
            RouteInfoChar_22: start-position=336, length=8
            RouteInfoChar_23: start-position=344, length=8
            RouteInfoChar_24: start-position=352, length=8
            RouteInfoChar_25: start-position=360, length=8
            RouteInfoChar_26: start-position=368, length=8
            RouteInfoChar_27: start-position=376, length=8
            RouteInfoChar_28: start-position=384, length=8
            RouteInfoChar_29: start-position=392, length=8
            RouteInfoChar_30: start-position=400, length=8
            RouteInfoChar_31: start-position=408, length=8
            RouteInfoChar_32: start-position=416, length=8
            RouteInfoChar_33: start-position=424, length=8
            RouteInfoChar_34: start-position=432, length=8
            RouteInfoChar_35: start-position=440, length=8
            RouteInfoChar_36: start-position=448, length=8
            RouteInfoChar_37: start-position=456, length=8
            RouteInfoChar_38: start-position=464, length=8
            RouteInfoChar_39: start-position=472, length=8
            RouteInfoChar_40: start-position=480, length=8
            RouteInfoChar_41: start-position=488, length=8
            RouteInfoChar_42: start-position=496, length=8
            RouteInfoChar_43: start-position=504, length=8
      RESP_002_ADAS_DOMAIN_TO_RADAR_FRONT_LONG_RANGE: identifier=1538, frame-length=16
        pdu RESP_002_ADAS_DOMAIN_TO_RADAR_FRONT_LONG_RANGE_PDU: sender=ADAS_DOMAIN, receiver=RADAR_FRONT_LONG_RANGE
          12 x i signal:
            CRC8: start-position=0, length=8
            ResponseCounter: start-position=8, length=4
            AckState: start-position=12, length=4
            ReceivedFrameId: start-position=16, length=11
            ReceivedCounter: start-position=27, length=4
            ChecksumOk: start-position=31, length=1
            PayloadLength: start-position=32, length=8
            ErrorCode: start-position=40, length=8
            ProcessingTimeUs: start-position=48, length=16
            ResponseSequence: start-position=64, length=16
            ReceivedCrc: start-position=80, length=8
            CalculatedCrc: start-position=88, length=8
      DATA_003_REAR_CROSS_TRAFFIC: identifier=259, frame-length=64
        pdu DATA_003_REAR_CROSS_TRAFFIC_PDU: sender=RADAR_REAR_CROSS_TRAFFIC, receiver=ADAS_DOMAIN
          59 x i signal:
            CRC8: start-position=0, length=8
            AliveCounter: start-position=8, length=4
            MuxState: start-position=12, length=4
            SIG_00: start-position=16, length=12
            SIG_01: start-position=28, length=12
            SIG_02: start-position=40, length=12
            SIG_03: start-position=52, length=12
            SIG_04: start-position=64, length=12
            SIG_05: start-position=76, length=12
            SIG_06: start-position=88, length=12
            SIG_07: start-position=100, length=12
            SIG_08: start-position=112, length=12
            SIG_09: start-position=124, length=12
            SIG_10: start-position=136, length=12
            SIG_11: start-position=148, length=12
            RouteInfoChar_00: start-position=160, length=8
            RouteInfoChar_01: start-position=168, length=8
            RouteInfoChar_02: start-position=176, length=8
            RouteInfoChar_03: start-position=184, length=8
            RouteInfoChar_04: start-position=192, length=8
            RouteInfoChar_05: start-position=200, length=8
            RouteInfoChar_06: start-position=208, length=8
            RouteInfoChar_07: start-position=216, length=8
            RouteInfoChar_08: start-position=224, length=8
            RouteInfoChar_09: start-position=232, length=8
            RouteInfoChar_10: start-position=240, length=8
            RouteInfoChar_11: start-position=248, length=8
            RouteInfoChar_12: start-position=256, length=8
            RouteInfoChar_13: start-position=264, length=8
            RouteInfoChar_14: start-position=272, length=8
            RouteInfoChar_15: start-position=280, length=8
            RouteInfoChar_16: start-position=288, length=8
            RouteInfoChar_17: start-position=296, length=8
            RouteInfoChar_18: start-position=304, length=8
            RouteInfoChar_19: start-position=312, length=8
            RouteInfoChar_20: start-position=320, length=8
            RouteInfoChar_21: start-position=328, length=8
            RouteInfoChar_22: start-position=336, length=8
            RouteInfoChar_23: start-position=344, length=8
            RouteInfoChar_24: start-position=352, length=8
            RouteInfoChar_25: start-position=360, length=8
            RouteInfoChar_26: start-position=368, length=8
            RouteInfoChar_27: start-position=376, length=8
            RouteInfoChar_28: start-position=384, length=8
            RouteInfoChar_29: start-position=392, length=8
            RouteInfoChar_30: start-position=400, length=8
            RouteInfoChar_31: start-position=408, length=8
            RouteInfoChar_32: start-position=416, length=8
            RouteInfoChar_33: start-position=424, length=8
            RouteInfoChar_34: start-position=432, length=8
            RouteInfoChar_35: start-position=440, length=8
            RouteInfoChar_36: start-position=448, length=8
            RouteInfoChar_37: start-position=456, length=8
            RouteInfoChar_38: start-position=464, length=8
            RouteInfoChar_39: start-position=472, length=8
            RouteInfoChar_40: start-position=480, length=8
            RouteInfoChar_41: start-position=488, length=8
            RouteInfoChar_42: start-position=496, length=8
            RouteInfoChar_43: start-position=504, length=8
      RESP_003_ADAS_DOMAIN_TO_RADAR_REAR_CROSS_TRAFFIC: identifier=1539, frame-length=16
        pdu RESP_003_ADAS_DOMAIN_TO_RADAR_REAR_CROSS_TRAFFIC_PDU: sender=ADAS_DOMAIN, receiver=RADAR_REAR_CROSS_TRAFFIC
          12 x i signal:
            CRC8: start-position=0, length=8
            ResponseCounter: start-position=8, length=4
            AckState: start-position=12, length=4
            ReceivedFrameId: start-position=16, length=11
            ReceivedCounter: start-position=27, length=4
            ChecksumOk: start-position=31, length=1
            PayloadLength: start-position=32, length=8
            ErrorCode: start-position=40, length=8
            ProcessingTimeUs: start-position=48, length=16
            ResponseSequence: start-position=64, length=16
            ReceivedCrc: start-position=80, length=8
            CalculatedCrc: start-position=88, length=8
      DATA_004_ULTRASONIC_LEFT_DISTANCE: identifier=260, frame-length=64
        pdu DATA_004_ULTRASONIC_LEFT_DISTANCE_PDU: sender=ULTRASONIC_LEFT_CLUSTER, receiver=PARK_ASSIST
          59 x i signal:
            CRC8: start-position=0, length=8
            AliveCounter: start-position=8, length=4
            MuxState: start-position=12, length=4
            SIG_00: start-position=16, length=12
            SIG_01: start-position=28, length=12
            SIG_02: start-position=40, length=12
            SIG_03: start-position=52, length=12
            SIG_04: start-position=64, length=12
            SIG_05: start-position=76, length=12
            SIG_06: start-position=88, length=12
            SIG_07: start-position=100, length=12
            SIG_08: start-position=112, length=12
            SIG_09: start-position=124, length=12
            SIG_10: start-position=136, length=12
            SIG_11: start-position=148, length=12
            RouteInfoChar_00: start-position=160, length=8
            RouteInfoChar_01: start-position=168, length=8
            RouteInfoChar_02: start-position=176, length=8
            RouteInfoChar_03: start-position=184, length=8
            RouteInfoChar_04: start-position=192, length=8
            RouteInfoChar_05: start-position=200, length=8
            RouteInfoChar_06: start-position=208, length=8
            RouteInfoChar_07: start-position=216, length=8
            RouteInfoChar_08: start-position=224, length=8
            RouteInfoChar_09: start-position=232, length=8
            RouteInfoChar_10: start-position=240, length=8
            RouteInfoChar_11: start-position=248, length=8
            RouteInfoChar_12: start-position=256, length=8
            RouteInfoChar_13: start-position=264, length=8
            RouteInfoChar_14: start-position=272, length=8
            RouteInfoChar_15: start-position=280, length=8
            RouteInfoChar_16: start-position=288, length=8
            RouteInfoChar_17: start-position=296, length=8
            RouteInfoChar_18: start-position=304, length=8
            RouteInfoChar_19: start-position=312, length=8
            RouteInfoChar_20: start-position=320, length=8
            RouteInfoChar_21: start-position=328, length=8
            RouteInfoChar_22: start-position=336, length=8
            RouteInfoChar_23: start-position=344, length=8
            RouteInfoChar_24: start-position=352, length=8
            RouteInfoChar_25: start-position=360, length=8
            RouteInfoChar_26: start-position=368, length=8
            RouteInfoChar_27: start-position=376, length=8
            RouteInfoChar_28: start-position=384, length=8
            RouteInfoChar_29: start-position=392, length=8
            RouteInfoChar_30: start-position=400, length=8
            RouteInfoChar_31: start-position=408, length=8
            RouteInfoChar_32: start-position=416, length=8
            RouteInfoChar_33: start-position=424, length=8
            RouteInfoChar_34: start-position=432, length=8
            RouteInfoChar_35: start-position=440, length=8
            RouteInfoChar_36: start-position=448, length=8
            RouteInfoChar_37: start-position=456, length=8
            RouteInfoChar_38: start-position=464, length=8
            RouteInfoChar_39: start-position=472, length=8
            RouteInfoChar_40: start-position=480, length=8
            RouteInfoChar_41: start-position=488, length=8
            RouteInfoChar_42: start-position=496, length=8
            RouteInfoChar_43: start-position=504, length=8
      RESP_004_PARK_ASSIST_TO_ULTRASONIC_LEFT_CLUSTER: identifier=1540, frame-length=16
        pdu RESP_004_PARK_ASSIST_TO_ULTRASONIC_LEFT_CLUSTER_PDU: sender=PARK_ASSIST, receiver=ULTRASONIC_LEFT_CLUSTER
          12 x i signal:
            CRC8: start-position=0, length=8
            ResponseCounter: start-position=8, length=4
            AckState: start-position=12, length=4
            ReceivedFrameId: start-position=16, length=11
            ReceivedCounter: start-position=27, length=4
            ChecksumOk: start-position=31, length=1
            PayloadLength: start-position=32, length=8
            ErrorCode: start-position=40, length=8
            ProcessingTimeUs: start-position=48, length=16
            ResponseSequence: start-position=64, length=16
            ReceivedCrc: start-position=80, length=8
            CalculatedCrc: start-position=88, length=8
      DATA_005_ULTRASONIC_RIGHT_DISTANCE: identifier=261, frame-length=64
        pdu DATA_005_ULTRASONIC_RIGHT_DISTANCE_PDU: sender=ULTRASONIC_RIGHT_CLUSTER, receiver=PARK_ASSIST
          59 x i signal:
            CRC8: start-position=0, length=8
            AliveCounter: start-position=8, length=4
            MuxState: start-position=12, length=4
            SIG_00: start-position=16, length=12
            SIG_01: start-position=28, length=12
            SIG_02: start-position=40, length=12
            SIG_03: start-position=52, length=12
            SIG_04: start-position=64, length=12
            SIG_05: start-position=76, length=12
            SIG_06: start-position=88, length=12
            SIG_07: start-position=100, length=12
            SIG_08: start-position=112, length=12
            SIG_09: start-position=124, length=12
            SIG_10: start-position=136, length=12
            SIG_11: start-position=148, length=12
            RouteInfoChar_00: start-position=160, length=8
            RouteInfoChar_01: start-position=168, length=8
            RouteInfoChar_02: start-position=176, length=8
            RouteInfoChar_03: start-position=184, length=8
            RouteInfoChar_04: start-position=192, length=8
            RouteInfoChar_05: start-position=200, length=8
            RouteInfoChar_06: start-position=208, length=8
            RouteInfoChar_07: start-position=216, length=8
            RouteInfoChar_08: start-position=224, length=8
            RouteInfoChar_09: start-position=232, length=8
            RouteInfoChar_10: start-position=240, length=8
            RouteInfoChar_11: start-position=248, length=8
            RouteInfoChar_12: start-position=256, length=8
            RouteInfoChar_13: start-position=264, length=8
            RouteInfoChar_14: start-position=272, length=8
            RouteInfoChar_15: start-position=280, length=8
            RouteInfoChar_16: start-position=288, length=8
            RouteInfoChar_17: start-position=296, length=8
            RouteInfoChar_18: start-position=304, length=8
            RouteInfoChar_19: start-position=312, length=8
            RouteInfoChar_20: start-position=320, length=8
            RouteInfoChar_21: start-position=328, length=8
            RouteInfoChar_22: start-position=336, length=8
            RouteInfoChar_23: start-position=344, length=8
            RouteInfoChar_24: start-position=352, length=8
            RouteInfoChar_25: start-position=360, length=8
            RouteInfoChar_26: start-position=368, length=8
            RouteInfoChar_27: start-position=376, length=8
            RouteInfoChar_28: start-position=384, length=8
            RouteInfoChar_29: start-position=392, length=8
            RouteInfoChar_30: start-position=400, length=8
            RouteInfoChar_31: start-position=408, length=8
            RouteInfoChar_32: start-position=416, length=8
            RouteInfoChar_33: start-position=424, length=8
            RouteInfoChar_34: start-position=432, length=8
            RouteInfoChar_35: start-position=440, length=8
            RouteInfoChar_36: start-position=448, length=8
            RouteInfoChar_37: start-position=456, length=8
            RouteInfoChar_38: start-position=464, length=8
            RouteInfoChar_39: start-position=472, length=8
            RouteInfoChar_40: start-position=480, length=8
            RouteInfoChar_41: start-position=488, length=8
            RouteInfoChar_42: start-position=496, length=8
            RouteInfoChar_43: start-position=504, length=8
      RESP_005_PARK_ASSIST_TO_ULTRASONIC_RIGHT_CLUSTER: identifier=1541, frame-length=16
        pdu RESP_005_PARK_ASSIST_TO_ULTRASONIC_RIGHT_CLUSTER_PDU: sender=PARK_ASSIST, receiver=ULTRASONIC_RIGHT_CLUSTER
          12 x i signal:
            CRC8: start-position=0, length=8
            ResponseCounter: start-position=8, length=4
            AckState: start-position=12, length=4
            ReceivedFrameId: start-position=16, length=11
            ReceivedCounter: start-position=27, length=4
            ChecksumOk: start-position=31, length=1
            PayloadLength: start-position=32, length=8
            ErrorCode: start-position=40, length=8
            ProcessingTimeUs: start-position=48, length=16
            ResponseSequence: start-position=64, length=16
            ReceivedCrc: start-position=80, length=8
            CalculatedCrc: start-position=88, length=8
      DATA_006_IMU_DYNAMICS: identifier=262, frame-length=64
        pdu DATA_006_IMU_DYNAMICS_PDU: sender=IMU_YAW_RATE_SENSOR, receiver=ADAS_DOMAIN
          59 x i signal:
            CRC8: start-position=0, length=8
            AliveCounter: start-position=8, length=4
            MuxState: start-position=12, length=4
            SIG_00: start-position=16, length=12
            SIG_01: start-position=28, length=12
            SIG_02: start-position=40, length=12
            SIG_03: start-position=52, length=12
            SIG_04: start-position=64, length=12
            SIG_05: start-position=76, length=12
            SIG_06: start-position=88, length=12
            SIG_07: start-position=100, length=12
            SIG_08: start-position=112, length=12
            SIG_09: start-position=124, length=12
            SIG_10: start-position=136, length=12
            SIG_11: start-position=148, length=12
            RouteInfoChar_00: start-position=160, length=8
            RouteInfoChar_01: start-position=168, length=8
            RouteInfoChar_02: start-position=176, length=8
            RouteInfoChar_03: start-position=184, length=8
            RouteInfoChar_04: start-position=192, length=8
            RouteInfoChar_05: start-position=200, length=8
            RouteInfoChar_06: start-position=208, length=8
            RouteInfoChar_07: start-position=216, length=8
            RouteInfoChar_08: start-position=224, length=8
            RouteInfoChar_09: start-position=232, length=8
            RouteInfoChar_10: start-position=240, length=8
            RouteInfoChar_11: start-position=248, length=8
            RouteInfoChar_12: start-position=256, length=8
            RouteInfoChar_13: start-position=264, length=8
            RouteInfoChar_14: start-position=272, length=8
            RouteInfoChar_15: start-position=280, length=8
            RouteInfoChar_16: start-position=288, length=8
            RouteInfoChar_17: start-position=296, length=8
            RouteInfoChar_18: start-position=304, length=8
            RouteInfoChar_19: start-position=312, length=8
            RouteInfoChar_20: start-position=320, length=8
            RouteInfoChar_21: start-position=328, length=8
            RouteInfoChar_22: start-position=336, length=8
            RouteInfoChar_23: start-position=344, length=8
            RouteInfoChar_24: start-position=352, length=8
            RouteInfoChar_25: start-position=360, length=8
            RouteInfoChar_26: start-position=368, length=8
            RouteInfoChar_27: start-position=376, length=8
            RouteInfoChar_28: start-position=384, length=8
            RouteInfoChar_29: start-position=392, length=8
            RouteInfoChar_30: start-position=400, length=8
            RouteInfoChar_31: start-position=408, length=8
            RouteInfoChar_32: start-position=416, length=8
            RouteInfoChar_33: start-position=424, length=8
            RouteInfoChar_34: start-position=432, length=8
            RouteInfoChar_35: start-position=440, length=8
            RouteInfoChar_36: start-position=448, length=8
            RouteInfoChar_37: start-position=456, length=8
            RouteInfoChar_38: start-position=464, length=8
            RouteInfoChar_39: start-position=472, length=8
            RouteInfoChar_40: start-position=480, length=8
            RouteInfoChar_41: start-position=488, length=8
            RouteInfoChar_42: start-position=496, length=8
            RouteInfoChar_43: start-position=504, length=8
      RESP_006_ADAS_DOMAIN_TO_IMU_YAW_RATE_SENSOR: identifier=1542, frame-length=16
        pdu RESP_006_ADAS_DOMAIN_TO_IMU_YAW_RATE_SENSOR_PDU: sender=ADAS_DOMAIN, receiver=IMU_YAW_RATE_SENSOR
          12 x i signal:
            CRC8: start-position=0, length=8
            ResponseCounter: start-position=8, length=4
            AckState: start-position=12, length=4
            ReceivedFrameId: start-position=16, length=11
            ReceivedCounter: start-position=27, length=4
            ChecksumOk: start-position=31, length=1
            PayloadLength: start-position=32, length=8
            ErrorCode: start-position=40, length=8
            ProcessingTimeUs: start-position=48, length=16
            ResponseSequence: start-position=64, length=16
            ReceivedCrc: start-position=80, length=8
            CalculatedCrc: start-position=88, length=8
      DATA_007_WHEEL_SPEED_FL: identifier=263, frame-length=64
        pdu DATA_007_WHEEL_SPEED_FL_PDU: sender=WHEEL_SPEED_FRONT_LEFT, receiver=BRAKE_CONTROLLER
          59 x i signal:
            CRC8: start-position=0, length=8
            AliveCounter: start-position=8, length=4
            MuxState: start-position=12, length=4
            SIG_00: start-position=16, length=12
            SIG_01: start-position=28, length=12
            SIG_02: start-position=40, length=12
            SIG_03: start-position=52, length=12
            SIG_04: start-position=64, length=12
            SIG_05: start-position=76, length=12
            SIG_06: start-position=88, length=12
            SIG_07: start-position=100, length=12
            SIG_08: start-position=112, length=12
            SIG_09: start-position=124, length=12
            SIG_10: start-position=136, length=12
            SIG_11: start-position=148, length=12
            RouteInfoChar_00: start-position=160, length=8
            RouteInfoChar_01: start-position=168, length=8
            RouteInfoChar_02: start-position=176, length=8
            RouteInfoChar_03: start-position=184, length=8
            RouteInfoChar_04: start-position=192, length=8
            RouteInfoChar_05: start-position=200, length=8
            RouteInfoChar_06: start-position=208, length=8
            RouteInfoChar_07: start-position=216, length=8
            RouteInfoChar_08: start-position=224, length=8
            RouteInfoChar_09: start-position=232, length=8
            RouteInfoChar_10: start-position=240, length=8
            RouteInfoChar_11: start-position=248, length=8
            RouteInfoChar_12: start-position=256, length=8
            RouteInfoChar_13: start-position=264, length=8
            RouteInfoChar_14: start-position=272, length=8
            RouteInfoChar_15: start-position=280, length=8
            RouteInfoChar_16: start-position=288, length=8
            RouteInfoChar_17: start-position=296, length=8
            RouteInfoChar_18: start-position=304, length=8
            RouteInfoChar_19: start-position=312, length=8
            RouteInfoChar_20: start-position=320, length=8
            RouteInfoChar_21: start-position=328, length=8
            RouteInfoChar_22: start-position=336, length=8
            RouteInfoChar_23: start-position=344, length=8
            RouteInfoChar_24: start-position=352, length=8
            RouteInfoChar_25: start-position=360, length=8
            RouteInfoChar_26: start-position=368, length=8
            RouteInfoChar_27: start-position=376, length=8
            RouteInfoChar_28: start-position=384, length=8
            RouteInfoChar_29: start-position=392, length=8
            RouteInfoChar_30: start-position=400, length=8
            RouteInfoChar_31: start-position=408, length=8
            RouteInfoChar_32: start-position=416, length=8
            RouteInfoChar_33: start-position=424, length=8
            RouteInfoChar_34: start-position=432, length=8
            RouteInfoChar_35: start-position=440, length=8
            RouteInfoChar_36: start-position=448, length=8
            RouteInfoChar_37: start-position=456, length=8
            RouteInfoChar_38: start-position=464, length=8
            RouteInfoChar_39: start-position=472, length=8
            RouteInfoChar_40: start-position=480, length=8
            RouteInfoChar_41: start-position=488, length=8
            RouteInfoChar_42: start-position=496, length=8
            RouteInfoChar_43: start-position=504, length=8
      RESP_007_BRAKE_CONTROLLER_TO_WHEEL_SPEED_FRONT_LEFT: identifier=1543, frame-length=16
        pdu RESP_007_BRAKE_CONTROLLER_TO_WHEEL_SPEED_FRONT_LEFT_PDU: sender=BRAKE_CONTROLLER, receiver=WHEEL_SPEED_FRONT_LEFT
          12 x i signal:
            CRC8: start-position=0, length=8
            ResponseCounter: start-position=8, length=4
            AckState: start-position=12, length=4
            ReceivedFrameId: start-position=16, length=11
            ReceivedCounter: start-position=27, length=4
            ChecksumOk: start-position=31, length=1
            PayloadLength: start-position=32, length=8
            ErrorCode: start-position=40, length=8
            ProcessingTimeUs: start-position=48, length=16
            ResponseSequence: start-position=64, length=16
            ReceivedCrc: start-position=80, length=8
            CalculatedCrc: start-position=88, length=8
      DATA_008_BRAKE_STATUS: identifier=264, frame-length=64
        pdu DATA_008_BRAKE_STATUS_PDU: sender=BRAKE_CONTROLLER, receiver=ADAS_DOMAIN
          59 x i signal:
            CRC8: start-position=0, length=8
            AliveCounter: start-position=8, length=4
            MuxState: start-position=12, length=4
            SIG_00: start-position=16, length=12
            SIG_01: start-position=28, length=12
            SIG_02: start-position=40, length=12
            SIG_03: start-position=52, length=12
            SIG_04: start-position=64, length=12
            SIG_05: start-position=76, length=12
            SIG_06: start-position=88, length=12
            SIG_07: start-position=100, length=12
            SIG_08: start-position=112, length=12
            SIG_09: start-position=124, length=12
            SIG_10: start-position=136, length=12
            SIG_11: start-position=148, length=12
            RouteInfoChar_00: start-position=160, length=8
            RouteInfoChar_01: start-position=168, length=8
            RouteInfoChar_02: start-position=176, length=8
            RouteInfoChar_03: start-position=184, length=8
            RouteInfoChar_04: start-position=192, length=8
            RouteInfoChar_05: start-position=200, length=8
            RouteInfoChar_06: start-position=208, length=8
            RouteInfoChar_07: start-position=216, length=8
            RouteInfoChar_08: start-position=224, length=8
            RouteInfoChar_09: start-position=232, length=8
            RouteInfoChar_10: start-position=240, length=8
            RouteInfoChar_11: start-position=248, length=8
            RouteInfoChar_12: start-position=256, length=8
            RouteInfoChar_13: start-position=264, length=8
            RouteInfoChar_14: start-position=272, length=8
            RouteInfoChar_15: start-position=280, length=8
            RouteInfoChar_16: start-position=288, length=8
            RouteInfoChar_17: start-position=296, length=8
            RouteInfoChar_18: start-position=304, length=8
            RouteInfoChar_19: start-position=312, length=8
            RouteInfoChar_20: start-position=320, length=8
            RouteInfoChar_21: start-position=328, length=8
            RouteInfoChar_22: start-position=336, length=8
            RouteInfoChar_23: start-position=344, length=8
            RouteInfoChar_24: start-position=352, length=8
            RouteInfoChar_25: start-position=360, length=8
            RouteInfoChar_26: start-position=368, length=8
            RouteInfoChar_27: start-position=376, length=8
            RouteInfoChar_28: start-position=384, length=8
            RouteInfoChar_29: start-position=392, length=8
            RouteInfoChar_30: start-position=400, length=8
            RouteInfoChar_31: start-position=408, length=8
            RouteInfoChar_32: start-position=416, length=8
            RouteInfoChar_33: start-position=424, length=8
            RouteInfoChar_34: start-position=432, length=8
            RouteInfoChar_35: start-position=440, length=8
            RouteInfoChar_36: start-position=448, length=8
            RouteInfoChar_37: start-position=456, length=8
            RouteInfoChar_38: start-position=464, length=8
            RouteInfoChar_39: start-position=472, length=8
            RouteInfoChar_40: start-position=480, length=8
            RouteInfoChar_41: start-position=488, length=8
            RouteInfoChar_42: start-position=496, length=8
            RouteInfoChar_43: start-position=504, length=8
      RESP_008_ADAS_DOMAIN_TO_BRAKE_CONTROLLER: identifier=1544, frame-length=16
        pdu RESP_008_ADAS_DOMAIN_TO_BRAKE_CONTROLLER_PDU: sender=ADAS_DOMAIN, receiver=BRAKE_CONTROLLER
          12 x i signal:
            CRC8: start-position=0, length=8
            ResponseCounter: start-position=8, length=4
            AckState: start-position=12, length=4
            ReceivedFrameId: start-position=16, length=11
            ReceivedCounter: start-position=27, length=4
            ChecksumOk: start-position=31, length=1
            PayloadLength: start-position=32, length=8
            ErrorCode: start-position=40, length=8
            ProcessingTimeUs: start-position=48, length=16
            ResponseSequence: start-position=64, length=16
            ReceivedCrc: start-position=80, length=8
            CalculatedCrc: start-position=88, length=8
      DATA_009_ADAS_MOTION_REQUEST: identifier=265, frame-length=64
        pdu DATA_009_ADAS_MOTION_REQUEST_PDU: sender=ADAS_DOMAIN, receiver=VEHICLE_MOTION_CONTROLLER
          59 x i signal:
            CRC8: start-position=0, length=8
            AliveCounter: start-position=8, length=4
            MuxState: start-position=12, length=4
            SIG_00: start-position=16, length=12
            SIG_01: start-position=28, length=12
            SIG_02: start-position=40, length=12
            SIG_03: start-position=52, length=12
            SIG_04: start-position=64, length=12
            SIG_05: start-position=76, length=12
            SIG_06: start-position=88, length=12
            SIG_07: start-position=100, length=12
            SIG_08: start-position=112, length=12
            SIG_09: start-position=124, length=12
            SIG_10: start-position=136, length=12
            SIG_11: start-position=148, length=12
            RouteInfoChar_00: start-position=160, length=8
            RouteInfoChar_01: start-position=168, length=8
            RouteInfoChar_02: start-position=176, length=8
            RouteInfoChar_03: start-position=184, length=8
            RouteInfoChar_04: start-position=192, length=8
            RouteInfoChar_05: start-position=200, length=8
            RouteInfoChar_06: start-position=208, length=8
            RouteInfoChar_07: start-position=216, length=8
            RouteInfoChar_08: start-position=224, length=8
            RouteInfoChar_09: start-position=232, length=8
            RouteInfoChar_10: start-position=240, length=8
            RouteInfoChar_11: start-position=248, length=8
            RouteInfoChar_12: start-position=256, length=8
            RouteInfoChar_13: start-position=264, length=8
            RouteInfoChar_14: start-position=272, length=8
            RouteInfoChar_15: start-position=280, length=8
            RouteInfoChar_16: start-position=288, length=8
            RouteInfoChar_17: start-position=296, length=8
            RouteInfoChar_18: start-position=304, length=8
            RouteInfoChar_19: start-position=312, length=8
            RouteInfoChar_20: start-position=320, length=8
            RouteInfoChar_21: start-position=328, length=8
            RouteInfoChar_22: start-position=336, length=8
            RouteInfoChar_23: start-position=344, length=8
            RouteInfoChar_24: start-position=352, length=8
            RouteInfoChar_25: start-position=360, length=8
            RouteInfoChar_26: start-position=368, length=8
            RouteInfoChar_27: start-position=376, length=8
            RouteInfoChar_28: start-position=384, length=8
            RouteInfoChar_29: start-position=392, length=8
            RouteInfoChar_30: start-position=400, length=8
            RouteInfoChar_31: start-position=408, length=8
            RouteInfoChar_32: start-position=416, length=8
            RouteInfoChar_33: start-position=424, length=8
            RouteInfoChar_34: start-position=432, length=8
            RouteInfoChar_35: start-position=440, length=8
            RouteInfoChar_36: start-position=448, length=8
            RouteInfoChar_37: start-position=456, length=8
            RouteInfoChar_38: start-position=464, length=8
            RouteInfoChar_39: start-position=472, length=8
            RouteInfoChar_40: start-position=480, length=8
            RouteInfoChar_41: start-position=488, length=8
            RouteInfoChar_42: start-position=496, length=8
            RouteInfoChar_43: start-position=504, length=8
      RESP_009_VEHICLE_MOTION_CONTROLLER_TO_ADAS_DOMAIN: identifier=1545, frame-length=16
        pdu RESP_009_VEHICLE_MOTION_CONTROLLER_TO_ADAS_DOMAIN_PDU: sender=VEHICLE_MOTION_CONTROLLER, receiver=ADAS_DOMAIN
          12 x i signal:
            CRC8: start-position=0, length=8
            ResponseCounter: start-position=8, length=4
            AckState: start-position=12, length=4
            ReceivedFrameId: start-position=16, length=11
            ReceivedCounter: start-position=27, length=4
            ChecksumOk: start-position=31, length=1
            PayloadLength: start-position=32, length=8
            ErrorCode: start-position=40, length=8
            ProcessingTimeUs: start-position=48, length=16
            ResponseSequence: start-position=64, length=16
            ReceivedCrc: start-position=80, length=8
            CalculatedCrc: start-position=88, length=8
