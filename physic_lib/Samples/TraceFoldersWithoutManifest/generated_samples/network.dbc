VERSION "Generated realistic CAN database"

NS_ :

BS_:

BU_: ADAS_DOMAIN CAMERA_FRONT_WIDE LIDAR_FRONT RADAR_FRONT_LONG_RANGE

BO_ 256 DATA_000_LIDAR_FRONT_TO_ADAS_DOMAIN: 64 LIDAR_FRONT
 SG_ CRC8 : 0|8@1+ (1,0) [0|255] "" ADAS_DOMAIN
 SG_ AliveCounter : 8|4@1+ (1,0) [0|15] "" ADAS_DOMAIN
 SG_ MuxState : 12|4@1+ (1,0) [0|15] "" ADAS_DOMAIN
 SG_ SIG_00 : 16|12@1+ (0.1,0.0) [0|4095] "km/h" ADAS_DOMAIN
 SG_ SIG_01 : 28|12@1+ (0.1,0.0) [0|4095] "rpm" ADAS_DOMAIN
 SG_ SIG_02 : 40|12@1+ (0.1,0.0) [0|4095] "deg" ADAS_DOMAIN
 SG_ SIG_03 : 52|12@1+ (0.1,0.0) [0|4095] "Nm" ADAS_DOMAIN
 SG_ SIG_04 : 64|12@1+ (0.1,0.0) [0|4095] "V" ADAS_DOMAIN
 SG_ SIG_05 : 76|12@1+ (0.1,0.0) [0|4095] "A" ADAS_DOMAIN
 SG_ SIG_06 : 88|12@1+ (0.1,0.0) [0|4095] "%" ADAS_DOMAIN
 SG_ SIG_07 : 100|12@1+ (0.1,0.0) [0|4095] "C" ADAS_DOMAIN
 SG_ SIG_08 : 112|12@1+ (0.1,0.0) [0|4095] "m" ADAS_DOMAIN
 SG_ SIG_09 : 124|12@1+ (0.1,0.0) [0|4095] "obj" ADAS_DOMAIN
 SG_ SIG_10 : 136|12@1+ (0.1,0.0) [0|4095] "km/h" ADAS_DOMAIN
 SG_ SIG_11 : 148|12@1+ (0.1,0.0) [0|4095] "rpm" ADAS_DOMAIN
 SG_ RouteInfoChar_00 : 160|8@1+ (1.0,0.0) [0|255] "ascii" ADAS_DOMAIN
 SG_ RouteInfoChar_01 : 168|8@1+ (1.0,0.0) [0|255] "ascii" ADAS_DOMAIN
 SG_ RouteInfoChar_02 : 176|8@1+ (1.0,0.0) [0|255] "ascii" ADAS_DOMAIN
 SG_ RouteInfoChar_03 : 184|8@1+ (1.0,0.0) [0|255] "ascii" ADAS_DOMAIN
 SG_ RouteInfoChar_04 : 192|8@1+ (1.0,0.0) [0|255] "ascii" ADAS_DOMAIN
 SG_ RouteInfoChar_05 : 200|8@1+ (1.0,0.0) [0|255] "ascii" ADAS_DOMAIN
 SG_ RouteInfoChar_06 : 208|8@1+ (1.0,0.0) [0|255] "ascii" ADAS_DOMAIN
 SG_ RouteInfoChar_07 : 216|8@1+ (1.0,0.0) [0|255] "ascii" ADAS_DOMAIN
 SG_ RouteInfoChar_08 : 224|8@1+ (1.0,0.0) [0|255] "ascii" ADAS_DOMAIN
 SG_ RouteInfoChar_09 : 232|8@1+ (1.0,0.0) [0|255] "ascii" ADAS_DOMAIN
 SG_ RouteInfoChar_10 : 240|8@1+ (1.0,0.0) [0|255] "ascii" ADAS_DOMAIN
 SG_ RouteInfoChar_11 : 248|8@1+ (1.0,0.0) [0|255] "ascii" ADAS_DOMAIN
 SG_ RouteInfoChar_12 : 256|8@1+ (1.0,0.0) [0|255] "ascii" ADAS_DOMAIN
 SG_ RouteInfoChar_13 : 264|8@1+ (1.0,0.0) [0|255] "ascii" ADAS_DOMAIN
 SG_ RouteInfoChar_14 : 272|8@1+ (1.0,0.0) [0|255] "ascii" ADAS_DOMAIN
 SG_ RouteInfoChar_15 : 280|8@1+ (1.0,0.0) [0|255] "ascii" ADAS_DOMAIN
 SG_ RouteInfoChar_16 : 288|8@1+ (1.0,0.0) [0|255] "ascii" ADAS_DOMAIN
 SG_ RouteInfoChar_17 : 296|8@1+ (1.0,0.0) [0|255] "ascii" ADAS_DOMAIN
 SG_ RouteInfoChar_18 : 304|8@1+ (1.0,0.0) [0|255] "ascii" ADAS_DOMAIN
 SG_ RouteInfoChar_19 : 312|8@1+ (1.0,0.0) [0|255] "ascii" ADAS_DOMAIN
 SG_ RouteInfoChar_20 : 320|8@1+ (1.0,0.0) [0|255] "ascii" ADAS_DOMAIN
 SG_ RouteInfoChar_21 : 328|8@1+ (1.0,0.0) [0|255] "ascii" ADAS_DOMAIN
 SG_ RouteInfoChar_22 : 336|8@1+ (1.0,0.0) [0|255] "ascii" ADAS_DOMAIN
 SG_ RouteInfoChar_23 : 344|8@1+ (1.0,0.0) [0|255] "ascii" ADAS_DOMAIN
 SG_ RouteInfoChar_24 : 352|8@1+ (1.0,0.0) [0|255] "ascii" ADAS_DOMAIN
 SG_ RouteInfoChar_25 : 360|8@1+ (1.0,0.0) [0|255] "ascii" ADAS_DOMAIN
 SG_ RouteInfoChar_26 : 368|8@1+ (1.0,0.0) [0|255] "ascii" ADAS_DOMAIN
 SG_ RouteInfoChar_27 : 376|8@1+ (1.0,0.0) [0|255] "ascii" ADAS_DOMAIN
 SG_ RouteInfoChar_28 : 384|8@1+ (1.0,0.0) [0|255] "ascii" ADAS_DOMAIN
 SG_ RouteInfoChar_29 : 392|8@1+ (1.0,0.0) [0|255] "ascii" ADAS_DOMAIN
 SG_ RouteInfoChar_30 : 400|8@1+ (1.0,0.0) [0|255] "ascii" ADAS_DOMAIN
 SG_ RouteInfoChar_31 : 408|8@1+ (1.0,0.0) [0|255] "ascii" ADAS_DOMAIN
 SG_ RouteInfoChar_32 : 416|8@1+ (1.0,0.0) [0|255] "ascii" ADAS_DOMAIN
 SG_ RouteInfoChar_33 : 424|8@1+ (1.0,0.0) [0|255] "ascii" ADAS_DOMAIN
 SG_ RouteInfoChar_34 : 432|8@1+ (1.0,0.0) [0|255] "ascii" ADAS_DOMAIN
 SG_ RouteInfoChar_35 : 440|8@1+ (1.0,0.0) [0|255] "ascii" ADAS_DOMAIN
 SG_ RouteInfoChar_36 : 448|8@1+ (1.0,0.0) [0|255] "ascii" ADAS_DOMAIN
 SG_ RouteInfoChar_37 : 456|8@1+ (1.0,0.0) [0|255] "ascii" ADAS_DOMAIN
 SG_ RouteInfoChar_38 : 464|8@1+ (1.0,0.0) [0|255] "ascii" ADAS_DOMAIN
 SG_ RouteInfoChar_39 : 472|8@1+ (1.0,0.0) [0|255] "ascii" ADAS_DOMAIN
 SG_ RouteInfoChar_40 : 480|8@1+ (1.0,0.0) [0|255] "ascii" ADAS_DOMAIN
 SG_ RouteInfoChar_41 : 488|8@1+ (1.0,0.0) [0|255] "ascii" ADAS_DOMAIN
 SG_ RouteInfoChar_42 : 496|8@1+ (1.0,0.0) [0|255] "ascii" ADAS_DOMAIN
 SG_ RouteInfoChar_43 : 504|8@1+ (1.0,0.0) [0|255] "ascii" ADAS_DOMAIN
CM_ BO_ 256 "Cycle=20ms; Channel=CAN0; CAN-FD; NominalBitrate=500kbit/s; DataBitrate=500kbit/s; PayloadRouteInfo='LIDAR_FRONT -> ADAS_DOMAIN' in bytes 20-63; Gateway to CAN1";

BO_ 1536 RESP_000_ADAS_DOMAIN_TO_LIDAR_FRONT: 16 ADAS_DOMAIN
 SG_ CRC8 : 0|8@1+ (1,0) [0|255] "" LIDAR_FRONT
 SG_ ResponseCounter : 8|4@1+ (1,0) [0|15] "" LIDAR_FRONT
 SG_ AckState : 12|4@1+ (1,0) [0|15] "" LIDAR_FRONT
 SG_ ReceivedFrameId : 16|11@1+ (1,0) [0|2047] "" LIDAR_FRONT
 SG_ ReceivedCounter : 27|4@1+ (1,0) [0|15] "" LIDAR_FRONT
 SG_ ChecksumOk : 31|1@1+ (0,0) [0|1] "" LIDAR_FRONT
 SG_ PayloadLength : 32|8@1+ (1,0) [0|64] "byte" LIDAR_FRONT
 SG_ ErrorCode : 40|8@1+ (1,0) [0|255] "" LIDAR_FRONT
 SG_ ProcessingTimeUs : 48|16@1+ (1,0) [0|65535] "us" LIDAR_FRONT
 SG_ ResponseSequence : 64|16@1+ (1,0) [0|65535] "" LIDAR_FRONT
 SG_ ReceivedCrc : 80|8@1+ (1,0) [0|255] "" LIDAR_FRONT
 SG_ CalculatedCrc : 88|8@1+ (1,0) [0|255] "" LIDAR_FRONT
CM_ BO_ 1536 "Cycle=20ms; Channel=CAN0; CAN-FD; NominalBitrate=500kbit/s; DataBitrate=500kbit/s; ResponseFor=0x100; ACK/NACK with CRC, DLC and counter check";

BO_ 257 DATA_001_CAMERA_FRONT_WIDE_TO_ADAS_DOMAIN: 64 CAMERA_FRONT_WIDE
 SG_ CRC8 : 0|8@1+ (1,0) [0|255] "" ADAS_DOMAIN
 SG_ AliveCounter : 8|4@1+ (1,0) [0|15] "" ADAS_DOMAIN
 SG_ MuxState : 12|4@1+ (1,0) [0|15] "" ADAS_DOMAIN
 SG_ SIG_00 : 16|12@1+ (0.1,0.0) [0|4095] "km/h" ADAS_DOMAIN
 SG_ SIG_01 : 28|12@1+ (0.1,0.0) [0|4095] "rpm" ADAS_DOMAIN
 SG_ SIG_02 : 40|12@1+ (0.1,0.0) [0|4095] "deg" ADAS_DOMAIN
 SG_ SIG_03 : 52|12@1+ (0.1,0.0) [0|4095] "Nm" ADAS_DOMAIN
 SG_ SIG_04 : 64|12@1+ (0.1,0.0) [0|4095] "V" ADAS_DOMAIN
 SG_ SIG_05 : 76|12@1+ (0.1,0.0) [0|4095] "A" ADAS_DOMAIN
 SG_ SIG_06 : 88|12@1+ (0.1,0.0) [0|4095] "%" ADAS_DOMAIN
 SG_ SIG_07 : 100|12@1+ (0.1,0.0) [0|4095] "C" ADAS_DOMAIN
 SG_ SIG_08 : 112|12@1+ (0.1,0.0) [0|4095] "m" ADAS_DOMAIN
 SG_ SIG_09 : 124|12@1+ (0.1,0.0) [0|4095] "obj" ADAS_DOMAIN
 SG_ SIG_10 : 136|12@1+ (0.1,0.0) [0|4095] "km/h" ADAS_DOMAIN
 SG_ SIG_11 : 148|12@1+ (0.1,0.0) [0|4095] "rpm" ADAS_DOMAIN
 SG_ RouteInfoChar_00 : 160|8@1+ (1.0,0.0) [0|255] "ascii" ADAS_DOMAIN
 SG_ RouteInfoChar_01 : 168|8@1+ (1.0,0.0) [0|255] "ascii" ADAS_DOMAIN
 SG_ RouteInfoChar_02 : 176|8@1+ (1.0,0.0) [0|255] "ascii" ADAS_DOMAIN
 SG_ RouteInfoChar_03 : 184|8@1+ (1.0,0.0) [0|255] "ascii" ADAS_DOMAIN
 SG_ RouteInfoChar_04 : 192|8@1+ (1.0,0.0) [0|255] "ascii" ADAS_DOMAIN
 SG_ RouteInfoChar_05 : 200|8@1+ (1.0,0.0) [0|255] "ascii" ADAS_DOMAIN
 SG_ RouteInfoChar_06 : 208|8@1+ (1.0,0.0) [0|255] "ascii" ADAS_DOMAIN
 SG_ RouteInfoChar_07 : 216|8@1+ (1.0,0.0) [0|255] "ascii" ADAS_DOMAIN
 SG_ RouteInfoChar_08 : 224|8@1+ (1.0,0.0) [0|255] "ascii" ADAS_DOMAIN
 SG_ RouteInfoChar_09 : 232|8@1+ (1.0,0.0) [0|255] "ascii" ADAS_DOMAIN
 SG_ RouteInfoChar_10 : 240|8@1+ (1.0,0.0) [0|255] "ascii" ADAS_DOMAIN
 SG_ RouteInfoChar_11 : 248|8@1+ (1.0,0.0) [0|255] "ascii" ADAS_DOMAIN
 SG_ RouteInfoChar_12 : 256|8@1+ (1.0,0.0) [0|255] "ascii" ADAS_DOMAIN
 SG_ RouteInfoChar_13 : 264|8@1+ (1.0,0.0) [0|255] "ascii" ADAS_DOMAIN
 SG_ RouteInfoChar_14 : 272|8@1+ (1.0,0.0) [0|255] "ascii" ADAS_DOMAIN
 SG_ RouteInfoChar_15 : 280|8@1+ (1.0,0.0) [0|255] "ascii" ADAS_DOMAIN
 SG_ RouteInfoChar_16 : 288|8@1+ (1.0,0.0) [0|255] "ascii" ADAS_DOMAIN
 SG_ RouteInfoChar_17 : 296|8@1+ (1.0,0.0) [0|255] "ascii" ADAS_DOMAIN
 SG_ RouteInfoChar_18 : 304|8@1+ (1.0,0.0) [0|255] "ascii" ADAS_DOMAIN
 SG_ RouteInfoChar_19 : 312|8@1+ (1.0,0.0) [0|255] "ascii" ADAS_DOMAIN
 SG_ RouteInfoChar_20 : 320|8@1+ (1.0,0.0) [0|255] "ascii" ADAS_DOMAIN
 SG_ RouteInfoChar_21 : 328|8@1+ (1.0,0.0) [0|255] "ascii" ADAS_DOMAIN
 SG_ RouteInfoChar_22 : 336|8@1+ (1.0,0.0) [0|255] "ascii" ADAS_DOMAIN
 SG_ RouteInfoChar_23 : 344|8@1+ (1.0,0.0) [0|255] "ascii" ADAS_DOMAIN
 SG_ RouteInfoChar_24 : 352|8@1+ (1.0,0.0) [0|255] "ascii" ADAS_DOMAIN
 SG_ RouteInfoChar_25 : 360|8@1+ (1.0,0.0) [0|255] "ascii" ADAS_DOMAIN
 SG_ RouteInfoChar_26 : 368|8@1+ (1.0,0.0) [0|255] "ascii" ADAS_DOMAIN
 SG_ RouteInfoChar_27 : 376|8@1+ (1.0,0.0) [0|255] "ascii" ADAS_DOMAIN
 SG_ RouteInfoChar_28 : 384|8@1+ (1.0,0.0) [0|255] "ascii" ADAS_DOMAIN
 SG_ RouteInfoChar_29 : 392|8@1+ (1.0,0.0) [0|255] "ascii" ADAS_DOMAIN
 SG_ RouteInfoChar_30 : 400|8@1+ (1.0,0.0) [0|255] "ascii" ADAS_DOMAIN
 SG_ RouteInfoChar_31 : 408|8@1+ (1.0,0.0) [0|255] "ascii" ADAS_DOMAIN
 SG_ RouteInfoChar_32 : 416|8@1+ (1.0,0.0) [0|255] "ascii" ADAS_DOMAIN
 SG_ RouteInfoChar_33 : 424|8@1+ (1.0,0.0) [0|255] "ascii" ADAS_DOMAIN
 SG_ RouteInfoChar_34 : 432|8@1+ (1.0,0.0) [0|255] "ascii" ADAS_DOMAIN
 SG_ RouteInfoChar_35 : 440|8@1+ (1.0,0.0) [0|255] "ascii" ADAS_DOMAIN
 SG_ RouteInfoChar_36 : 448|8@1+ (1.0,0.0) [0|255] "ascii" ADAS_DOMAIN
 SG_ RouteInfoChar_37 : 456|8@1+ (1.0,0.0) [0|255] "ascii" ADAS_DOMAIN
 SG_ RouteInfoChar_38 : 464|8@1+ (1.0,0.0) [0|255] "ascii" ADAS_DOMAIN
 SG_ RouteInfoChar_39 : 472|8@1+ (1.0,0.0) [0|255] "ascii" ADAS_DOMAIN
 SG_ RouteInfoChar_40 : 480|8@1+ (1.0,0.0) [0|255] "ascii" ADAS_DOMAIN
 SG_ RouteInfoChar_41 : 488|8@1+ (1.0,0.0) [0|255] "ascii" ADAS_DOMAIN
 SG_ RouteInfoChar_42 : 496|8@1+ (1.0,0.0) [0|255] "ascii" ADAS_DOMAIN
 SG_ RouteInfoChar_43 : 504|8@1+ (1.0,0.0) [0|255] "ascii" ADAS_DOMAIN
CM_ BO_ 257 "Cycle=33ms; Channel=CAN1; CAN-FD; NominalBitrate=500kbit/s; DataBitrate=500kbit/s; PayloadRouteInfo='CAMERA_FRONT_WIDE -> ADAS_DOMAIN' in bytes 20-63";

BO_ 1537 RESP_001_ADAS_DOMAIN_TO_CAMERA_FRONT_WIDE: 16 ADAS_DOMAIN
 SG_ CRC8 : 0|8@1+ (1,0) [0|255] "" CAMERA_FRONT_WIDE
 SG_ ResponseCounter : 8|4@1+ (1,0) [0|15] "" CAMERA_FRONT_WIDE
 SG_ AckState : 12|4@1+ (1,0) [0|15] "" CAMERA_FRONT_WIDE
 SG_ ReceivedFrameId : 16|11@1+ (1,0) [0|2047] "" CAMERA_FRONT_WIDE
 SG_ ReceivedCounter : 27|4@1+ (1,0) [0|15] "" CAMERA_FRONT_WIDE
 SG_ ChecksumOk : 31|1@1+ (0,0) [0|1] "" CAMERA_FRONT_WIDE
 SG_ PayloadLength : 32|8@1+ (1,0) [0|64] "byte" CAMERA_FRONT_WIDE
 SG_ ErrorCode : 40|8@1+ (1,0) [0|255] "" CAMERA_FRONT_WIDE
 SG_ ProcessingTimeUs : 48|16@1+ (1,0) [0|65535] "us" CAMERA_FRONT_WIDE
 SG_ ResponseSequence : 64|16@1+ (1,0) [0|65535] "" CAMERA_FRONT_WIDE
 SG_ ReceivedCrc : 80|8@1+ (1,0) [0|255] "" CAMERA_FRONT_WIDE
 SG_ CalculatedCrc : 88|8@1+ (1,0) [0|255] "" CAMERA_FRONT_WIDE
CM_ BO_ 1537 "Cycle=33ms; Channel=CAN1; CAN-FD; NominalBitrate=500kbit/s; DataBitrate=500kbit/s; ResponseFor=0x101; ACK/NACK with CRC, DLC and counter check";

BO_ 258 DATA_002_RADAR_FRONT_LONG_RANGE_TO_ADAS_DOMAIN: 64 RADAR_FRONT_LONG_RANGE
 SG_ CRC8 : 0|8@1+ (1,0) [0|255] "" ADAS_DOMAIN
 SG_ AliveCounter : 8|4@1+ (1,0) [0|15] "" ADAS_DOMAIN
 SG_ MuxState : 12|4@1+ (1,0) [0|15] "" ADAS_DOMAIN
 SG_ SIG_00 : 16|12@1+ (0.1,0.0) [0|4095] "km/h" ADAS_DOMAIN
 SG_ SIG_01 : 28|12@1+ (0.1,0.0) [0|4095] "rpm" ADAS_DOMAIN
 SG_ SIG_02 : 40|12@1+ (0.1,0.0) [0|4095] "deg" ADAS_DOMAIN
 SG_ SIG_03 : 52|12@1+ (0.1,0.0) [0|4095] "Nm" ADAS_DOMAIN
 SG_ SIG_04 : 64|12@1+ (0.1,0.0) [0|4095] "V" ADAS_DOMAIN
 SG_ SIG_05 : 76|12@1+ (0.1,0.0) [0|4095] "A" ADAS_DOMAIN
 SG_ SIG_06 : 88|12@1+ (0.1,0.0) [0|4095] "%" ADAS_DOMAIN
 SG_ SIG_07 : 100|12@1+ (0.1,0.0) [0|4095] "C" ADAS_DOMAIN
 SG_ SIG_08 : 112|12@1+ (0.1,0.0) [0|4095] "m" ADAS_DOMAIN
 SG_ SIG_09 : 124|12@1+ (0.1,0.0) [0|4095] "obj" ADAS_DOMAIN
 SG_ SIG_10 : 136|12@1+ (0.1,0.0) [0|4095] "km/h" ADAS_DOMAIN
 SG_ SIG_11 : 148|12@1+ (0.1,0.0) [0|4095] "rpm" ADAS_DOMAIN
 SG_ RouteInfoChar_00 : 160|8@1+ (1.0,0.0) [0|255] "ascii" ADAS_DOMAIN
 SG_ RouteInfoChar_01 : 168|8@1+ (1.0,0.0) [0|255] "ascii" ADAS_DOMAIN
 SG_ RouteInfoChar_02 : 176|8@1+ (1.0,0.0) [0|255] "ascii" ADAS_DOMAIN
 SG_ RouteInfoChar_03 : 184|8@1+ (1.0,0.0) [0|255] "ascii" ADAS_DOMAIN
 SG_ RouteInfoChar_04 : 192|8@1+ (1.0,0.0) [0|255] "ascii" ADAS_DOMAIN
 SG_ RouteInfoChar_05 : 200|8@1+ (1.0,0.0) [0|255] "ascii" ADAS_DOMAIN
 SG_ RouteInfoChar_06 : 208|8@1+ (1.0,0.0) [0|255] "ascii" ADAS_DOMAIN
 SG_ RouteInfoChar_07 : 216|8@1+ (1.0,0.0) [0|255] "ascii" ADAS_DOMAIN
 SG_ RouteInfoChar_08 : 224|8@1+ (1.0,0.0) [0|255] "ascii" ADAS_DOMAIN
 SG_ RouteInfoChar_09 : 232|8@1+ (1.0,0.0) [0|255] "ascii" ADAS_DOMAIN
 SG_ RouteInfoChar_10 : 240|8@1+ (1.0,0.0) [0|255] "ascii" ADAS_DOMAIN
 SG_ RouteInfoChar_11 : 248|8@1+ (1.0,0.0) [0|255] "ascii" ADAS_DOMAIN
 SG_ RouteInfoChar_12 : 256|8@1+ (1.0,0.0) [0|255] "ascii" ADAS_DOMAIN
 SG_ RouteInfoChar_13 : 264|8@1+ (1.0,0.0) [0|255] "ascii" ADAS_DOMAIN
 SG_ RouteInfoChar_14 : 272|8@1+ (1.0,0.0) [0|255] "ascii" ADAS_DOMAIN
 SG_ RouteInfoChar_15 : 280|8@1+ (1.0,0.0) [0|255] "ascii" ADAS_DOMAIN
 SG_ RouteInfoChar_16 : 288|8@1+ (1.0,0.0) [0|255] "ascii" ADAS_DOMAIN
 SG_ RouteInfoChar_17 : 296|8@1+ (1.0,0.0) [0|255] "ascii" ADAS_DOMAIN
 SG_ RouteInfoChar_18 : 304|8@1+ (1.0,0.0) [0|255] "ascii" ADAS_DOMAIN
 SG_ RouteInfoChar_19 : 312|8@1+ (1.0,0.0) [0|255] "ascii" ADAS_DOMAIN
 SG_ RouteInfoChar_20 : 320|8@1+ (1.0,0.0) [0|255] "ascii" ADAS_DOMAIN
 SG_ RouteInfoChar_21 : 328|8@1+ (1.0,0.0) [0|255] "ascii" ADAS_DOMAIN
 SG_ RouteInfoChar_22 : 336|8@1+ (1.0,0.0) [0|255] "ascii" ADAS_DOMAIN
 SG_ RouteInfoChar_23 : 344|8@1+ (1.0,0.0) [0|255] "ascii" ADAS_DOMAIN
 SG_ RouteInfoChar_24 : 352|8@1+ (1.0,0.0) [0|255] "ascii" ADAS_DOMAIN
 SG_ RouteInfoChar_25 : 360|8@1+ (1.0,0.0) [0|255] "ascii" ADAS_DOMAIN
 SG_ RouteInfoChar_26 : 368|8@1+ (1.0,0.0) [0|255] "ascii" ADAS_DOMAIN
 SG_ RouteInfoChar_27 : 376|8@1+ (1.0,0.0) [0|255] "ascii" ADAS_DOMAIN
 SG_ RouteInfoChar_28 : 384|8@1+ (1.0,0.0) [0|255] "ascii" ADAS_DOMAIN
 SG_ RouteInfoChar_29 : 392|8@1+ (1.0,0.0) [0|255] "ascii" ADAS_DOMAIN
 SG_ RouteInfoChar_30 : 400|8@1+ (1.0,0.0) [0|255] "ascii" ADAS_DOMAIN
 SG_ RouteInfoChar_31 : 408|8@1+ (1.0,0.0) [0|255] "ascii" ADAS_DOMAIN
 SG_ RouteInfoChar_32 : 416|8@1+ (1.0,0.0) [0|255] "ascii" ADAS_DOMAIN
 SG_ RouteInfoChar_33 : 424|8@1+ (1.0,0.0) [0|255] "ascii" ADAS_DOMAIN
 SG_ RouteInfoChar_34 : 432|8@1+ (1.0,0.0) [0|255] "ascii" ADAS_DOMAIN
 SG_ RouteInfoChar_35 : 440|8@1+ (1.0,0.0) [0|255] "ascii" ADAS_DOMAIN
 SG_ RouteInfoChar_36 : 448|8@1+ (1.0,0.0) [0|255] "ascii" ADAS_DOMAIN
 SG_ RouteInfoChar_37 : 456|8@1+ (1.0,0.0) [0|255] "ascii" ADAS_DOMAIN
 SG_ RouteInfoChar_38 : 464|8@1+ (1.0,0.0) [0|255] "ascii" ADAS_DOMAIN
 SG_ RouteInfoChar_39 : 472|8@1+ (1.0,0.0) [0|255] "ascii" ADAS_DOMAIN
 SG_ RouteInfoChar_40 : 480|8@1+ (1.0,0.0) [0|255] "ascii" ADAS_DOMAIN
 SG_ RouteInfoChar_41 : 488|8@1+ (1.0,0.0) [0|255] "ascii" ADAS_DOMAIN
 SG_ RouteInfoChar_42 : 496|8@1+ (1.0,0.0) [0|255] "ascii" ADAS_DOMAIN
 SG_ RouteInfoChar_43 : 504|8@1+ (1.0,0.0) [0|255] "ascii" ADAS_DOMAIN
CM_ BO_ 258 "Cycle=20ms; Channel=CAN2; CAN-FD; NominalBitrate=500kbit/s; DataBitrate=500kbit/s; PayloadRouteInfo='RADAR_FRONT_LONG_RANGE -> ADAS_DOMAIN' in bytes 20-63";

BO_ 1538 RESP_002_ADAS_DOMAIN_TO_RADAR_FRONT_LONG_RANGE: 16 ADAS_DOMAIN
 SG_ CRC8 : 0|8@1+ (1,0) [0|255] "" RADAR_FRONT_LONG_RANGE
 SG_ ResponseCounter : 8|4@1+ (1,0) [0|15] "" RADAR_FRONT_LONG_RANGE
 SG_ AckState : 12|4@1+ (1,0) [0|15] "" RADAR_FRONT_LONG_RANGE
 SG_ ReceivedFrameId : 16|11@1+ (1,0) [0|2047] "" RADAR_FRONT_LONG_RANGE
 SG_ ReceivedCounter : 27|4@1+ (1,0) [0|15] "" RADAR_FRONT_LONG_RANGE
 SG_ ChecksumOk : 31|1@1+ (0,0) [0|1] "" RADAR_FRONT_LONG_RANGE
 SG_ PayloadLength : 32|8@1+ (1,0) [0|64] "byte" RADAR_FRONT_LONG_RANGE
 SG_ ErrorCode : 40|8@1+ (1,0) [0|255] "" RADAR_FRONT_LONG_RANGE
 SG_ ProcessingTimeUs : 48|16@1+ (1,0) [0|65535] "us" RADAR_FRONT_LONG_RANGE
 SG_ ResponseSequence : 64|16@1+ (1,0) [0|65535] "" RADAR_FRONT_LONG_RANGE
 SG_ ReceivedCrc : 80|8@1+ (1,0) [0|255] "" RADAR_FRONT_LONG_RANGE
 SG_ CalculatedCrc : 88|8@1+ (1,0) [0|255] "" RADAR_FRONT_LONG_RANGE
CM_ BO_ 1538 "Cycle=20ms; Channel=CAN2; CAN-FD; NominalBitrate=500kbit/s; DataBitrate=500kbit/s; ResponseFor=0x102; ACK/NACK with CRC, DLC and counter check";
