VERSION "Realistic CAN Trace Generator"

NS_ :

BS_:

BU_: ADAS_DOMAIN ADAS_ECU_TEMP_SENSOR AMBIENT_TEMP_SENSOR BRAKE_CONTROLLER CAMERA_FRONT_WIDE CENTRAL_GATEWAY DIAG_TESTER IMU_YAW_RATE_SENSOR LIDAR_FRONT RADAR_FRONT_LONG_RANGE RADAR_REAR_CORNER_LEFT STEERING_CONTROLLER

BO_ 384 DATA_000_ADAS_DOMAIN_TRAJECTORY_PLAN_TO_STEERING_CONTROLLER: 64 ADAS_DOMAIN
 SG_ CRC8 : 0|8@1+ (1,0) [0|255] "" STEERING_CONTROLLER
 SG_ AliveCounter : 8|4@1+ (1,0) [0|15] "" STEERING_CONTROLLER
 SG_ MuxState : 12|4@1+ (1,0) [0|15] "" STEERING_CONTROLLER
 SG_ SIG_180_00 : 16|12@1+ (0.1,0.0) [0|4095] "rpm" STEERING_CONTROLLER
 SG_ SIG_180_01 : 28|12@1+ (0.1,0.0) [0|4095] "km/h" STEERING_CONTROLLER
 SG_ SIG_180_02 : 40|12@1+ (0.1,0.0) [0|4095] "V" STEERING_CONTROLLER
 SG_ SIG_180_03 : 52|12@1+ (0.1,0.0) [0|4095] "Nm" STEERING_CONTROLLER
 SG_ SIG_180_04 : 64|12@1+ (0.1,0.0) [0|4095] "Nm" STEERING_CONTROLLER
 SG_ SIG_180_05 : 76|12@1+ (0.1,0.0) [0|4095] "deg" STEERING_CONTROLLER
 SG_ SIG_180_06 : 88|12@1+ (0.1,0.0) [0|4095] "rpm" STEERING_CONTROLLER
 SG_ SIG_180_07 : 100|12@1+ (0.1,0.0) [0|4095] "m" STEERING_CONTROLLER
 SG_ SIG_180_08 : 112|12@1+ (0.1,0.0) [0|4095] "rpm" STEERING_CONTROLLER
 SG_ SIG_180_09 : 124|12@1+ (0.1,0.0) [0|4095] "obj" STEERING_CONTROLLER
 SG_ SIG_180_10 : 136|12@1+ (0.1,0.0) [0|4095] "%" STEERING_CONTROLLER
 SG_ SIG_180_11 : 148|12@1+ (0.1,0.0) [0|4095] "km/h" STEERING_CONTROLLER
 SG_ RouteInfoChar_00 : 160|8@1+ (1,0) [0|255] "ascii" STEERING_CONTROLLER
 SG_ RouteInfoChar_01 : 168|8@1+ (1,0) [0|255] "ascii" STEERING_CONTROLLER
 SG_ RouteInfoChar_02 : 176|8@1+ (1,0) [0|255] "ascii" STEERING_CONTROLLER
 SG_ RouteInfoChar_03 : 184|8@1+ (1,0) [0|255] "ascii" STEERING_CONTROLLER
 SG_ RouteInfoChar_04 : 192|8@1+ (1,0) [0|255] "ascii" STEERING_CONTROLLER
 SG_ RouteInfoChar_05 : 200|8@1+ (1,0) [0|255] "ascii" STEERING_CONTROLLER
 SG_ RouteInfoChar_06 : 208|8@1+ (1,0) [0|255] "ascii" STEERING_CONTROLLER
 SG_ RouteInfoChar_07 : 216|8@1+ (1,0) [0|255] "ascii" STEERING_CONTROLLER
 SG_ RouteInfoChar_08 : 224|8@1+ (1,0) [0|255] "ascii" STEERING_CONTROLLER
 SG_ RouteInfoChar_09 : 232|8@1+ (1,0) [0|255] "ascii" STEERING_CONTROLLER
 SG_ RouteInfoChar_10 : 240|8@1+ (1,0) [0|255] "ascii" STEERING_CONTROLLER
 SG_ RouteInfoChar_11 : 248|8@1+ (1,0) [0|255] "ascii" STEERING_CONTROLLER
 SG_ RouteInfoChar_12 : 256|8@1+ (1,0) [0|255] "ascii" STEERING_CONTROLLER
 SG_ RouteInfoChar_13 : 264|8@1+ (1,0) [0|255] "ascii" STEERING_CONTROLLER
 SG_ RouteInfoChar_14 : 272|8@1+ (1,0) [0|255] "ascii" STEERING_CONTROLLER
 SG_ RouteInfoChar_15 : 280|8@1+ (1,0) [0|255] "ascii" STEERING_CONTROLLER
 SG_ RouteInfoChar_16 : 288|8@1+ (1,0) [0|255] "ascii" STEERING_CONTROLLER
 SG_ RouteInfoChar_17 : 296|8@1+ (1,0) [0|255] "ascii" STEERING_CONTROLLER
 SG_ RouteInfoChar_18 : 304|8@1+ (1,0) [0|255] "ascii" STEERING_CONTROLLER
 SG_ RouteInfoChar_19 : 312|8@1+ (1,0) [0|255] "ascii" STEERING_CONTROLLER
 SG_ RouteInfoChar_20 : 320|8@1+ (1,0) [0|255] "ascii" STEERING_CONTROLLER
 SG_ RouteInfoChar_21 : 328|8@1+ (1,0) [0|255] "ascii" STEERING_CONTROLLER
 SG_ RouteInfoChar_22 : 336|8@1+ (1,0) [0|255] "ascii" STEERING_CONTROLLER
 SG_ RouteInfoChar_23 : 344|8@1+ (1,0) [0|255] "ascii" STEERING_CONTROLLER
 SG_ RouteInfoChar_24 : 352|8@1+ (1,0) [0|255] "ascii" STEERING_CONTROLLER
 SG_ RouteInfoChar_25 : 360|8@1+ (1,0) [0|255] "ascii" STEERING_CONTROLLER
 SG_ RouteInfoChar_26 : 368|8@1+ (1,0) [0|255] "ascii" STEERING_CONTROLLER
 SG_ RouteInfoChar_27 : 376|8@1+ (1,0) [0|255] "ascii" STEERING_CONTROLLER
 SG_ RouteInfoChar_28 : 384|8@1+ (1,0) [0|255] "ascii" STEERING_CONTROLLER
 SG_ RouteInfoChar_29 : 392|8@1+ (1,0) [0|255] "ascii" STEERING_CONTROLLER
 SG_ RouteInfoChar_30 : 400|8@1+ (1,0) [0|255] "ascii" STEERING_CONTROLLER
 SG_ RouteInfoChar_31 : 408|8@1+ (1,0) [0|255] "ascii" STEERING_CONTROLLER
 SG_ RouteInfoChar_32 : 416|8@1+ (1,0) [0|255] "ascii" STEERING_CONTROLLER
 SG_ RouteInfoChar_33 : 424|8@1+ (1,0) [0|255] "ascii" STEERING_CONTROLLER
 SG_ RouteInfoChar_34 : 432|8@1+ (1,0) [0|255] "ascii" STEERING_CONTROLLER
 SG_ RouteInfoChar_35 : 440|8@1+ (1,0) [0|255] "ascii" STEERING_CONTROLLER
 SG_ RouteInfoChar_36 : 448|8@1+ (1,0) [0|255] "ascii" STEERING_CONTROLLER
 SG_ RouteInfoChar_37 : 456|8@1+ (1,0) [0|255] "ascii" STEERING_CONTROLLER
 SG_ RouteInfoChar_38 : 464|8@1+ (1,0) [0|255] "ascii" STEERING_CONTROLLER
 SG_ RouteInfoChar_39 : 472|8@1+ (1,0) [0|255] "ascii" STEERING_CONTROLLER
 SG_ RouteInfoChar_40 : 480|8@1+ (1,0) [0|255] "ascii" STEERING_CONTROLLER
 SG_ RouteInfoChar_41 : 488|8@1+ (1,0) [0|255] "ascii" STEERING_CONTROLLER
 SG_ RouteInfoChar_42 : 496|8@1+ (1,0) [0|255] "ascii" STEERING_CONTROLLER
 SG_ RouteInfoChar_43 : 504|8@1+ (1,0) [0|255] "ascii" STEERING_CONTROLLER
CM_ BO_ 384 "Cycle=10ms; Channel=CAN0; CAN-FD; NominalBitrate=500kbit/s; DataBitrate=2000kbit/s;  Data request; receiver answers with response frame; PayloadRouteInfo='ADAS_DOMAIN -> STEERING_CONTROLLER' in bytes 20-63; Gateway to CAN2";

BO_ 1536 RESP_000_STEERING_CONTROLLER_TO_ADAS_DOMAIN: 16 STEERING_CONTROLLER
 SG_ CRC8 : 0|8@1+ (1,0) [0|255] "" ADAS_DOMAIN
 SG_ ResponseCounter : 8|4@1+ (1,0) [0|15] "" ADAS_DOMAIN
 SG_ AckState : 12|4@1+ (1,0) [0|15] "" ADAS_DOMAIN
 SG_ ReceivedFrameId : 16|11@1+ (1,0) [0|2047] "" ADAS_DOMAIN
 SG_ ReceivedCounter : 27|4@1+ (1,0) [0|15] "" ADAS_DOMAIN
 SG_ ChecksumOk : 31|1@1+ (1,0) [0|1] "" ADAS_DOMAIN
 SG_ PayloadLength : 32|8@1+ (1,0) [0|64] "byte" ADAS_DOMAIN
 SG_ ErrorCode : 40|8@1+ (1,0) [0|255] "" ADAS_DOMAIN
 SG_ ProcessingTimeUs : 48|16@1+ (1,0) [0|65535] "us" ADAS_DOMAIN
 SG_ ResponseSequence : 64|16@1+ (1,0) [0|65535] "" ADAS_DOMAIN
 SG_ ReceivedCrc : 80|8@1+ (1,0) [0|255] "" ADAS_DOMAIN
 SG_ CalculatedCrc : 88|8@1+ (1,0) [0|255] "" ADAS_DOMAIN
CM_ BO_ 1536 "Cycle=10ms; Channel=CAN0; CAN-FD; NominalBitrate=500kbit/s; DataBitrate=2000kbit/s;  ResponseFor=0x180; ACK/NACK with CRC, DLC and counter check;";

BO_ 385 DATA_001_ADAS_DOMAIN_MOTION_REQUEST_TO_BRAKE_CONTROLLER: 64 ADAS_DOMAIN
 SG_ CRC8 : 0|8@1+ (1,0) [0|255] "" BRAKE_CONTROLLER
 SG_ AliveCounter : 8|4@1+ (1,0) [0|15] "" BRAKE_CONTROLLER
 SG_ MuxState : 12|4@1+ (1,0) [0|15] "" BRAKE_CONTROLLER
 SG_ SIG_181_00 : 16|12@1+ (0.1,0.0) [0|4095] "km/h" BRAKE_CONTROLLER
 SG_ SIG_181_01 : 28|12@1+ (0.1,0.0) [0|4095] "rpm" BRAKE_CONTROLLER
 SG_ SIG_181_02 : 40|12@1+ (0.1,0.0) [0|4095] "Nm" BRAKE_CONTROLLER
 SG_ SIG_181_03 : 52|12@1+ (0.1,0.0) [0|4095] "Nm" BRAKE_CONTROLLER
 SG_ SIG_181_04 : 64|12@1+ (0.1,0.0) [0|4095] "m" BRAKE_CONTROLLER
 SG_ SIG_181_05 : 76|12@1+ (0.1,0.0) [0|4095] "obj" BRAKE_CONTROLLER
 SG_ SIG_181_06 : 88|12@1+ (0.1,0.0) [0|4095] "km/h" BRAKE_CONTROLLER
 SG_ SIG_181_07 : 100|12@1+ (0.1,0.0) [0|4095] "m" BRAKE_CONTROLLER
 SG_ SIG_181_08 : 112|12@1+ (0.1,0.0) [0|4095] "Nm" BRAKE_CONTROLLER
 SG_ SIG_181_09 : 124|12@1+ (0.1,0.0) [0|4095] "m" BRAKE_CONTROLLER
 SG_ SIG_181_10 : 136|12@1+ (0.1,0.0) [0|4095] "%" BRAKE_CONTROLLER
 SG_ SIG_181_11 : 148|12@1+ (0.1,0.0) [0|4095] "Nm" BRAKE_CONTROLLER
 SG_ RouteInfoChar_00 : 160|8@1+ (1,0) [0|255] "ascii" BRAKE_CONTROLLER
 SG_ RouteInfoChar_01 : 168|8@1+ (1,0) [0|255] "ascii" BRAKE_CONTROLLER
 SG_ RouteInfoChar_02 : 176|8@1+ (1,0) [0|255] "ascii" BRAKE_CONTROLLER
 SG_ RouteInfoChar_03 : 184|8@1+ (1,0) [0|255] "ascii" BRAKE_CONTROLLER
 SG_ RouteInfoChar_04 : 192|8@1+ (1,0) [0|255] "ascii" BRAKE_CONTROLLER
 SG_ RouteInfoChar_05 : 200|8@1+ (1,0) [0|255] "ascii" BRAKE_CONTROLLER
 SG_ RouteInfoChar_06 : 208|8@1+ (1,0) [0|255] "ascii" BRAKE_CONTROLLER
 SG_ RouteInfoChar_07 : 216|8@1+ (1,0) [0|255] "ascii" BRAKE_CONTROLLER
 SG_ RouteInfoChar_08 : 224|8@1+ (1,0) [0|255] "ascii" BRAKE_CONTROLLER
 SG_ RouteInfoChar_09 : 232|8@1+ (1,0) [0|255] "ascii" BRAKE_CONTROLLER
 SG_ RouteInfoChar_10 : 240|8@1+ (1,0) [0|255] "ascii" BRAKE_CONTROLLER
 SG_ RouteInfoChar_11 : 248|8@1+ (1,0) [0|255] "ascii" BRAKE_CONTROLLER
 SG_ RouteInfoChar_12 : 256|8@1+ (1,0) [0|255] "ascii" BRAKE_CONTROLLER
 SG_ RouteInfoChar_13 : 264|8@1+ (1,0) [0|255] "ascii" BRAKE_CONTROLLER
 SG_ RouteInfoChar_14 : 272|8@1+ (1,0) [0|255] "ascii" BRAKE_CONTROLLER
 SG_ RouteInfoChar_15 : 280|8@1+ (1,0) [0|255] "ascii" BRAKE_CONTROLLER
 SG_ RouteInfoChar_16 : 288|8@1+ (1,0) [0|255] "ascii" BRAKE_CONTROLLER
 SG_ RouteInfoChar_17 : 296|8@1+ (1,0) [0|255] "ascii" BRAKE_CONTROLLER
 SG_ RouteInfoChar_18 : 304|8@1+ (1,0) [0|255] "ascii" BRAKE_CONTROLLER
 SG_ RouteInfoChar_19 : 312|8@1+ (1,0) [0|255] "ascii" BRAKE_CONTROLLER
 SG_ RouteInfoChar_20 : 320|8@1+ (1,0) [0|255] "ascii" BRAKE_CONTROLLER
 SG_ RouteInfoChar_21 : 328|8@1+ (1,0) [0|255] "ascii" BRAKE_CONTROLLER
 SG_ RouteInfoChar_22 : 336|8@1+ (1,0) [0|255] "ascii" BRAKE_CONTROLLER
 SG_ RouteInfoChar_23 : 344|8@1+ (1,0) [0|255] "ascii" BRAKE_CONTROLLER
 SG_ RouteInfoChar_24 : 352|8@1+ (1,0) [0|255] "ascii" BRAKE_CONTROLLER
 SG_ RouteInfoChar_25 : 360|8@1+ (1,0) [0|255] "ascii" BRAKE_CONTROLLER
 SG_ RouteInfoChar_26 : 368|8@1+ (1,0) [0|255] "ascii" BRAKE_CONTROLLER
 SG_ RouteInfoChar_27 : 376|8@1+ (1,0) [0|255] "ascii" BRAKE_CONTROLLER
 SG_ RouteInfoChar_28 : 384|8@1+ (1,0) [0|255] "ascii" BRAKE_CONTROLLER
 SG_ RouteInfoChar_29 : 392|8@1+ (1,0) [0|255] "ascii" BRAKE_CONTROLLER
 SG_ RouteInfoChar_30 : 400|8@1+ (1,0) [0|255] "ascii" BRAKE_CONTROLLER
 SG_ RouteInfoChar_31 : 408|8@1+ (1,0) [0|255] "ascii" BRAKE_CONTROLLER
 SG_ RouteInfoChar_32 : 416|8@1+ (1,0) [0|255] "ascii" BRAKE_CONTROLLER
 SG_ RouteInfoChar_33 : 424|8@1+ (1,0) [0|255] "ascii" BRAKE_CONTROLLER
 SG_ RouteInfoChar_34 : 432|8@1+ (1,0) [0|255] "ascii" BRAKE_CONTROLLER
 SG_ RouteInfoChar_35 : 440|8@1+ (1,0) [0|255] "ascii" BRAKE_CONTROLLER
 SG_ RouteInfoChar_36 : 448|8@1+ (1,0) [0|255] "ascii" BRAKE_CONTROLLER
 SG_ RouteInfoChar_37 : 456|8@1+ (1,0) [0|255] "ascii" BRAKE_CONTROLLER
 SG_ RouteInfoChar_38 : 464|8@1+ (1,0) [0|255] "ascii" BRAKE_CONTROLLER
 SG_ RouteInfoChar_39 : 472|8@1+ (1,0) [0|255] "ascii" BRAKE_CONTROLLER
 SG_ RouteInfoChar_40 : 480|8@1+ (1,0) [0|255] "ascii" BRAKE_CONTROLLER
 SG_ RouteInfoChar_41 : 488|8@1+ (1,0) [0|255] "ascii" BRAKE_CONTROLLER
 SG_ RouteInfoChar_42 : 496|8@1+ (1,0) [0|255] "ascii" BRAKE_CONTROLLER
 SG_ RouteInfoChar_43 : 504|8@1+ (1,0) [0|255] "ascii" BRAKE_CONTROLLER
CM_ BO_ 385 "Cycle=10ms; Channel=CAN0; CAN-FD; NominalBitrate=500kbit/s; DataBitrate=2000kbit/s;  Data request; receiver answers with response frame; PayloadRouteInfo='ADAS_DOMAIN -> BRAKE_CONTROLLER' in bytes 20-63; Gateway to CAN2";

BO_ 1537 RESP_001_BRAKE_CONTROLLER_TO_ADAS_DOMAIN: 16 BRAKE_CONTROLLER
 SG_ CRC8 : 0|8@1+ (1,0) [0|255] "" ADAS_DOMAIN
 SG_ ResponseCounter : 8|4@1+ (1,0) [0|15] "" ADAS_DOMAIN
 SG_ AckState : 12|4@1+ (1,0) [0|15] "" ADAS_DOMAIN
 SG_ ReceivedFrameId : 16|11@1+ (1,0) [0|2047] "" ADAS_DOMAIN
 SG_ ReceivedCounter : 27|4@1+ (1,0) [0|15] "" ADAS_DOMAIN
 SG_ ChecksumOk : 31|1@1+ (1,0) [0|1] "" ADAS_DOMAIN
 SG_ PayloadLength : 32|8@1+ (1,0) [0|64] "byte" ADAS_DOMAIN
 SG_ ErrorCode : 40|8@1+ (1,0) [0|255] "" ADAS_DOMAIN
 SG_ ProcessingTimeUs : 48|16@1+ (1,0) [0|65535] "us" ADAS_DOMAIN
 SG_ ResponseSequence : 64|16@1+ (1,0) [0|65535] "" ADAS_DOMAIN
 SG_ ReceivedCrc : 80|8@1+ (1,0) [0|255] "" ADAS_DOMAIN
 SG_ CalculatedCrc : 88|8@1+ (1,0) [0|255] "" ADAS_DOMAIN
CM_ BO_ 1537 "Cycle=10ms; Channel=CAN0; CAN-FD; NominalBitrate=500kbit/s; DataBitrate=2000kbit/s;  ResponseFor=0x181; ACK/NACK with CRC, DLC and counter check;";

BO_ 386 DATA_002_ADAS_DOMAIN_STEERING_TORQUE_REQUEST_TO_STEERING_CONTROLLER: 64 ADAS_DOMAIN
 SG_ CRC8 : 0|8@1+ (1,0) [0|255] "" STEERING_CONTROLLER
 SG_ AliveCounter : 8|4@1+ (1,0) [0|15] "" STEERING_CONTROLLER
 SG_ MuxState : 12|4@1+ (1,0) [0|15] "" STEERING_CONTROLLER
 SG_ SIG_182_00 : 16|12@1+ (0.1,0.0) [0|4095] "C" STEERING_CONTROLLER
 SG_ SIG_182_01 : 28|12@1+ (0.1,0.0) [0|4095] "obj" STEERING_CONTROLLER
 SG_ SIG_182_02 : 40|12@1+ (0.1,0.0) [0|4095] "V" STEERING_CONTROLLER
 SG_ SIG_182_03 : 52|12@1+ (0.1,0.0) [0|4095] "km/h" STEERING_CONTROLLER
 SG_ SIG_182_04 : 64|12@1+ (0.1,0.0) [0|4095] "deg" STEERING_CONTROLLER
 SG_ SIG_182_05 : 76|12@1+ (0.1,0.0) [0|4095] "%" STEERING_CONTROLLER
 SG_ SIG_182_06 : 88|12@1+ (0.1,0.0) [0|4095] "A" STEERING_CONTROLLER
 SG_ SIG_182_07 : 100|12@1+ (0.1,0.0) [0|4095] "V" STEERING_CONTROLLER
 SG_ SIG_182_08 : 112|12@1+ (0.1,0.0) [0|4095] "deg" STEERING_CONTROLLER
 SG_ SIG_182_09 : 124|12@1+ (0.1,0.0) [0|4095] "Nm" STEERING_CONTROLLER
 SG_ SIG_182_10 : 136|12@1+ (0.1,0.0) [0|4095] "A" STEERING_CONTROLLER
 SG_ SIG_182_11 : 148|12@1+ (0.1,0.0) [0|4095] "rpm" STEERING_CONTROLLER
 SG_ RouteInfoChar_00 : 160|8@1+ (1,0) [0|255] "ascii" STEERING_CONTROLLER
 SG_ RouteInfoChar_01 : 168|8@1+ (1,0) [0|255] "ascii" STEERING_CONTROLLER
 SG_ RouteInfoChar_02 : 176|8@1+ (1,0) [0|255] "ascii" STEERING_CONTROLLER
 SG_ RouteInfoChar_03 : 184|8@1+ (1,0) [0|255] "ascii" STEERING_CONTROLLER
 SG_ RouteInfoChar_04 : 192|8@1+ (1,0) [0|255] "ascii" STEERING_CONTROLLER
 SG_ RouteInfoChar_05 : 200|8@1+ (1,0) [0|255] "ascii" STEERING_CONTROLLER
 SG_ RouteInfoChar_06 : 208|8@1+ (1,0) [0|255] "ascii" STEERING_CONTROLLER
 SG_ RouteInfoChar_07 : 216|8@1+ (1,0) [0|255] "ascii" STEERING_CONTROLLER
 SG_ RouteInfoChar_08 : 224|8@1+ (1,0) [0|255] "ascii" STEERING_CONTROLLER
 SG_ RouteInfoChar_09 : 232|8@1+ (1,0) [0|255] "ascii" STEERING_CONTROLLER
 SG_ RouteInfoChar_10 : 240|8@1+ (1,0) [0|255] "ascii" STEERING_CONTROLLER
 SG_ RouteInfoChar_11 : 248|8@1+ (1,0) [0|255] "ascii" STEERING_CONTROLLER
 SG_ RouteInfoChar_12 : 256|8@1+ (1,0) [0|255] "ascii" STEERING_CONTROLLER
 SG_ RouteInfoChar_13 : 264|8@1+ (1,0) [0|255] "ascii" STEERING_CONTROLLER
 SG_ RouteInfoChar_14 : 272|8@1+ (1,0) [0|255] "ascii" STEERING_CONTROLLER
 SG_ RouteInfoChar_15 : 280|8@1+ (1,0) [0|255] "ascii" STEERING_CONTROLLER
 SG_ RouteInfoChar_16 : 288|8@1+ (1,0) [0|255] "ascii" STEERING_CONTROLLER
 SG_ RouteInfoChar_17 : 296|8@1+ (1,0) [0|255] "ascii" STEERING_CONTROLLER
 SG_ RouteInfoChar_18 : 304|8@1+ (1,0) [0|255] "ascii" STEERING_CONTROLLER
 SG_ RouteInfoChar_19 : 312|8@1+ (1,0) [0|255] "ascii" STEERING_CONTROLLER
 SG_ RouteInfoChar_20 : 320|8@1+ (1,0) [0|255] "ascii" STEERING_CONTROLLER
 SG_ RouteInfoChar_21 : 328|8@1+ (1,0) [0|255] "ascii" STEERING_CONTROLLER
 SG_ RouteInfoChar_22 : 336|8@1+ (1,0) [0|255] "ascii" STEERING_CONTROLLER
 SG_ RouteInfoChar_23 : 344|8@1+ (1,0) [0|255] "ascii" STEERING_CONTROLLER
 SG_ RouteInfoChar_24 : 352|8@1+ (1,0) [0|255] "ascii" STEERING_CONTROLLER
 SG_ RouteInfoChar_25 : 360|8@1+ (1,0) [0|255] "ascii" STEERING_CONTROLLER
 SG_ RouteInfoChar_26 : 368|8@1+ (1,0) [0|255] "ascii" STEERING_CONTROLLER
 SG_ RouteInfoChar_27 : 376|8@1+ (1,0) [0|255] "ascii" STEERING_CONTROLLER
 SG_ RouteInfoChar_28 : 384|8@1+ (1,0) [0|255] "ascii" STEERING_CONTROLLER
 SG_ RouteInfoChar_29 : 392|8@1+ (1,0) [0|255] "ascii" STEERING_CONTROLLER
 SG_ RouteInfoChar_30 : 400|8@1+ (1,0) [0|255] "ascii" STEERING_CONTROLLER
 SG_ RouteInfoChar_31 : 408|8@1+ (1,0) [0|255] "ascii" STEERING_CONTROLLER
 SG_ RouteInfoChar_32 : 416|8@1+ (1,0) [0|255] "ascii" STEERING_CONTROLLER
 SG_ RouteInfoChar_33 : 424|8@1+ (1,0) [0|255] "ascii" STEERING_CONTROLLER
 SG_ RouteInfoChar_34 : 432|8@1+ (1,0) [0|255] "ascii" STEERING_CONTROLLER
 SG_ RouteInfoChar_35 : 440|8@1+ (1,0) [0|255] "ascii" STEERING_CONTROLLER
 SG_ RouteInfoChar_36 : 448|8@1+ (1,0) [0|255] "ascii" STEERING_CONTROLLER
 SG_ RouteInfoChar_37 : 456|8@1+ (1,0) [0|255] "ascii" STEERING_CONTROLLER
 SG_ RouteInfoChar_38 : 464|8@1+ (1,0) [0|255] "ascii" STEERING_CONTROLLER
 SG_ RouteInfoChar_39 : 472|8@1+ (1,0) [0|255] "ascii" STEERING_CONTROLLER
 SG_ RouteInfoChar_40 : 480|8@1+ (1,0) [0|255] "ascii" STEERING_CONTROLLER
 SG_ RouteInfoChar_41 : 488|8@1+ (1,0) [0|255] "ascii" STEERING_CONTROLLER
 SG_ RouteInfoChar_42 : 496|8@1+ (1,0) [0|255] "ascii" STEERING_CONTROLLER
 SG_ RouteInfoChar_43 : 504|8@1+ (1,0) [0|255] "ascii" STEERING_CONTROLLER
CM_ BO_ 386 "Cycle=10ms; Channel=CAN0; CAN-FD; NominalBitrate=500kbit/s; DataBitrate=2000kbit/s;  Data request; receiver answers with response frame; PayloadRouteInfo='ADAS_DOMAIN -> STEERING_CONTROLLER' in bytes 20-63; Gateway to CAN2";

BO_ 1538 RESP_002_STEERING_CONTROLLER_TO_ADAS_DOMAIN: 16 STEERING_CONTROLLER
 SG_ CRC8 : 0|8@1+ (1,0) [0|255] "" ADAS_DOMAIN
 SG_ ResponseCounter : 8|4@1+ (1,0) [0|15] "" ADAS_DOMAIN
 SG_ AckState : 12|4@1+ (1,0) [0|15] "" ADAS_DOMAIN
 SG_ ReceivedFrameId : 16|11@1+ (1,0) [0|2047] "" ADAS_DOMAIN
 SG_ ReceivedCounter : 27|4@1+ (1,0) [0|15] "" ADAS_DOMAIN
 SG_ ChecksumOk : 31|1@1+ (1,0) [0|1] "" ADAS_DOMAIN
 SG_ PayloadLength : 32|8@1+ (1,0) [0|64] "byte" ADAS_DOMAIN
 SG_ ErrorCode : 40|8@1+ (1,0) [0|255] "" ADAS_DOMAIN
 SG_ ProcessingTimeUs : 48|16@1+ (1,0) [0|65535] "us" ADAS_DOMAIN
 SG_ ResponseSequence : 64|16@1+ (1,0) [0|65535] "" ADAS_DOMAIN
 SG_ ReceivedCrc : 80|8@1+ (1,0) [0|255] "" ADAS_DOMAIN
 SG_ CalculatedCrc : 88|8@1+ (1,0) [0|255] "" ADAS_DOMAIN
CM_ BO_ 1538 "Cycle=10ms; Channel=CAN0; CAN-FD; NominalBitrate=500kbit/s; DataBitrate=2000kbit/s;  ResponseFor=0x182; ACK/NACK with CRC, DLC and counter check;";

BO_ 387 DATA_003_CAMERA_FRONT_WIDE_LANE_MODEL_TO_ADAS_DOMAIN: 64 CAMERA_FRONT_WIDE
 SG_ CRC8 : 0|8@1+ (1,0) [0|255] "" ADAS_DOMAIN
 SG_ AliveCounter : 8|4@1+ (1,0) [0|15] "" ADAS_DOMAIN
 SG_ MuxState : 12|4@1+ (1,0) [0|15] "" ADAS_DOMAIN
 SG_ SIG_183_00 : 16|12@1+ (0.1,0.0) [0|4095] "rpm" ADAS_DOMAIN
 SG_ SIG_183_01 : 28|12@1+ (0.1,0.0) [0|4095] "%" ADAS_DOMAIN
 SG_ SIG_183_02 : 40|12@1+ (0.1,0.0) [0|4095] "rpm" ADAS_DOMAIN
 SG_ SIG_183_03 : 52|12@1+ (0.1,0.0) [0|4095] "A" ADAS_DOMAIN
 SG_ SIG_183_04 : 64|12@1+ (0.1,0.0) [0|4095] "A" ADAS_DOMAIN
 SG_ SIG_183_05 : 76|12@1+ (0.1,0.0) [0|4095] "obj" ADAS_DOMAIN
 SG_ SIG_183_06 : 88|12@1+ (0.1,0.0) [0|4095] "V" ADAS_DOMAIN
 SG_ SIG_183_07 : 100|12@1+ (0.1,0.0) [0|4095] "km/h" ADAS_DOMAIN
 SG_ SIG_183_08 : 112|12@1+ (0.1,0.0) [0|4095] "C" ADAS_DOMAIN
 SG_ SIG_183_09 : 124|12@1+ (0.1,0.0) [0|4095] "m" ADAS_DOMAIN
 SG_ SIG_183_10 : 136|12@1+ (0.1,0.0) [0|4095] "rpm" ADAS_DOMAIN
 SG_ SIG_183_11 : 148|12@1+ (0.1,0.0) [0|4095] "%" ADAS_DOMAIN
 SG_ RouteInfoChar_00 : 160|8@1+ (1,0) [0|255] "ascii" ADAS_DOMAIN
 SG_ RouteInfoChar_01 : 168|8@1+ (1,0) [0|255] "ascii" ADAS_DOMAIN
 SG_ RouteInfoChar_02 : 176|8@1+ (1,0) [0|255] "ascii" ADAS_DOMAIN
 SG_ RouteInfoChar_03 : 184|8@1+ (1,0) [0|255] "ascii" ADAS_DOMAIN
 SG_ RouteInfoChar_04 : 192|8@1+ (1,0) [0|255] "ascii" ADAS_DOMAIN
 SG_ RouteInfoChar_05 : 200|8@1+ (1,0) [0|255] "ascii" ADAS_DOMAIN
 SG_ RouteInfoChar_06 : 208|8@1+ (1,0) [0|255] "ascii" ADAS_DOMAIN
 SG_ RouteInfoChar_07 : 216|8@1+ (1,0) [0|255] "ascii" ADAS_DOMAIN
 SG_ RouteInfoChar_08 : 224|8@1+ (1,0) [0|255] "ascii" ADAS_DOMAIN
 SG_ RouteInfoChar_09 : 232|8@1+ (1,0) [0|255] "ascii" ADAS_DOMAIN
 SG_ RouteInfoChar_10 : 240|8@1+ (1,0) [0|255] "ascii" ADAS_DOMAIN
 SG_ RouteInfoChar_11 : 248|8@1+ (1,0) [0|255] "ascii" ADAS_DOMAIN
 SG_ RouteInfoChar_12 : 256|8@1+ (1,0) [0|255] "ascii" ADAS_DOMAIN
 SG_ RouteInfoChar_13 : 264|8@1+ (1,0) [0|255] "ascii" ADAS_DOMAIN
 SG_ RouteInfoChar_14 : 272|8@1+ (1,0) [0|255] "ascii" ADAS_DOMAIN
 SG_ RouteInfoChar_15 : 280|8@1+ (1,0) [0|255] "ascii" ADAS_DOMAIN
 SG_ RouteInfoChar_16 : 288|8@1+ (1,0) [0|255] "ascii" ADAS_DOMAIN
 SG_ RouteInfoChar_17 : 296|8@1+ (1,0) [0|255] "ascii" ADAS_DOMAIN
 SG_ RouteInfoChar_18 : 304|8@1+ (1,0) [0|255] "ascii" ADAS_DOMAIN
 SG_ RouteInfoChar_19 : 312|8@1+ (1,0) [0|255] "ascii" ADAS_DOMAIN
 SG_ RouteInfoChar_20 : 320|8@1+ (1,0) [0|255] "ascii" ADAS_DOMAIN
 SG_ RouteInfoChar_21 : 328|8@1+ (1,0) [0|255] "ascii" ADAS_DOMAIN
 SG_ RouteInfoChar_22 : 336|8@1+ (1,0) [0|255] "ascii" ADAS_DOMAIN
 SG_ RouteInfoChar_23 : 344|8@1+ (1,0) [0|255] "ascii" ADAS_DOMAIN
 SG_ RouteInfoChar_24 : 352|8@1+ (1,0) [0|255] "ascii" ADAS_DOMAIN
 SG_ RouteInfoChar_25 : 360|8@1+ (1,0) [0|255] "ascii" ADAS_DOMAIN
 SG_ RouteInfoChar_26 : 368|8@1+ (1,0) [0|255] "ascii" ADAS_DOMAIN
 SG_ RouteInfoChar_27 : 376|8@1+ (1,0) [0|255] "ascii" ADAS_DOMAIN
 SG_ RouteInfoChar_28 : 384|8@1+ (1,0) [0|255] "ascii" ADAS_DOMAIN
 SG_ RouteInfoChar_29 : 392|8@1+ (1,0) [0|255] "ascii" ADAS_DOMAIN
 SG_ RouteInfoChar_30 : 400|8@1+ (1,0) [0|255] "ascii" ADAS_DOMAIN
 SG_ RouteInfoChar_31 : 408|8@1+ (1,0) [0|255] "ascii" ADAS_DOMAIN
 SG_ RouteInfoChar_32 : 416|8@1+ (1,0) [0|255] "ascii" ADAS_DOMAIN
 SG_ RouteInfoChar_33 : 424|8@1+ (1,0) [0|255] "ascii" ADAS_DOMAIN
 SG_ RouteInfoChar_34 : 432|8@1+ (1,0) [0|255] "ascii" ADAS_DOMAIN
 SG_ RouteInfoChar_35 : 440|8@1+ (1,0) [0|255] "ascii" ADAS_DOMAIN
 SG_ RouteInfoChar_36 : 448|8@1+ (1,0) [0|255] "ascii" ADAS_DOMAIN
 SG_ RouteInfoChar_37 : 456|8@1+ (1,0) [0|255] "ascii" ADAS_DOMAIN
 SG_ RouteInfoChar_38 : 464|8@1+ (1,0) [0|255] "ascii" ADAS_DOMAIN
 SG_ RouteInfoChar_39 : 472|8@1+ (1,0) [0|255] "ascii" ADAS_DOMAIN
 SG_ RouteInfoChar_40 : 480|8@1+ (1,0) [0|255] "ascii" ADAS_DOMAIN
 SG_ RouteInfoChar_41 : 488|8@1+ (1,0) [0|255] "ascii" ADAS_DOMAIN
 SG_ RouteInfoChar_42 : 496|8@1+ (1,0) [0|255] "ascii" ADAS_DOMAIN
 SG_ RouteInfoChar_43 : 504|8@1+ (1,0) [0|255] "ascii" ADAS_DOMAIN
CM_ BO_ 387 "Cycle=20ms; Channel=CAN1; CAN-FD; NominalBitrate=500kbit/s; DataBitrate=2000kbit/s;  Data request; receiver answers with response frame; PayloadRouteInfo='CAMERA_FRONT_WIDE -> ADAS_DOMAIN' in bytes 20-63;";

BO_ 1539 RESP_003_ADAS_DOMAIN_TO_CAMERA_FRONT_WIDE: 16 ADAS_DOMAIN
 SG_ CRC8 : 0|8@1+ (1,0) [0|255] "" CAMERA_FRONT_WIDE
 SG_ ResponseCounter : 8|4@1+ (1,0) [0|15] "" CAMERA_FRONT_WIDE
 SG_ AckState : 12|4@1+ (1,0) [0|15] "" CAMERA_FRONT_WIDE
 SG_ ReceivedFrameId : 16|11@1+ (1,0) [0|2047] "" CAMERA_FRONT_WIDE
 SG_ ReceivedCounter : 27|4@1+ (1,0) [0|15] "" CAMERA_FRONT_WIDE
 SG_ ChecksumOk : 31|1@1+ (1,0) [0|1] "" CAMERA_FRONT_WIDE
 SG_ PayloadLength : 32|8@1+ (1,0) [0|64] "byte" CAMERA_FRONT_WIDE
 SG_ ErrorCode : 40|8@1+ (1,0) [0|255] "" CAMERA_FRONT_WIDE
 SG_ ProcessingTimeUs : 48|16@1+ (1,0) [0|65535] "us" CAMERA_FRONT_WIDE
 SG_ ResponseSequence : 64|16@1+ (1,0) [0|65535] "" CAMERA_FRONT_WIDE
 SG_ ReceivedCrc : 80|8@1+ (1,0) [0|255] "" CAMERA_FRONT_WIDE
 SG_ CalculatedCrc : 88|8@1+ (1,0) [0|255] "" CAMERA_FRONT_WIDE
CM_ BO_ 1539 "Cycle=20ms; Channel=CAN1; CAN-FD; NominalBitrate=500kbit/s; DataBitrate=2000kbit/s;  ResponseFor=0x183; ACK/NACK with CRC, DLC and counter check;";

BO_ 388 DATA_004_CAMERA_FRONT_WIDE_OBJECT_LIST_TO_ADAS_DOMAIN: 64 CAMERA_FRONT_WIDE
 SG_ CRC8 : 0|8@1+ (1,0) [0|255] "" ADAS_DOMAIN
 SG_ AliveCounter : 8|4@1+ (1,0) [0|15] "" ADAS_DOMAIN
 SG_ MuxState : 12|4@1+ (1,0) [0|15] "" ADAS_DOMAIN
 SG_ SIG_184_00 : 16|12@1+ (0.1,0.0) [0|4095] "rpm" ADAS_DOMAIN
 SG_ SIG_184_01 : 28|12@1+ (0.1,0.0) [0|4095] "m" ADAS_DOMAIN
 SG_ SIG_184_02 : 40|12@1+ (0.1,0.0) [0|4095] "V" ADAS_DOMAIN
 SG_ SIG_184_03 : 52|12@1+ (0.1,0.0) [0|4095] "obj" ADAS_DOMAIN
 SG_ SIG_184_04 : 64|12@1+ (0.1,0.0) [0|4095] "A" ADAS_DOMAIN
 SG_ SIG_184_05 : 76|12@1+ (0.1,0.0) [0|4095] "obj" ADAS_DOMAIN
 SG_ SIG_184_06 : 88|12@1+ (0.1,0.0) [0|4095] "Nm" ADAS_DOMAIN
 SG_ SIG_184_07 : 100|12@1+ (0.1,0.0) [0|4095] "rpm" ADAS_DOMAIN
 SG_ SIG_184_08 : 112|12@1+ (0.1,0.0) [0|4095] "km/h" ADAS_DOMAIN
 SG_ SIG_184_09 : 124|12@1+ (0.1,0.0) [0|4095] "Nm" ADAS_DOMAIN
 SG_ SIG_184_10 : 136|12@1+ (0.1,0.0) [0|4095] "V" ADAS_DOMAIN
 SG_ SIG_184_11 : 148|12@1+ (0.1,0.0) [0|4095] "rpm" ADAS_DOMAIN
 SG_ RouteInfoChar_00 : 160|8@1+ (1,0) [0|255] "ascii" ADAS_DOMAIN
 SG_ RouteInfoChar_01 : 168|8@1+ (1,0) [0|255] "ascii" ADAS_DOMAIN
 SG_ RouteInfoChar_02 : 176|8@1+ (1,0) [0|255] "ascii" ADAS_DOMAIN
 SG_ RouteInfoChar_03 : 184|8@1+ (1,0) [0|255] "ascii" ADAS_DOMAIN
 SG_ RouteInfoChar_04 : 192|8@1+ (1,0) [0|255] "ascii" ADAS_DOMAIN
 SG_ RouteInfoChar_05 : 200|8@1+ (1,0) [0|255] "ascii" ADAS_DOMAIN
 SG_ RouteInfoChar_06 : 208|8@1+ (1,0) [0|255] "ascii" ADAS_DOMAIN
 SG_ RouteInfoChar_07 : 216|8@1+ (1,0) [0|255] "ascii" ADAS_DOMAIN
 SG_ RouteInfoChar_08 : 224|8@1+ (1,0) [0|255] "ascii" ADAS_DOMAIN
 SG_ RouteInfoChar_09 : 232|8@1+ (1,0) [0|255] "ascii" ADAS_DOMAIN
 SG_ RouteInfoChar_10 : 240|8@1+ (1,0) [0|255] "ascii" ADAS_DOMAIN
 SG_ RouteInfoChar_11 : 248|8@1+ (1,0) [0|255] "ascii" ADAS_DOMAIN
 SG_ RouteInfoChar_12 : 256|8@1+ (1,0) [0|255] "ascii" ADAS_DOMAIN
 SG_ RouteInfoChar_13 : 264|8@1+ (1,0) [0|255] "ascii" ADAS_DOMAIN
 SG_ RouteInfoChar_14 : 272|8@1+ (1,0) [0|255] "ascii" ADAS_DOMAIN
 SG_ RouteInfoChar_15 : 280|8@1+ (1,0) [0|255] "ascii" ADAS_DOMAIN
 SG_ RouteInfoChar_16 : 288|8@1+ (1,0) [0|255] "ascii" ADAS_DOMAIN
 SG_ RouteInfoChar_17 : 296|8@1+ (1,0) [0|255] "ascii" ADAS_DOMAIN
 SG_ RouteInfoChar_18 : 304|8@1+ (1,0) [0|255] "ascii" ADAS_DOMAIN
 SG_ RouteInfoChar_19 : 312|8@1+ (1,0) [0|255] "ascii" ADAS_DOMAIN
 SG_ RouteInfoChar_20 : 320|8@1+ (1,0) [0|255] "ascii" ADAS_DOMAIN
 SG_ RouteInfoChar_21 : 328|8@1+ (1,0) [0|255] "ascii" ADAS_DOMAIN
 SG_ RouteInfoChar_22 : 336|8@1+ (1,0) [0|255] "ascii" ADAS_DOMAIN
 SG_ RouteInfoChar_23 : 344|8@1+ (1,0) [0|255] "ascii" ADAS_DOMAIN
 SG_ RouteInfoChar_24 : 352|8@1+ (1,0) [0|255] "ascii" ADAS_DOMAIN
 SG_ RouteInfoChar_25 : 360|8@1+ (1,0) [0|255] "ascii" ADAS_DOMAIN
 SG_ RouteInfoChar_26 : 368|8@1+ (1,0) [0|255] "ascii" ADAS_DOMAIN
 SG_ RouteInfoChar_27 : 376|8@1+ (1,0) [0|255] "ascii" ADAS_DOMAIN
 SG_ RouteInfoChar_28 : 384|8@1+ (1,0) [0|255] "ascii" ADAS_DOMAIN
 SG_ RouteInfoChar_29 : 392|8@1+ (1,0) [0|255] "ascii" ADAS_DOMAIN
 SG_ RouteInfoChar_30 : 400|8@1+ (1,0) [0|255] "ascii" ADAS_DOMAIN
 SG_ RouteInfoChar_31 : 408|8@1+ (1,0) [0|255] "ascii" ADAS_DOMAIN
 SG_ RouteInfoChar_32 : 416|8@1+ (1,0) [0|255] "ascii" ADAS_DOMAIN
 SG_ RouteInfoChar_33 : 424|8@1+ (1,0) [0|255] "ascii" ADAS_DOMAIN
 SG_ RouteInfoChar_34 : 432|8@1+ (1,0) [0|255] "ascii" ADAS_DOMAIN
 SG_ RouteInfoChar_35 : 440|8@1+ (1,0) [0|255] "ascii" ADAS_DOMAIN
 SG_ RouteInfoChar_36 : 448|8@1+ (1,0) [0|255] "ascii" ADAS_DOMAIN
 SG_ RouteInfoChar_37 : 456|8@1+ (1,0) [0|255] "ascii" ADAS_DOMAIN
 SG_ RouteInfoChar_38 : 464|8@1+ (1,0) [0|255] "ascii" ADAS_DOMAIN
 SG_ RouteInfoChar_39 : 472|8@1+ (1,0) [0|255] "ascii" ADAS_DOMAIN
 SG_ RouteInfoChar_40 : 480|8@1+ (1,0) [0|255] "ascii" ADAS_DOMAIN
 SG_ RouteInfoChar_41 : 488|8@1+ (1,0) [0|255] "ascii" ADAS_DOMAIN
 SG_ RouteInfoChar_42 : 496|8@1+ (1,0) [0|255] "ascii" ADAS_DOMAIN
 SG_ RouteInfoChar_43 : 504|8@1+ (1,0) [0|255] "ascii" ADAS_DOMAIN
CM_ BO_ 388 "Cycle=20ms; Channel=CAN1; CAN-FD; NominalBitrate=500kbit/s; DataBitrate=2000kbit/s;  Data request; receiver answers with response frame; PayloadRouteInfo='CAMERA_FRONT_WIDE -> ADAS_DOMAIN' in bytes 20-63;";

BO_ 1540 RESP_004_ADAS_DOMAIN_TO_CAMERA_FRONT_WIDE: 16 ADAS_DOMAIN
 SG_ CRC8 : 0|8@1+ (1,0) [0|255] "" CAMERA_FRONT_WIDE
 SG_ ResponseCounter : 8|4@1+ (1,0) [0|15] "" CAMERA_FRONT_WIDE
 SG_ AckState : 12|4@1+ (1,0) [0|15] "" CAMERA_FRONT_WIDE
 SG_ ReceivedFrameId : 16|11@1+ (1,0) [0|2047] "" CAMERA_FRONT_WIDE
 SG_ ReceivedCounter : 27|4@1+ (1,0) [0|15] "" CAMERA_FRONT_WIDE
 SG_ ChecksumOk : 31|1@1+ (1,0) [0|1] "" CAMERA_FRONT_WIDE
 SG_ PayloadLength : 32|8@1+ (1,0) [0|64] "byte" CAMERA_FRONT_WIDE
 SG_ ErrorCode : 40|8@1+ (1,0) [0|255] "" CAMERA_FRONT_WIDE
 SG_ ProcessingTimeUs : 48|16@1+ (1,0) [0|65535] "us" CAMERA_FRONT_WIDE
 SG_ ResponseSequence : 64|16@1+ (1,0) [0|65535] "" CAMERA_FRONT_WIDE
 SG_ ReceivedCrc : 80|8@1+ (1,0) [0|255] "" CAMERA_FRONT_WIDE
 SG_ CalculatedCrc : 88|8@1+ (1,0) [0|255] "" CAMERA_FRONT_WIDE
CM_ BO_ 1540 "Cycle=20ms; Channel=CAN1; CAN-FD; NominalBitrate=500kbit/s; DataBitrate=2000kbit/s;  ResponseFor=0x184; ACK/NACK with CRC, DLC and counter check;";

BO_ 389 DATA_005_RADAR_FRONT_LONG_RANGE_OBJECT_LIST_TO_ADAS_DOMAIN: 64 RADAR_FRONT_LONG_RANGE
 SG_ CRC8 : 0|8@1+ (1,0) [0|255] "" ADAS_DOMAIN
 SG_ AliveCounter : 8|4@1+ (1,0) [0|15] "" ADAS_DOMAIN
 SG_ MuxState : 12|4@1+ (1,0) [0|15] "" ADAS_DOMAIN
 SG_ SIG_185_00 : 16|12@1+ (0.1,0.0) [0|4095] "Nm" ADAS_DOMAIN
 SG_ SIG_185_01 : 28|12@1+ (0.1,0.0) [0|4095] "rpm" ADAS_DOMAIN
 SG_ SIG_185_02 : 40|12@1+ (0.1,0.0) [0|4095] "%" ADAS_DOMAIN
 SG_ SIG_185_03 : 52|12@1+ (0.1,0.0) [0|4095] "V" ADAS_DOMAIN
 SG_ SIG_185_04 : 64|12@1+ (0.1,0.0) [0|4095] "C" ADAS_DOMAIN
 SG_ SIG_185_05 : 76|12@1+ (0.1,0.0) [0|4095] "A" ADAS_DOMAIN
 SG_ SIG_185_06 : 88|12@1+ (0.1,0.0) [0|4095] "deg" ADAS_DOMAIN
 SG_ SIG_185_07 : 100|12@1+ (0.1,0.0) [0|4095] "A" ADAS_DOMAIN
 SG_ SIG_185_08 : 112|12@1+ (0.1,0.0) [0|4095] "A" ADAS_DOMAIN
 SG_ SIG_185_09 : 124|12@1+ (0.1,0.0) [0|4095] "Nm" ADAS_DOMAIN
 SG_ SIG_185_10 : 136|12@1+ (0.1,0.0) [0|4095] "V" ADAS_DOMAIN
 SG_ SIG_185_11 : 148|12@1+ (0.1,0.0) [0|4095] "rpm" ADAS_DOMAIN
 SG_ RouteInfoChar_00 : 160|8@1+ (1,0) [0|255] "ascii" ADAS_DOMAIN
 SG_ RouteInfoChar_01 : 168|8@1+ (1,0) [0|255] "ascii" ADAS_DOMAIN
 SG_ RouteInfoChar_02 : 176|8@1+ (1,0) [0|255] "ascii" ADAS_DOMAIN
 SG_ RouteInfoChar_03 : 184|8@1+ (1,0) [0|255] "ascii" ADAS_DOMAIN
 SG_ RouteInfoChar_04 : 192|8@1+ (1,0) [0|255] "ascii" ADAS_DOMAIN
 SG_ RouteInfoChar_05 : 200|8@1+ (1,0) [0|255] "ascii" ADAS_DOMAIN
 SG_ RouteInfoChar_06 : 208|8@1+ (1,0) [0|255] "ascii" ADAS_DOMAIN
 SG_ RouteInfoChar_07 : 216|8@1+ (1,0) [0|255] "ascii" ADAS_DOMAIN
 SG_ RouteInfoChar_08 : 224|8@1+ (1,0) [0|255] "ascii" ADAS_DOMAIN
 SG_ RouteInfoChar_09 : 232|8@1+ (1,0) [0|255] "ascii" ADAS_DOMAIN
 SG_ RouteInfoChar_10 : 240|8@1+ (1,0) [0|255] "ascii" ADAS_DOMAIN
 SG_ RouteInfoChar_11 : 248|8@1+ (1,0) [0|255] "ascii" ADAS_DOMAIN
 SG_ RouteInfoChar_12 : 256|8@1+ (1,0) [0|255] "ascii" ADAS_DOMAIN
 SG_ RouteInfoChar_13 : 264|8@1+ (1,0) [0|255] "ascii" ADAS_DOMAIN
 SG_ RouteInfoChar_14 : 272|8@1+ (1,0) [0|255] "ascii" ADAS_DOMAIN
 SG_ RouteInfoChar_15 : 280|8@1+ (1,0) [0|255] "ascii" ADAS_DOMAIN
 SG_ RouteInfoChar_16 : 288|8@1+ (1,0) [0|255] "ascii" ADAS_DOMAIN
 SG_ RouteInfoChar_17 : 296|8@1+ (1,0) [0|255] "ascii" ADAS_DOMAIN
 SG_ RouteInfoChar_18 : 304|8@1+ (1,0) [0|255] "ascii" ADAS_DOMAIN
 SG_ RouteInfoChar_19 : 312|8@1+ (1,0) [0|255] "ascii" ADAS_DOMAIN
 SG_ RouteInfoChar_20 : 320|8@1+ (1,0) [0|255] "ascii" ADAS_DOMAIN
 SG_ RouteInfoChar_21 : 328|8@1+ (1,0) [0|255] "ascii" ADAS_DOMAIN
 SG_ RouteInfoChar_22 : 336|8@1+ (1,0) [0|255] "ascii" ADAS_DOMAIN
 SG_ RouteInfoChar_23 : 344|8@1+ (1,0) [0|255] "ascii" ADAS_DOMAIN
 SG_ RouteInfoChar_24 : 352|8@1+ (1,0) [0|255] "ascii" ADAS_DOMAIN
 SG_ RouteInfoChar_25 : 360|8@1+ (1,0) [0|255] "ascii" ADAS_DOMAIN
 SG_ RouteInfoChar_26 : 368|8@1+ (1,0) [0|255] "ascii" ADAS_DOMAIN
 SG_ RouteInfoChar_27 : 376|8@1+ (1,0) [0|255] "ascii" ADAS_DOMAIN
 SG_ RouteInfoChar_28 : 384|8@1+ (1,0) [0|255] "ascii" ADAS_DOMAIN
 SG_ RouteInfoChar_29 : 392|8@1+ (1,0) [0|255] "ascii" ADAS_DOMAIN
 SG_ RouteInfoChar_30 : 400|8@1+ (1,0) [0|255] "ascii" ADAS_DOMAIN
 SG_ RouteInfoChar_31 : 408|8@1+ (1,0) [0|255] "ascii" ADAS_DOMAIN
 SG_ RouteInfoChar_32 : 416|8@1+ (1,0) [0|255] "ascii" ADAS_DOMAIN
 SG_ RouteInfoChar_33 : 424|8@1+ (1,0) [0|255] "ascii" ADAS_DOMAIN
 SG_ RouteInfoChar_34 : 432|8@1+ (1,0) [0|255] "ascii" ADAS_DOMAIN
 SG_ RouteInfoChar_35 : 440|8@1+ (1,0) [0|255] "ascii" ADAS_DOMAIN
 SG_ RouteInfoChar_36 : 448|8@1+ (1,0) [0|255] "ascii" ADAS_DOMAIN
 SG_ RouteInfoChar_37 : 456|8@1+ (1,0) [0|255] "ascii" ADAS_DOMAIN
 SG_ RouteInfoChar_38 : 464|8@1+ (1,0) [0|255] "ascii" ADAS_DOMAIN
 SG_ RouteInfoChar_39 : 472|8@1+ (1,0) [0|255] "ascii" ADAS_DOMAIN
 SG_ RouteInfoChar_40 : 480|8@1+ (1,0) [0|255] "ascii" ADAS_DOMAIN
 SG_ RouteInfoChar_41 : 488|8@1+ (1,0) [0|255] "ascii" ADAS_DOMAIN
 SG_ RouteInfoChar_42 : 496|8@1+ (1,0) [0|255] "ascii" ADAS_DOMAIN
 SG_ RouteInfoChar_43 : 504|8@1+ (1,0) [0|255] "ascii" ADAS_DOMAIN
CM_ BO_ 389 "Cycle=10ms; Channel=CAN0; CAN-FD; NominalBitrate=500kbit/s; DataBitrate=2000kbit/s;  Data request; receiver answers with response frame; PayloadRouteInfo='RADAR_FRONT_LONG_RANGE -> ADAS_DOMAIN' in bytes 20-63;";

BO_ 1541 RESP_005_ADAS_DOMAIN_TO_RADAR_FRONT_LONG_RANGE: 16 ADAS_DOMAIN
 SG_ CRC8 : 0|8@1+ (1,0) [0|255] "" RADAR_FRONT_LONG_RANGE
 SG_ ResponseCounter : 8|4@1+ (1,0) [0|15] "" RADAR_FRONT_LONG_RANGE
 SG_ AckState : 12|4@1+ (1,0) [0|15] "" RADAR_FRONT_LONG_RANGE
 SG_ ReceivedFrameId : 16|11@1+ (1,0) [0|2047] "" RADAR_FRONT_LONG_RANGE
 SG_ ReceivedCounter : 27|4@1+ (1,0) [0|15] "" RADAR_FRONT_LONG_RANGE
 SG_ ChecksumOk : 31|1@1+ (1,0) [0|1] "" RADAR_FRONT_LONG_RANGE
 SG_ PayloadLength : 32|8@1+ (1,0) [0|64] "byte" RADAR_FRONT_LONG_RANGE
 SG_ ErrorCode : 40|8@1+ (1,0) [0|255] "" RADAR_FRONT_LONG_RANGE
 SG_ ProcessingTimeUs : 48|16@1+ (1,0) [0|65535] "us" RADAR_FRONT_LONG_RANGE
 SG_ ResponseSequence : 64|16@1+ (1,0) [0|65535] "" RADAR_FRONT_LONG_RANGE
 SG_ ReceivedCrc : 80|8@1+ (1,0) [0|255] "" RADAR_FRONT_LONG_RANGE
 SG_ CalculatedCrc : 88|8@1+ (1,0) [0|255] "" RADAR_FRONT_LONG_RANGE
CM_ BO_ 1541 "Cycle=10ms; Channel=CAN0; CAN-FD; NominalBitrate=500kbit/s; DataBitrate=2000kbit/s;  ResponseFor=0x185; ACK/NACK with CRC, DLC and counter check;";

BO_ 390 DATA_006_RADAR_REAR_CORNER_LEFT_BLIND_SPOT_OBJECTS_TO_ADAS_DOMAIN: 64 RADAR_REAR_CORNER_LEFT
 SG_ CRC8 : 0|8@1+ (1,0) [0|255] "" ADAS_DOMAIN
 SG_ AliveCounter : 8|4@1+ (1,0) [0|15] "" ADAS_DOMAIN
 SG_ MuxState : 12|4@1+ (1,0) [0|15] "" ADAS_DOMAIN
 SG_ SIG_186_00 : 16|12@1+ (0.1,0.0) [0|4095] "obj" ADAS_DOMAIN
 SG_ SIG_186_01 : 28|12@1+ (0.1,0.0) [0|4095] "deg" ADAS_DOMAIN
 SG_ SIG_186_02 : 40|12@1+ (0.1,0.0) [0|4095] "m" ADAS_DOMAIN
 SG_ SIG_186_03 : 52|12@1+ (0.1,0.0) [0|4095] "Nm" ADAS_DOMAIN
 SG_ SIG_186_04 : 64|12@1+ (0.1,0.0) [0|4095] "deg" ADAS_DOMAIN
 SG_ SIG_186_05 : 76|12@1+ (0.1,0.0) [0|4095] "C" ADAS_DOMAIN
 SG_ SIG_186_06 : 88|12@1+ (0.1,0.0) [0|4095] "%" ADAS_DOMAIN
 SG_ SIG_186_07 : 100|12@1+ (0.1,0.0) [0|4095] "V" ADAS_DOMAIN
 SG_ SIG_186_08 : 112|12@1+ (0.1,0.0) [0|4095] "m" ADAS_DOMAIN
 SG_ SIG_186_09 : 124|12@1+ (0.1,0.0) [0|4095] "Nm" ADAS_DOMAIN
 SG_ SIG_186_10 : 136|12@1+ (0.1,0.0) [0|4095] "A" ADAS_DOMAIN
 SG_ SIG_186_11 : 148|12@1+ (0.1,0.0) [0|4095] "km/h" ADAS_DOMAIN
 SG_ RouteInfoChar_00 : 160|8@1+ (1,0) [0|255] "ascii" ADAS_DOMAIN
 SG_ RouteInfoChar_01 : 168|8@1+ (1,0) [0|255] "ascii" ADAS_DOMAIN
 SG_ RouteInfoChar_02 : 176|8@1+ (1,0) [0|255] "ascii" ADAS_DOMAIN
 SG_ RouteInfoChar_03 : 184|8@1+ (1,0) [0|255] "ascii" ADAS_DOMAIN
 SG_ RouteInfoChar_04 : 192|8@1+ (1,0) [0|255] "ascii" ADAS_DOMAIN
 SG_ RouteInfoChar_05 : 200|8@1+ (1,0) [0|255] "ascii" ADAS_DOMAIN
 SG_ RouteInfoChar_06 : 208|8@1+ (1,0) [0|255] "ascii" ADAS_DOMAIN
 SG_ RouteInfoChar_07 : 216|8@1+ (1,0) [0|255] "ascii" ADAS_DOMAIN
 SG_ RouteInfoChar_08 : 224|8@1+ (1,0) [0|255] "ascii" ADAS_DOMAIN
 SG_ RouteInfoChar_09 : 232|8@1+ (1,0) [0|255] "ascii" ADAS_DOMAIN
 SG_ RouteInfoChar_10 : 240|8@1+ (1,0) [0|255] "ascii" ADAS_DOMAIN
 SG_ RouteInfoChar_11 : 248|8@1+ (1,0) [0|255] "ascii" ADAS_DOMAIN
 SG_ RouteInfoChar_12 : 256|8@1+ (1,0) [0|255] "ascii" ADAS_DOMAIN
 SG_ RouteInfoChar_13 : 264|8@1+ (1,0) [0|255] "ascii" ADAS_DOMAIN
 SG_ RouteInfoChar_14 : 272|8@1+ (1,0) [0|255] "ascii" ADAS_DOMAIN
 SG_ RouteInfoChar_15 : 280|8@1+ (1,0) [0|255] "ascii" ADAS_DOMAIN
 SG_ RouteInfoChar_16 : 288|8@1+ (1,0) [0|255] "ascii" ADAS_DOMAIN
 SG_ RouteInfoChar_17 : 296|8@1+ (1,0) [0|255] "ascii" ADAS_DOMAIN
 SG_ RouteInfoChar_18 : 304|8@1+ (1,0) [0|255] "ascii" ADAS_DOMAIN
 SG_ RouteInfoChar_19 : 312|8@1+ (1,0) [0|255] "ascii" ADAS_DOMAIN
 SG_ RouteInfoChar_20 : 320|8@1+ (1,0) [0|255] "ascii" ADAS_DOMAIN
 SG_ RouteInfoChar_21 : 328|8@1+ (1,0) [0|255] "ascii" ADAS_DOMAIN
 SG_ RouteInfoChar_22 : 336|8@1+ (1,0) [0|255] "ascii" ADAS_DOMAIN
 SG_ RouteInfoChar_23 : 344|8@1+ (1,0) [0|255] "ascii" ADAS_DOMAIN
 SG_ RouteInfoChar_24 : 352|8@1+ (1,0) [0|255] "ascii" ADAS_DOMAIN
 SG_ RouteInfoChar_25 : 360|8@1+ (1,0) [0|255] "ascii" ADAS_DOMAIN
 SG_ RouteInfoChar_26 : 368|8@1+ (1,0) [0|255] "ascii" ADAS_DOMAIN
 SG_ RouteInfoChar_27 : 376|8@1+ (1,0) [0|255] "ascii" ADAS_DOMAIN
 SG_ RouteInfoChar_28 : 384|8@1+ (1,0) [0|255] "ascii" ADAS_DOMAIN
 SG_ RouteInfoChar_29 : 392|8@1+ (1,0) [0|255] "ascii" ADAS_DOMAIN
 SG_ RouteInfoChar_30 : 400|8@1+ (1,0) [0|255] "ascii" ADAS_DOMAIN
 SG_ RouteInfoChar_31 : 408|8@1+ (1,0) [0|255] "ascii" ADAS_DOMAIN
 SG_ RouteInfoChar_32 : 416|8@1+ (1,0) [0|255] "ascii" ADAS_DOMAIN
 SG_ RouteInfoChar_33 : 424|8@1+ (1,0) [0|255] "ascii" ADAS_DOMAIN
 SG_ RouteInfoChar_34 : 432|8@1+ (1,0) [0|255] "ascii" ADAS_DOMAIN
 SG_ RouteInfoChar_35 : 440|8@1+ (1,0) [0|255] "ascii" ADAS_DOMAIN
 SG_ RouteInfoChar_36 : 448|8@1+ (1,0) [0|255] "ascii" ADAS_DOMAIN
 SG_ RouteInfoChar_37 : 456|8@1+ (1,0) [0|255] "ascii" ADAS_DOMAIN
 SG_ RouteInfoChar_38 : 464|8@1+ (1,0) [0|255] "ascii" ADAS_DOMAIN
 SG_ RouteInfoChar_39 : 472|8@1+ (1,0) [0|255] "ascii" ADAS_DOMAIN
 SG_ RouteInfoChar_40 : 480|8@1+ (1,0) [0|255] "ascii" ADAS_DOMAIN
 SG_ RouteInfoChar_41 : 488|8@1+ (1,0) [0|255] "ascii" ADAS_DOMAIN
 SG_ RouteInfoChar_42 : 496|8@1+ (1,0) [0|255] "ascii" ADAS_DOMAIN
 SG_ RouteInfoChar_43 : 504|8@1+ (1,0) [0|255] "ascii" ADAS_DOMAIN
CM_ BO_ 390 "Cycle=10ms; Channel=CAN1; CAN-FD; NominalBitrate=500kbit/s; DataBitrate=2000kbit/s;  Data request; receiver answers with response frame; PayloadRouteInfo='RADAR_REAR_CORNER_LEFT -> ADAS_DOMAIN' in bytes 20-63;";

BO_ 1542 RESP_006_ADAS_DOMAIN_TO_RADAR_REAR_CORNER_LEFT: 16 ADAS_DOMAIN
 SG_ CRC8 : 0|8@1+ (1,0) [0|255] "" RADAR_REAR_CORNER_LEFT
 SG_ ResponseCounter : 8|4@1+ (1,0) [0|15] "" RADAR_REAR_CORNER_LEFT
 SG_ AckState : 12|4@1+ (1,0) [0|15] "" RADAR_REAR_CORNER_LEFT
 SG_ ReceivedFrameId : 16|11@1+ (1,0) [0|2047] "" RADAR_REAR_CORNER_LEFT
 SG_ ReceivedCounter : 27|4@1+ (1,0) [0|15] "" RADAR_REAR_CORNER_LEFT
 SG_ ChecksumOk : 31|1@1+ (1,0) [0|1] "" RADAR_REAR_CORNER_LEFT
 SG_ PayloadLength : 32|8@1+ (1,0) [0|64] "byte" RADAR_REAR_CORNER_LEFT
 SG_ ErrorCode : 40|8@1+ (1,0) [0|255] "" RADAR_REAR_CORNER_LEFT
 SG_ ProcessingTimeUs : 48|16@1+ (1,0) [0|65535] "us" RADAR_REAR_CORNER_LEFT
 SG_ ResponseSequence : 64|16@1+ (1,0) [0|65535] "" RADAR_REAR_CORNER_LEFT
 SG_ ReceivedCrc : 80|8@1+ (1,0) [0|255] "" RADAR_REAR_CORNER_LEFT
 SG_ CalculatedCrc : 88|8@1+ (1,0) [0|255] "" RADAR_REAR_CORNER_LEFT
CM_ BO_ 1542 "Cycle=10ms; Channel=CAN1; CAN-FD; NominalBitrate=500kbit/s; DataBitrate=2000kbit/s;  ResponseFor=0x186; ACK/NACK with CRC, DLC and counter check;";

BO_ 391 DATA_007_IMU_YAW_RATE_SENSOR_VEHICLE_DYNAMICS_TO_ADAS_DOMAIN: 64 IMU_YAW_RATE_SENSOR
 SG_ CRC8 : 0|8@1+ (1,0) [0|255] "" ADAS_DOMAIN
 SG_ AliveCounter : 8|4@1+ (1,0) [0|15] "" ADAS_DOMAIN
 SG_ MuxState : 12|4@1+ (1,0) [0|15] "" ADAS_DOMAIN
 SG_ SIG_187_00 : 16|12@1+ (0.1,0.0) [0|4095] "Nm" ADAS_DOMAIN
 SG_ SIG_187_01 : 28|12@1+ (0.1,0.0) [0|4095] "km/h" ADAS_DOMAIN
 SG_ SIG_187_02 : 40|12@1+ (0.1,0.0) [0|4095] "A" ADAS_DOMAIN
 SG_ SIG_187_03 : 52|12@1+ (0.1,0.0) [0|4095] "%" ADAS_DOMAIN
 SG_ SIG_187_04 : 64|12@1+ (0.1,0.0) [0|4095] "V" ADAS_DOMAIN
 SG_ SIG_187_05 : 76|12@1+ (0.1,0.0) [0|4095] "rpm" ADAS_DOMAIN
 SG_ SIG_187_06 : 88|12@1+ (0.1,0.0) [0|4095] "Nm" ADAS_DOMAIN
 SG_ SIG_187_07 : 100|12@1+ (0.1,0.0) [0|4095] "obj" ADAS_DOMAIN
 SG_ SIG_187_08 : 112|12@1+ (0.1,0.0) [0|4095] "A" ADAS_DOMAIN
 SG_ SIG_187_09 : 124|12@1+ (0.1,0.0) [0|4095] "Nm" ADAS_DOMAIN
 SG_ SIG_187_10 : 136|12@1+ (0.1,0.0) [0|4095] "C" ADAS_DOMAIN
 SG_ SIG_187_11 : 148|12@1+ (0.1,0.0) [0|4095] "%" ADAS_DOMAIN
 SG_ RouteInfoChar_00 : 160|8@1+ (1,0) [0|255] "ascii" ADAS_DOMAIN
 SG_ RouteInfoChar_01 : 168|8@1+ (1,0) [0|255] "ascii" ADAS_DOMAIN
 SG_ RouteInfoChar_02 : 176|8@1+ (1,0) [0|255] "ascii" ADAS_DOMAIN
 SG_ RouteInfoChar_03 : 184|8@1+ (1,0) [0|255] "ascii" ADAS_DOMAIN
 SG_ RouteInfoChar_04 : 192|8@1+ (1,0) [0|255] "ascii" ADAS_DOMAIN
 SG_ RouteInfoChar_05 : 200|8@1+ (1,0) [0|255] "ascii" ADAS_DOMAIN
 SG_ RouteInfoChar_06 : 208|8@1+ (1,0) [0|255] "ascii" ADAS_DOMAIN
 SG_ RouteInfoChar_07 : 216|8@1+ (1,0) [0|255] "ascii" ADAS_DOMAIN
 SG_ RouteInfoChar_08 : 224|8@1+ (1,0) [0|255] "ascii" ADAS_DOMAIN
 SG_ RouteInfoChar_09 : 232|8@1+ (1,0) [0|255] "ascii" ADAS_DOMAIN
 SG_ RouteInfoChar_10 : 240|8@1+ (1,0) [0|255] "ascii" ADAS_DOMAIN
 SG_ RouteInfoChar_11 : 248|8@1+ (1,0) [0|255] "ascii" ADAS_DOMAIN
 SG_ RouteInfoChar_12 : 256|8@1+ (1,0) [0|255] "ascii" ADAS_DOMAIN
 SG_ RouteInfoChar_13 : 264|8@1+ (1,0) [0|255] "ascii" ADAS_DOMAIN
 SG_ RouteInfoChar_14 : 272|8@1+ (1,0) [0|255] "ascii" ADAS_DOMAIN
 SG_ RouteInfoChar_15 : 280|8@1+ (1,0) [0|255] "ascii" ADAS_DOMAIN
 SG_ RouteInfoChar_16 : 288|8@1+ (1,0) [0|255] "ascii" ADAS_DOMAIN
 SG_ RouteInfoChar_17 : 296|8@1+ (1,0) [0|255] "ascii" ADAS_DOMAIN
 SG_ RouteInfoChar_18 : 304|8@1+ (1,0) [0|255] "ascii" ADAS_DOMAIN
 SG_ RouteInfoChar_19 : 312|8@1+ (1,0) [0|255] "ascii" ADAS_DOMAIN
 SG_ RouteInfoChar_20 : 320|8@1+ (1,0) [0|255] "ascii" ADAS_DOMAIN
 SG_ RouteInfoChar_21 : 328|8@1+ (1,0) [0|255] "ascii" ADAS_DOMAIN
 SG_ RouteInfoChar_22 : 336|8@1+ (1,0) [0|255] "ascii" ADAS_DOMAIN
 SG_ RouteInfoChar_23 : 344|8@1+ (1,0) [0|255] "ascii" ADAS_DOMAIN
 SG_ RouteInfoChar_24 : 352|8@1+ (1,0) [0|255] "ascii" ADAS_DOMAIN
 SG_ RouteInfoChar_25 : 360|8@1+ (1,0) [0|255] "ascii" ADAS_DOMAIN
 SG_ RouteInfoChar_26 : 368|8@1+ (1,0) [0|255] "ascii" ADAS_DOMAIN
 SG_ RouteInfoChar_27 : 376|8@1+ (1,0) [0|255] "ascii" ADAS_DOMAIN
 SG_ RouteInfoChar_28 : 384|8@1+ (1,0) [0|255] "ascii" ADAS_DOMAIN
 SG_ RouteInfoChar_29 : 392|8@1+ (1,0) [0|255] "ascii" ADAS_DOMAIN
 SG_ RouteInfoChar_30 : 400|8@1+ (1,0) [0|255] "ascii" ADAS_DOMAIN
 SG_ RouteInfoChar_31 : 408|8@1+ (1,0) [0|255] "ascii" ADAS_DOMAIN
 SG_ RouteInfoChar_32 : 416|8@1+ (1,0) [0|255] "ascii" ADAS_DOMAIN
 SG_ RouteInfoChar_33 : 424|8@1+ (1,0) [0|255] "ascii" ADAS_DOMAIN
 SG_ RouteInfoChar_34 : 432|8@1+ (1,0) [0|255] "ascii" ADAS_DOMAIN
 SG_ RouteInfoChar_35 : 440|8@1+ (1,0) [0|255] "ascii" ADAS_DOMAIN
 SG_ RouteInfoChar_36 : 448|8@1+ (1,0) [0|255] "ascii" ADAS_DOMAIN
 SG_ RouteInfoChar_37 : 456|8@1+ (1,0) [0|255] "ascii" ADAS_DOMAIN
 SG_ RouteInfoChar_38 : 464|8@1+ (1,0) [0|255] "ascii" ADAS_DOMAIN
 SG_ RouteInfoChar_39 : 472|8@1+ (1,0) [0|255] "ascii" ADAS_DOMAIN
 SG_ RouteInfoChar_40 : 480|8@1+ (1,0) [0|255] "ascii" ADAS_DOMAIN
 SG_ RouteInfoChar_41 : 488|8@1+ (1,0) [0|255] "ascii" ADAS_DOMAIN
 SG_ RouteInfoChar_42 : 496|8@1+ (1,0) [0|255] "ascii" ADAS_DOMAIN
 SG_ RouteInfoChar_43 : 504|8@1+ (1,0) [0|255] "ascii" ADAS_DOMAIN
CM_ BO_ 391 "Cycle=10ms; Channel=CAN0; CAN-FD; NominalBitrate=500kbit/s; DataBitrate=2000kbit/s;  Data request; receiver answers with response frame; PayloadRouteInfo='IMU_YAW_RATE_SENSOR -> ADAS_DOMAIN' in bytes 20-63;";

BO_ 1543 RESP_007_ADAS_DOMAIN_TO_IMU_YAW_RATE_SENSOR: 16 ADAS_DOMAIN
 SG_ CRC8 : 0|8@1+ (1,0) [0|255] "" IMU_YAW_RATE_SENSOR
 SG_ ResponseCounter : 8|4@1+ (1,0) [0|15] "" IMU_YAW_RATE_SENSOR
 SG_ AckState : 12|4@1+ (1,0) [0|15] "" IMU_YAW_RATE_SENSOR
 SG_ ReceivedFrameId : 16|11@1+ (1,0) [0|2047] "" IMU_YAW_RATE_SENSOR
 SG_ ReceivedCounter : 27|4@1+ (1,0) [0|15] "" IMU_YAW_RATE_SENSOR
 SG_ ChecksumOk : 31|1@1+ (1,0) [0|1] "" IMU_YAW_RATE_SENSOR
 SG_ PayloadLength : 32|8@1+ (1,0) [0|64] "byte" IMU_YAW_RATE_SENSOR
 SG_ ErrorCode : 40|8@1+ (1,0) [0|255] "" IMU_YAW_RATE_SENSOR
 SG_ ProcessingTimeUs : 48|16@1+ (1,0) [0|65535] "us" IMU_YAW_RATE_SENSOR
 SG_ ResponseSequence : 64|16@1+ (1,0) [0|65535] "" IMU_YAW_RATE_SENSOR
 SG_ ReceivedCrc : 80|8@1+ (1,0) [0|255] "" IMU_YAW_RATE_SENSOR
 SG_ CalculatedCrc : 88|8@1+ (1,0) [0|255] "" IMU_YAW_RATE_SENSOR
CM_ BO_ 1543 "Cycle=10ms; Channel=CAN0; CAN-FD; NominalBitrate=500kbit/s; DataBitrate=2000kbit/s;  ResponseFor=0x187; ACK/NACK with CRC, DLC and counter check;";

BO_ 392 DATA_008_BRAKE_CONTROLLER_BRAKE_STATUS_TO_ADAS_DOMAIN: 64 BRAKE_CONTROLLER
 SG_ CRC8 : 0|8@1+ (1,0) [0|255] "" ADAS_DOMAIN
 SG_ AliveCounter : 8|4@1+ (1,0) [0|15] "" ADAS_DOMAIN
 SG_ MuxState : 12|4@1+ (1,0) [0|15] "" ADAS_DOMAIN
 SG_ SIG_188_00 : 16|12@1+ (0.1,0.0) [0|4095] "C" ADAS_DOMAIN
 SG_ SIG_188_01 : 28|12@1+ (0.1,0.0) [0|4095] "deg" ADAS_DOMAIN
 SG_ SIG_188_02 : 40|12@1+ (0.1,0.0) [0|4095] "V" ADAS_DOMAIN
 SG_ SIG_188_03 : 52|12@1+ (0.1,0.0) [0|4095] "deg" ADAS_DOMAIN
 SG_ SIG_188_04 : 64|12@1+ (0.1,0.0) [0|4095] "Nm" ADAS_DOMAIN
 SG_ SIG_188_05 : 76|12@1+ (0.1,0.0) [0|4095] "m" ADAS_DOMAIN
 SG_ SIG_188_06 : 88|12@1+ (0.1,0.0) [0|4095] "m" ADAS_DOMAIN
 SG_ SIG_188_07 : 100|12@1+ (0.1,0.0) [0|4095] "V" ADAS_DOMAIN
 SG_ SIG_188_08 : 112|12@1+ (0.1,0.0) [0|4095] "obj" ADAS_DOMAIN
 SG_ SIG_188_09 : 124|12@1+ (0.1,0.0) [0|4095] "%" ADAS_DOMAIN
 SG_ SIG_188_10 : 136|12@1+ (0.1,0.0) [0|4095] "obj" ADAS_DOMAIN
 SG_ SIG_188_11 : 148|12@1+ (0.1,0.0) [0|4095] "%" ADAS_DOMAIN
 SG_ RouteInfoChar_00 : 160|8@1+ (1,0) [0|255] "ascii" ADAS_DOMAIN
 SG_ RouteInfoChar_01 : 168|8@1+ (1,0) [0|255] "ascii" ADAS_DOMAIN
 SG_ RouteInfoChar_02 : 176|8@1+ (1,0) [0|255] "ascii" ADAS_DOMAIN
 SG_ RouteInfoChar_03 : 184|8@1+ (1,0) [0|255] "ascii" ADAS_DOMAIN
 SG_ RouteInfoChar_04 : 192|8@1+ (1,0) [0|255] "ascii" ADAS_DOMAIN
 SG_ RouteInfoChar_05 : 200|8@1+ (1,0) [0|255] "ascii" ADAS_DOMAIN
 SG_ RouteInfoChar_06 : 208|8@1+ (1,0) [0|255] "ascii" ADAS_DOMAIN
 SG_ RouteInfoChar_07 : 216|8@1+ (1,0) [0|255] "ascii" ADAS_DOMAIN
 SG_ RouteInfoChar_08 : 224|8@1+ (1,0) [0|255] "ascii" ADAS_DOMAIN
 SG_ RouteInfoChar_09 : 232|8@1+ (1,0) [0|255] "ascii" ADAS_DOMAIN
 SG_ RouteInfoChar_10 : 240|8@1+ (1,0) [0|255] "ascii" ADAS_DOMAIN
 SG_ RouteInfoChar_11 : 248|8@1+ (1,0) [0|255] "ascii" ADAS_DOMAIN
 SG_ RouteInfoChar_12 : 256|8@1+ (1,0) [0|255] "ascii" ADAS_DOMAIN
 SG_ RouteInfoChar_13 : 264|8@1+ (1,0) [0|255] "ascii" ADAS_DOMAIN
 SG_ RouteInfoChar_14 : 272|8@1+ (1,0) [0|255] "ascii" ADAS_DOMAIN
 SG_ RouteInfoChar_15 : 280|8@1+ (1,0) [0|255] "ascii" ADAS_DOMAIN
 SG_ RouteInfoChar_16 : 288|8@1+ (1,0) [0|255] "ascii" ADAS_DOMAIN
 SG_ RouteInfoChar_17 : 296|8@1+ (1,0) [0|255] "ascii" ADAS_DOMAIN
 SG_ RouteInfoChar_18 : 304|8@1+ (1,0) [0|255] "ascii" ADAS_DOMAIN
 SG_ RouteInfoChar_19 : 312|8@1+ (1,0) [0|255] "ascii" ADAS_DOMAIN
 SG_ RouteInfoChar_20 : 320|8@1+ (1,0) [0|255] "ascii" ADAS_DOMAIN
 SG_ RouteInfoChar_21 : 328|8@1+ (1,0) [0|255] "ascii" ADAS_DOMAIN
 SG_ RouteInfoChar_22 : 336|8@1+ (1,0) [0|255] "ascii" ADAS_DOMAIN
 SG_ RouteInfoChar_23 : 344|8@1+ (1,0) [0|255] "ascii" ADAS_DOMAIN
 SG_ RouteInfoChar_24 : 352|8@1+ (1,0) [0|255] "ascii" ADAS_DOMAIN
 SG_ RouteInfoChar_25 : 360|8@1+ (1,0) [0|255] "ascii" ADAS_DOMAIN
 SG_ RouteInfoChar_26 : 368|8@1+ (1,0) [0|255] "ascii" ADAS_DOMAIN
 SG_ RouteInfoChar_27 : 376|8@1+ (1,0) [0|255] "ascii" ADAS_DOMAIN
 SG_ RouteInfoChar_28 : 384|8@1+ (1,0) [0|255] "ascii" ADAS_DOMAIN
 SG_ RouteInfoChar_29 : 392|8@1+ (1,0) [0|255] "ascii" ADAS_DOMAIN
 SG_ RouteInfoChar_30 : 400|8@1+ (1,0) [0|255] "ascii" ADAS_DOMAIN
 SG_ RouteInfoChar_31 : 408|8@1+ (1,0) [0|255] "ascii" ADAS_DOMAIN
 SG_ RouteInfoChar_32 : 416|8@1+ (1,0) [0|255] "ascii" ADAS_DOMAIN
 SG_ RouteInfoChar_33 : 424|8@1+ (1,0) [0|255] "ascii" ADAS_DOMAIN
 SG_ RouteInfoChar_34 : 432|8@1+ (1,0) [0|255] "ascii" ADAS_DOMAIN
 SG_ RouteInfoChar_35 : 440|8@1+ (1,0) [0|255] "ascii" ADAS_DOMAIN
 SG_ RouteInfoChar_36 : 448|8@1+ (1,0) [0|255] "ascii" ADAS_DOMAIN
 SG_ RouteInfoChar_37 : 456|8@1+ (1,0) [0|255] "ascii" ADAS_DOMAIN
 SG_ RouteInfoChar_38 : 464|8@1+ (1,0) [0|255] "ascii" ADAS_DOMAIN
 SG_ RouteInfoChar_39 : 472|8@1+ (1,0) [0|255] "ascii" ADAS_DOMAIN
 SG_ RouteInfoChar_40 : 480|8@1+ (1,0) [0|255] "ascii" ADAS_DOMAIN
 SG_ RouteInfoChar_41 : 488|8@1+ (1,0) [0|255] "ascii" ADAS_DOMAIN
 SG_ RouteInfoChar_42 : 496|8@1+ (1,0) [0|255] "ascii" ADAS_DOMAIN
 SG_ RouteInfoChar_43 : 504|8@1+ (1,0) [0|255] "ascii" ADAS_DOMAIN
CM_ BO_ 392 "Cycle=10ms; Channel=CAN2; CAN-FD; NominalBitrate=500kbit/s; DataBitrate=2000kbit/s;  Data request; receiver answers with response frame; PayloadRouteInfo='BRAKE_CONTROLLER -> ADAS_DOMAIN' in bytes 20-63;";

BO_ 1544 RESP_008_ADAS_DOMAIN_TO_BRAKE_CONTROLLER: 16 ADAS_DOMAIN
 SG_ CRC8 : 0|8@1+ (1,0) [0|255] "" BRAKE_CONTROLLER
 SG_ ResponseCounter : 8|4@1+ (1,0) [0|15] "" BRAKE_CONTROLLER
 SG_ AckState : 12|4@1+ (1,0) [0|15] "" BRAKE_CONTROLLER
 SG_ ReceivedFrameId : 16|11@1+ (1,0) [0|2047] "" BRAKE_CONTROLLER
 SG_ ReceivedCounter : 27|4@1+ (1,0) [0|15] "" BRAKE_CONTROLLER
 SG_ ChecksumOk : 31|1@1+ (1,0) [0|1] "" BRAKE_CONTROLLER
 SG_ PayloadLength : 32|8@1+ (1,0) [0|64] "byte" BRAKE_CONTROLLER
 SG_ ErrorCode : 40|8@1+ (1,0) [0|255] "" BRAKE_CONTROLLER
 SG_ ProcessingTimeUs : 48|16@1+ (1,0) [0|65535] "us" BRAKE_CONTROLLER
 SG_ ResponseSequence : 64|16@1+ (1,0) [0|65535] "" BRAKE_CONTROLLER
 SG_ ReceivedCrc : 80|8@1+ (1,0) [0|255] "" BRAKE_CONTROLLER
 SG_ CalculatedCrc : 88|8@1+ (1,0) [0|255] "" BRAKE_CONTROLLER
CM_ BO_ 1544 "Cycle=10ms; Channel=CAN2; CAN-FD; NominalBitrate=500kbit/s; DataBitrate=2000kbit/s;  ResponseFor=0x188; ACK/NACK with CRC, DLC and counter check;";

BO_ 393 DATA_009_BRAKE_CONTROLLER_BRAKE_STATUS_TO_DIAG_TESTER: 64 BRAKE_CONTROLLER
 SG_ CRC8 : 0|8@1+ (1,0) [0|255] "" DIAG_TESTER
 SG_ AliveCounter : 8|4@1+ (1,0) [0|15] "" DIAG_TESTER
 SG_ MuxState : 12|4@1+ (1,0) [0|15] "" DIAG_TESTER
 SG_ SIG_189_00 : 16|12@1+ (0.1,0.0) [0|4095] "A" DIAG_TESTER
 SG_ SIG_189_01 : 28|12@1+ (0.1,0.0) [0|4095] "Nm" DIAG_TESTER
 SG_ SIG_189_02 : 40|12@1+ (0.1,0.0) [0|4095] "deg" DIAG_TESTER
 SG_ SIG_189_03 : 52|12@1+ (0.1,0.0) [0|4095] "m" DIAG_TESTER
 SG_ SIG_189_04 : 64|12@1+ (0.1,0.0) [0|4095] "C" DIAG_TESTER
 SG_ SIG_189_05 : 76|12@1+ (0.1,0.0) [0|4095] "rpm" DIAG_TESTER
 SG_ SIG_189_06 : 88|12@1+ (0.1,0.0) [0|4095] "km/h" DIAG_TESTER
 SG_ SIG_189_07 : 100|12@1+ (0.1,0.0) [0|4095] "rpm" DIAG_TESTER
 SG_ SIG_189_08 : 112|12@1+ (0.1,0.0) [0|4095] "deg" DIAG_TESTER
 SG_ SIG_189_09 : 124|12@1+ (0.1,0.0) [0|4095] "deg" DIAG_TESTER
 SG_ SIG_189_10 : 136|12@1+ (0.1,0.0) [0|4095] "%" DIAG_TESTER
 SG_ SIG_189_11 : 148|12@1+ (0.1,0.0) [0|4095] "obj" DIAG_TESTER
 SG_ RouteInfoChar_00 : 160|8@1+ (1,0) [0|255] "ascii" DIAG_TESTER
 SG_ RouteInfoChar_01 : 168|8@1+ (1,0) [0|255] "ascii" DIAG_TESTER
 SG_ RouteInfoChar_02 : 176|8@1+ (1,0) [0|255] "ascii" DIAG_TESTER
 SG_ RouteInfoChar_03 : 184|8@1+ (1,0) [0|255] "ascii" DIAG_TESTER
 SG_ RouteInfoChar_04 : 192|8@1+ (1,0) [0|255] "ascii" DIAG_TESTER
 SG_ RouteInfoChar_05 : 200|8@1+ (1,0) [0|255] "ascii" DIAG_TESTER
 SG_ RouteInfoChar_06 : 208|8@1+ (1,0) [0|255] "ascii" DIAG_TESTER
 SG_ RouteInfoChar_07 : 216|8@1+ (1,0) [0|255] "ascii" DIAG_TESTER
 SG_ RouteInfoChar_08 : 224|8@1+ (1,0) [0|255] "ascii" DIAG_TESTER
 SG_ RouteInfoChar_09 : 232|8@1+ (1,0) [0|255] "ascii" DIAG_TESTER
 SG_ RouteInfoChar_10 : 240|8@1+ (1,0) [0|255] "ascii" DIAG_TESTER
 SG_ RouteInfoChar_11 : 248|8@1+ (1,0) [0|255] "ascii" DIAG_TESTER
 SG_ RouteInfoChar_12 : 256|8@1+ (1,0) [0|255] "ascii" DIAG_TESTER
 SG_ RouteInfoChar_13 : 264|8@1+ (1,0) [0|255] "ascii" DIAG_TESTER
 SG_ RouteInfoChar_14 : 272|8@1+ (1,0) [0|255] "ascii" DIAG_TESTER
 SG_ RouteInfoChar_15 : 280|8@1+ (1,0) [0|255] "ascii" DIAG_TESTER
 SG_ RouteInfoChar_16 : 288|8@1+ (1,0) [0|255] "ascii" DIAG_TESTER
 SG_ RouteInfoChar_17 : 296|8@1+ (1,0) [0|255] "ascii" DIAG_TESTER
 SG_ RouteInfoChar_18 : 304|8@1+ (1,0) [0|255] "ascii" DIAG_TESTER
 SG_ RouteInfoChar_19 : 312|8@1+ (1,0) [0|255] "ascii" DIAG_TESTER
 SG_ RouteInfoChar_20 : 320|8@1+ (1,0) [0|255] "ascii" DIAG_TESTER
 SG_ RouteInfoChar_21 : 328|8@1+ (1,0) [0|255] "ascii" DIAG_TESTER
 SG_ RouteInfoChar_22 : 336|8@1+ (1,0) [0|255] "ascii" DIAG_TESTER
 SG_ RouteInfoChar_23 : 344|8@1+ (1,0) [0|255] "ascii" DIAG_TESTER
 SG_ RouteInfoChar_24 : 352|8@1+ (1,0) [0|255] "ascii" DIAG_TESTER
 SG_ RouteInfoChar_25 : 360|8@1+ (1,0) [0|255] "ascii" DIAG_TESTER
 SG_ RouteInfoChar_26 : 368|8@1+ (1,0) [0|255] "ascii" DIAG_TESTER
 SG_ RouteInfoChar_27 : 376|8@1+ (1,0) [0|255] "ascii" DIAG_TESTER
 SG_ RouteInfoChar_28 : 384|8@1+ (1,0) [0|255] "ascii" DIAG_TESTER
 SG_ RouteInfoChar_29 : 392|8@1+ (1,0) [0|255] "ascii" DIAG_TESTER
 SG_ RouteInfoChar_30 : 400|8@1+ (1,0) [0|255] "ascii" DIAG_TESTER
 SG_ RouteInfoChar_31 : 408|8@1+ (1,0) [0|255] "ascii" DIAG_TESTER
 SG_ RouteInfoChar_32 : 416|8@1+ (1,0) [0|255] "ascii" DIAG_TESTER
 SG_ RouteInfoChar_33 : 424|8@1+ (1,0) [0|255] "ascii" DIAG_TESTER
 SG_ RouteInfoChar_34 : 432|8@1+ (1,0) [0|255] "ascii" DIAG_TESTER
 SG_ RouteInfoChar_35 : 440|8@1+ (1,0) [0|255] "ascii" DIAG_TESTER
 SG_ RouteInfoChar_36 : 448|8@1+ (1,0) [0|255] "ascii" DIAG_TESTER
 SG_ RouteInfoChar_37 : 456|8@1+ (1,0) [0|255] "ascii" DIAG_TESTER
 SG_ RouteInfoChar_38 : 464|8@1+ (1,0) [0|255] "ascii" DIAG_TESTER
 SG_ RouteInfoChar_39 : 472|8@1+ (1,0) [0|255] "ascii" DIAG_TESTER
 SG_ RouteInfoChar_40 : 480|8@1+ (1,0) [0|255] "ascii" DIAG_TESTER
 SG_ RouteInfoChar_41 : 488|8@1+ (1,0) [0|255] "ascii" DIAG_TESTER
 SG_ RouteInfoChar_42 : 496|8@1+ (1,0) [0|255] "ascii" DIAG_TESTER
 SG_ RouteInfoChar_43 : 504|8@1+ (1,0) [0|255] "ascii" DIAG_TESTER
CM_ BO_ 393 "Cycle=10ms; Channel=CAN2; CAN-FD; NominalBitrate=500kbit/s; DataBitrate=2000kbit/s;  Data request; receiver answers with response frame; PayloadRouteInfo='BRAKE_CONTROLLER -> DIAG_TESTER' in bytes 20-63; Gateway to CAN3";

BO_ 1545 RESP_009_DIAG_TESTER_TO_BRAKE_CONTROLLER: 16 DIAG_TESTER
 SG_ CRC8 : 0|8@1+ (1,0) [0|255] "" BRAKE_CONTROLLER
 SG_ ResponseCounter : 8|4@1+ (1,0) [0|15] "" BRAKE_CONTROLLER
 SG_ AckState : 12|4@1+ (1,0) [0|15] "" BRAKE_CONTROLLER
 SG_ ReceivedFrameId : 16|11@1+ (1,0) [0|2047] "" BRAKE_CONTROLLER
 SG_ ReceivedCounter : 27|4@1+ (1,0) [0|15] "" BRAKE_CONTROLLER
 SG_ ChecksumOk : 31|1@1+ (1,0) [0|1] "" BRAKE_CONTROLLER
 SG_ PayloadLength : 32|8@1+ (1,0) [0|64] "byte" BRAKE_CONTROLLER
 SG_ ErrorCode : 40|8@1+ (1,0) [0|255] "" BRAKE_CONTROLLER
 SG_ ProcessingTimeUs : 48|16@1+ (1,0) [0|65535] "us" BRAKE_CONTROLLER
 SG_ ResponseSequence : 64|16@1+ (1,0) [0|65535] "" BRAKE_CONTROLLER
 SG_ ReceivedCrc : 80|8@1+ (1,0) [0|255] "" BRAKE_CONTROLLER
 SG_ CalculatedCrc : 88|8@1+ (1,0) [0|255] "" BRAKE_CONTROLLER
CM_ BO_ 1545 "Cycle=10ms; Channel=CAN2; CAN-FD; NominalBitrate=500kbit/s; DataBitrate=2000kbit/s;  ResponseFor=0x189; ACK/NACK with CRC, DLC and counter check;";

BO_ 394 DATA_010_STEERING_CONTROLLER_STEERING_STATUS_TO_ADAS_DOMAIN: 64 STEERING_CONTROLLER
 SG_ CRC8 : 0|8@1+ (1,0) [0|255] "" ADAS_DOMAIN
 SG_ AliveCounter : 8|4@1+ (1,0) [0|15] "" ADAS_DOMAIN
 SG_ MuxState : 12|4@1+ (1,0) [0|15] "" ADAS_DOMAIN
 SG_ SIG_18A_00 : 16|12@1+ (0.1,0.0) [0|4095] "rpm" ADAS_DOMAIN
 SG_ SIG_18A_01 : 28|12@1+ (0.1,0.0) [0|4095] "%" ADAS_DOMAIN
 SG_ SIG_18A_02 : 40|12@1+ (0.1,0.0) [0|4095] "%" ADAS_DOMAIN
 SG_ SIG_18A_03 : 52|12@1+ (0.1,0.0) [0|4095] "obj" ADAS_DOMAIN
 SG_ SIG_18A_04 : 64|12@1+ (0.1,0.0) [0|4095] "C" ADAS_DOMAIN
 SG_ SIG_18A_05 : 76|12@1+ (0.1,0.0) [0|4095] "m" ADAS_DOMAIN
 SG_ SIG_18A_06 : 88|12@1+ (0.1,0.0) [0|4095] "V" ADAS_DOMAIN
 SG_ SIG_18A_07 : 100|12@1+ (0.1,0.0) [0|4095] "m" ADAS_DOMAIN
 SG_ SIG_18A_08 : 112|12@1+ (0.1,0.0) [0|4095] "km/h" ADAS_DOMAIN
 SG_ SIG_18A_09 : 124|12@1+ (0.1,0.0) [0|4095] "rpm" ADAS_DOMAIN
 SG_ SIG_18A_10 : 136|12@1+ (0.1,0.0) [0|4095] "m" ADAS_DOMAIN
 SG_ SIG_18A_11 : 148|12@1+ (0.1,0.0) [0|4095] "V" ADAS_DOMAIN
 SG_ RouteInfoChar_00 : 160|8@1+ (1,0) [0|255] "ascii" ADAS_DOMAIN
 SG_ RouteInfoChar_01 : 168|8@1+ (1,0) [0|255] "ascii" ADAS_DOMAIN
 SG_ RouteInfoChar_02 : 176|8@1+ (1,0) [0|255] "ascii" ADAS_DOMAIN
 SG_ RouteInfoChar_03 : 184|8@1+ (1,0) [0|255] "ascii" ADAS_DOMAIN
 SG_ RouteInfoChar_04 : 192|8@1+ (1,0) [0|255] "ascii" ADAS_DOMAIN
 SG_ RouteInfoChar_05 : 200|8@1+ (1,0) [0|255] "ascii" ADAS_DOMAIN
 SG_ RouteInfoChar_06 : 208|8@1+ (1,0) [0|255] "ascii" ADAS_DOMAIN
 SG_ RouteInfoChar_07 : 216|8@1+ (1,0) [0|255] "ascii" ADAS_DOMAIN
 SG_ RouteInfoChar_08 : 224|8@1+ (1,0) [0|255] "ascii" ADAS_DOMAIN
 SG_ RouteInfoChar_09 : 232|8@1+ (1,0) [0|255] "ascii" ADAS_DOMAIN
 SG_ RouteInfoChar_10 : 240|8@1+ (1,0) [0|255] "ascii" ADAS_DOMAIN
 SG_ RouteInfoChar_11 : 248|8@1+ (1,0) [0|255] "ascii" ADAS_DOMAIN
 SG_ RouteInfoChar_12 : 256|8@1+ (1,0) [0|255] "ascii" ADAS_DOMAIN
 SG_ RouteInfoChar_13 : 264|8@1+ (1,0) [0|255] "ascii" ADAS_DOMAIN
 SG_ RouteInfoChar_14 : 272|8@1+ (1,0) [0|255] "ascii" ADAS_DOMAIN
 SG_ RouteInfoChar_15 : 280|8@1+ (1,0) [0|255] "ascii" ADAS_DOMAIN
 SG_ RouteInfoChar_16 : 288|8@1+ (1,0) [0|255] "ascii" ADAS_DOMAIN
 SG_ RouteInfoChar_17 : 296|8@1+ (1,0) [0|255] "ascii" ADAS_DOMAIN
 SG_ RouteInfoChar_18 : 304|8@1+ (1,0) [0|255] "ascii" ADAS_DOMAIN
 SG_ RouteInfoChar_19 : 312|8@1+ (1,0) [0|255] "ascii" ADAS_DOMAIN
 SG_ RouteInfoChar_20 : 320|8@1+ (1,0) [0|255] "ascii" ADAS_DOMAIN
 SG_ RouteInfoChar_21 : 328|8@1+ (1,0) [0|255] "ascii" ADAS_DOMAIN
 SG_ RouteInfoChar_22 : 336|8@1+ (1,0) [0|255] "ascii" ADAS_DOMAIN
 SG_ RouteInfoChar_23 : 344|8@1+ (1,0) [0|255] "ascii" ADAS_DOMAIN
 SG_ RouteInfoChar_24 : 352|8@1+ (1,0) [0|255] "ascii" ADAS_DOMAIN
 SG_ RouteInfoChar_25 : 360|8@1+ (1,0) [0|255] "ascii" ADAS_DOMAIN
 SG_ RouteInfoChar_26 : 368|8@1+ (1,0) [0|255] "ascii" ADAS_DOMAIN
 SG_ RouteInfoChar_27 : 376|8@1+ (1,0) [0|255] "ascii" ADAS_DOMAIN
 SG_ RouteInfoChar_28 : 384|8@1+ (1,0) [0|255] "ascii" ADAS_DOMAIN
 SG_ RouteInfoChar_29 : 392|8@1+ (1,0) [0|255] "ascii" ADAS_DOMAIN
 SG_ RouteInfoChar_30 : 400|8@1+ (1,0) [0|255] "ascii" ADAS_DOMAIN
 SG_ RouteInfoChar_31 : 408|8@1+ (1,0) [0|255] "ascii" ADAS_DOMAIN
 SG_ RouteInfoChar_32 : 416|8@1+ (1,0) [0|255] "ascii" ADAS_DOMAIN
 SG_ RouteInfoChar_33 : 424|8@1+ (1,0) [0|255] "ascii" ADAS_DOMAIN
 SG_ RouteInfoChar_34 : 432|8@1+ (1,0) [0|255] "ascii" ADAS_DOMAIN
 SG_ RouteInfoChar_35 : 440|8@1+ (1,0) [0|255] "ascii" ADAS_DOMAIN
 SG_ RouteInfoChar_36 : 448|8@1+ (1,0) [0|255] "ascii" ADAS_DOMAIN
 SG_ RouteInfoChar_37 : 456|8@1+ (1,0) [0|255] "ascii" ADAS_DOMAIN
 SG_ RouteInfoChar_38 : 464|8@1+ (1,0) [0|255] "ascii" ADAS_DOMAIN
 SG_ RouteInfoChar_39 : 472|8@1+ (1,0) [0|255] "ascii" ADAS_DOMAIN
 SG_ RouteInfoChar_40 : 480|8@1+ (1,0) [0|255] "ascii" ADAS_DOMAIN
 SG_ RouteInfoChar_41 : 488|8@1+ (1,0) [0|255] "ascii" ADAS_DOMAIN
 SG_ RouteInfoChar_42 : 496|8@1+ (1,0) [0|255] "ascii" ADAS_DOMAIN
 SG_ RouteInfoChar_43 : 504|8@1+ (1,0) [0|255] "ascii" ADAS_DOMAIN
CM_ BO_ 394 "Cycle=10ms; Channel=CAN2; CAN-FD; NominalBitrate=500kbit/s; DataBitrate=2000kbit/s;  Data request; receiver answers with response frame; PayloadRouteInfo='STEERING_CONTROLLER -> ADAS_DOMAIN' in bytes 20-63;";

BO_ 1546 RESP_010_ADAS_DOMAIN_TO_STEERING_CONTROLLER: 16 ADAS_DOMAIN
 SG_ CRC8 : 0|8@1+ (1,0) [0|255] "" STEERING_CONTROLLER
 SG_ ResponseCounter : 8|4@1+ (1,0) [0|15] "" STEERING_CONTROLLER
 SG_ AckState : 12|4@1+ (1,0) [0|15] "" STEERING_CONTROLLER
 SG_ ReceivedFrameId : 16|11@1+ (1,0) [0|2047] "" STEERING_CONTROLLER
 SG_ ReceivedCounter : 27|4@1+ (1,0) [0|15] "" STEERING_CONTROLLER
 SG_ ChecksumOk : 31|1@1+ (1,0) [0|1] "" STEERING_CONTROLLER
 SG_ PayloadLength : 32|8@1+ (1,0) [0|64] "byte" STEERING_CONTROLLER
 SG_ ErrorCode : 40|8@1+ (1,0) [0|255] "" STEERING_CONTROLLER
 SG_ ProcessingTimeUs : 48|16@1+ (1,0) [0|65535] "us" STEERING_CONTROLLER
 SG_ ResponseSequence : 64|16@1+ (1,0) [0|65535] "" STEERING_CONTROLLER
 SG_ ReceivedCrc : 80|8@1+ (1,0) [0|255] "" STEERING_CONTROLLER
 SG_ CalculatedCrc : 88|8@1+ (1,0) [0|255] "" STEERING_CONTROLLER
CM_ BO_ 1546 "Cycle=10ms; Channel=CAN2; CAN-FD; NominalBitrate=500kbit/s; DataBitrate=2000kbit/s;  ResponseFor=0x18A; ACK/NACK with CRC, DLC and counter check;";

BO_ 395 DATA_011_STEERING_CONTROLLER_STEERING_STATUS_TO_DIAG_TESTER: 64 STEERING_CONTROLLER
 SG_ CRC8 : 0|8@1+ (1,0) [0|255] "" DIAG_TESTER
 SG_ AliveCounter : 8|4@1+ (1,0) [0|15] "" DIAG_TESTER
 SG_ MuxState : 12|4@1+ (1,0) [0|15] "" DIAG_TESTER
 SG_ SIG_18B_00 : 16|12@1+ (0.1,0.0) [0|4095] "A" DIAG_TESTER
 SG_ SIG_18B_01 : 28|12@1+ (0.1,0.0) [0|4095] "rpm" DIAG_TESTER
 SG_ SIG_18B_02 : 40|12@1+ (0.1,0.0) [0|4095] "V" DIAG_TESTER
 SG_ SIG_18B_03 : 52|12@1+ (0.1,0.0) [0|4095] "%" DIAG_TESTER
 SG_ SIG_18B_04 : 64|12@1+ (0.1,0.0) [0|4095] "deg" DIAG_TESTER
 SG_ SIG_18B_05 : 76|12@1+ (0.1,0.0) [0|4095] "C" DIAG_TESTER
 SG_ SIG_18B_06 : 88|12@1+ (0.1,0.0) [0|4095] "km/h" DIAG_TESTER
 SG_ SIG_18B_07 : 100|12@1+ (0.1,0.0) [0|4095] "V" DIAG_TESTER
 SG_ SIG_18B_08 : 112|12@1+ (0.1,0.0) [0|4095] "m" DIAG_TESTER
 SG_ SIG_18B_09 : 124|12@1+ (0.1,0.0) [0|4095] "deg" DIAG_TESTER
 SG_ SIG_18B_10 : 136|12@1+ (0.1,0.0) [0|4095] "m" DIAG_TESTER
 SG_ SIG_18B_11 : 148|12@1+ (0.1,0.0) [0|4095] "rpm" DIAG_TESTER
 SG_ RouteInfoChar_00 : 160|8@1+ (1,0) [0|255] "ascii" DIAG_TESTER
 SG_ RouteInfoChar_01 : 168|8@1+ (1,0) [0|255] "ascii" DIAG_TESTER
 SG_ RouteInfoChar_02 : 176|8@1+ (1,0) [0|255] "ascii" DIAG_TESTER
 SG_ RouteInfoChar_03 : 184|8@1+ (1,0) [0|255] "ascii" DIAG_TESTER
 SG_ RouteInfoChar_04 : 192|8@1+ (1,0) [0|255] "ascii" DIAG_TESTER
 SG_ RouteInfoChar_05 : 200|8@1+ (1,0) [0|255] "ascii" DIAG_TESTER
 SG_ RouteInfoChar_06 : 208|8@1+ (1,0) [0|255] "ascii" DIAG_TESTER
 SG_ RouteInfoChar_07 : 216|8@1+ (1,0) [0|255] "ascii" DIAG_TESTER
 SG_ RouteInfoChar_08 : 224|8@1+ (1,0) [0|255] "ascii" DIAG_TESTER
 SG_ RouteInfoChar_09 : 232|8@1+ (1,0) [0|255] "ascii" DIAG_TESTER
 SG_ RouteInfoChar_10 : 240|8@1+ (1,0) [0|255] "ascii" DIAG_TESTER
 SG_ RouteInfoChar_11 : 248|8@1+ (1,0) [0|255] "ascii" DIAG_TESTER
 SG_ RouteInfoChar_12 : 256|8@1+ (1,0) [0|255] "ascii" DIAG_TESTER
 SG_ RouteInfoChar_13 : 264|8@1+ (1,0) [0|255] "ascii" DIAG_TESTER
 SG_ RouteInfoChar_14 : 272|8@1+ (1,0) [0|255] "ascii" DIAG_TESTER
 SG_ RouteInfoChar_15 : 280|8@1+ (1,0) [0|255] "ascii" DIAG_TESTER
 SG_ RouteInfoChar_16 : 288|8@1+ (1,0) [0|255] "ascii" DIAG_TESTER
 SG_ RouteInfoChar_17 : 296|8@1+ (1,0) [0|255] "ascii" DIAG_TESTER
 SG_ RouteInfoChar_18 : 304|8@1+ (1,0) [0|255] "ascii" DIAG_TESTER
 SG_ RouteInfoChar_19 : 312|8@1+ (1,0) [0|255] "ascii" DIAG_TESTER
 SG_ RouteInfoChar_20 : 320|8@1+ (1,0) [0|255] "ascii" DIAG_TESTER
 SG_ RouteInfoChar_21 : 328|8@1+ (1,0) [0|255] "ascii" DIAG_TESTER
 SG_ RouteInfoChar_22 : 336|8@1+ (1,0) [0|255] "ascii" DIAG_TESTER
 SG_ RouteInfoChar_23 : 344|8@1+ (1,0) [0|255] "ascii" DIAG_TESTER
 SG_ RouteInfoChar_24 : 352|8@1+ (1,0) [0|255] "ascii" DIAG_TESTER
 SG_ RouteInfoChar_25 : 360|8@1+ (1,0) [0|255] "ascii" DIAG_TESTER
 SG_ RouteInfoChar_26 : 368|8@1+ (1,0) [0|255] "ascii" DIAG_TESTER
 SG_ RouteInfoChar_27 : 376|8@1+ (1,0) [0|255] "ascii" DIAG_TESTER
 SG_ RouteInfoChar_28 : 384|8@1+ (1,0) [0|255] "ascii" DIAG_TESTER
 SG_ RouteInfoChar_29 : 392|8@1+ (1,0) [0|255] "ascii" DIAG_TESTER
 SG_ RouteInfoChar_30 : 400|8@1+ (1,0) [0|255] "ascii" DIAG_TESTER
 SG_ RouteInfoChar_31 : 408|8@1+ (1,0) [0|255] "ascii" DIAG_TESTER
 SG_ RouteInfoChar_32 : 416|8@1+ (1,0) [0|255] "ascii" DIAG_TESTER
 SG_ RouteInfoChar_33 : 424|8@1+ (1,0) [0|255] "ascii" DIAG_TESTER
 SG_ RouteInfoChar_34 : 432|8@1+ (1,0) [0|255] "ascii" DIAG_TESTER
 SG_ RouteInfoChar_35 : 440|8@1+ (1,0) [0|255] "ascii" DIAG_TESTER
 SG_ RouteInfoChar_36 : 448|8@1+ (1,0) [0|255] "ascii" DIAG_TESTER
 SG_ RouteInfoChar_37 : 456|8@1+ (1,0) [0|255] "ascii" DIAG_TESTER
 SG_ RouteInfoChar_38 : 464|8@1+ (1,0) [0|255] "ascii" DIAG_TESTER
 SG_ RouteInfoChar_39 : 472|8@1+ (1,0) [0|255] "ascii" DIAG_TESTER
 SG_ RouteInfoChar_40 : 480|8@1+ (1,0) [0|255] "ascii" DIAG_TESTER
 SG_ RouteInfoChar_41 : 488|8@1+ (1,0) [0|255] "ascii" DIAG_TESTER
 SG_ RouteInfoChar_42 : 496|8@1+ (1,0) [0|255] "ascii" DIAG_TESTER
 SG_ RouteInfoChar_43 : 504|8@1+ (1,0) [0|255] "ascii" DIAG_TESTER
CM_ BO_ 395 "Cycle=10ms; Channel=CAN2; CAN-FD; NominalBitrate=500kbit/s; DataBitrate=2000kbit/s;  Data request; receiver answers with response frame; PayloadRouteInfo='STEERING_CONTROLLER -> DIAG_TESTER' in bytes 20-63; Gateway to CAN3";

BO_ 1547 RESP_011_DIAG_TESTER_TO_STEERING_CONTROLLER: 16 DIAG_TESTER
 SG_ CRC8 : 0|8@1+ (1,0) [0|255] "" STEERING_CONTROLLER
 SG_ ResponseCounter : 8|4@1+ (1,0) [0|15] "" STEERING_CONTROLLER
 SG_ AckState : 12|4@1+ (1,0) [0|15] "" STEERING_CONTROLLER
 SG_ ReceivedFrameId : 16|11@1+ (1,0) [0|2047] "" STEERING_CONTROLLER
 SG_ ReceivedCounter : 27|4@1+ (1,0) [0|15] "" STEERING_CONTROLLER
 SG_ ChecksumOk : 31|1@1+ (1,0) [0|1] "" STEERING_CONTROLLER
 SG_ PayloadLength : 32|8@1+ (1,0) [0|64] "byte" STEERING_CONTROLLER
 SG_ ErrorCode : 40|8@1+ (1,0) [0|255] "" STEERING_CONTROLLER
 SG_ ProcessingTimeUs : 48|16@1+ (1,0) [0|65535] "us" STEERING_CONTROLLER
 SG_ ResponseSequence : 64|16@1+ (1,0) [0|65535] "" STEERING_CONTROLLER
 SG_ ReceivedCrc : 80|8@1+ (1,0) [0|255] "" STEERING_CONTROLLER
 SG_ CalculatedCrc : 88|8@1+ (1,0) [0|255] "" STEERING_CONTROLLER
CM_ BO_ 1547 "Cycle=10ms; Channel=CAN2; CAN-FD; NominalBitrate=500kbit/s; DataBitrate=2000kbit/s;  ResponseFor=0x18B; ACK/NACK with CRC, DLC and counter check;";

BO_ 396 DATA_012_CENTRAL_GATEWAY_ROUTING_STATUS_TO_DIAG_TESTER: 64 CENTRAL_GATEWAY
 SG_ CRC8 : 0|8@1+ (1,0) [0|255] "" DIAG_TESTER
 SG_ AliveCounter : 8|4@1+ (1,0) [0|15] "" DIAG_TESTER
 SG_ MuxState : 12|4@1+ (1,0) [0|15] "" DIAG_TESTER
 SG_ SIG_18C_00 : 16|12@1+ (0.1,0.0) [0|4095] "V" DIAG_TESTER
 SG_ SIG_18C_01 : 28|12@1+ (0.1,0.0) [0|4095] "m" DIAG_TESTER
 SG_ SIG_18C_02 : 40|12@1+ (0.1,0.0) [0|4095] "obj" DIAG_TESTER
 SG_ SIG_18C_03 : 52|12@1+ (0.1,0.0) [0|4095] "Nm" DIAG_TESTER
 SG_ SIG_18C_04 : 64|12@1+ (0.1,0.0) [0|4095] "deg" DIAG_TESTER
 SG_ SIG_18C_05 : 76|12@1+ (0.1,0.0) [0|4095] "A" DIAG_TESTER
 SG_ SIG_18C_06 : 88|12@1+ (0.1,0.0) [0|4095] "deg" DIAG_TESTER
 SG_ SIG_18C_07 : 100|12@1+ (0.1,0.0) [0|4095] "m" DIAG_TESTER
 SG_ SIG_18C_08 : 112|12@1+ (0.1,0.0) [0|4095] "m" DIAG_TESTER
 SG_ SIG_18C_09 : 124|12@1+ (0.1,0.0) [0|4095] "km/h" DIAG_TESTER
 SG_ SIG_18C_10 : 136|12@1+ (0.1,0.0) [0|4095] "obj" DIAG_TESTER
 SG_ SIG_18C_11 : 148|12@1+ (0.1,0.0) [0|4095] "A" DIAG_TESTER
 SG_ RouteInfoChar_00 : 160|8@1+ (1,0) [0|255] "ascii" DIAG_TESTER
 SG_ RouteInfoChar_01 : 168|8@1+ (1,0) [0|255] "ascii" DIAG_TESTER
 SG_ RouteInfoChar_02 : 176|8@1+ (1,0) [0|255] "ascii" DIAG_TESTER
 SG_ RouteInfoChar_03 : 184|8@1+ (1,0) [0|255] "ascii" DIAG_TESTER
 SG_ RouteInfoChar_04 : 192|8@1+ (1,0) [0|255] "ascii" DIAG_TESTER
 SG_ RouteInfoChar_05 : 200|8@1+ (1,0) [0|255] "ascii" DIAG_TESTER
 SG_ RouteInfoChar_06 : 208|8@1+ (1,0) [0|255] "ascii" DIAG_TESTER
 SG_ RouteInfoChar_07 : 216|8@1+ (1,0) [0|255] "ascii" DIAG_TESTER
 SG_ RouteInfoChar_08 : 224|8@1+ (1,0) [0|255] "ascii" DIAG_TESTER
 SG_ RouteInfoChar_09 : 232|8@1+ (1,0) [0|255] "ascii" DIAG_TESTER
 SG_ RouteInfoChar_10 : 240|8@1+ (1,0) [0|255] "ascii" DIAG_TESTER
 SG_ RouteInfoChar_11 : 248|8@1+ (1,0) [0|255] "ascii" DIAG_TESTER
 SG_ RouteInfoChar_12 : 256|8@1+ (1,0) [0|255] "ascii" DIAG_TESTER
 SG_ RouteInfoChar_13 : 264|8@1+ (1,0) [0|255] "ascii" DIAG_TESTER
 SG_ RouteInfoChar_14 : 272|8@1+ (1,0) [0|255] "ascii" DIAG_TESTER
 SG_ RouteInfoChar_15 : 280|8@1+ (1,0) [0|255] "ascii" DIAG_TESTER
 SG_ RouteInfoChar_16 : 288|8@1+ (1,0) [0|255] "ascii" DIAG_TESTER
 SG_ RouteInfoChar_17 : 296|8@1+ (1,0) [0|255] "ascii" DIAG_TESTER
 SG_ RouteInfoChar_18 : 304|8@1+ (1,0) [0|255] "ascii" DIAG_TESTER
 SG_ RouteInfoChar_19 : 312|8@1+ (1,0) [0|255] "ascii" DIAG_TESTER
 SG_ RouteInfoChar_20 : 320|8@1+ (1,0) [0|255] "ascii" DIAG_TESTER
 SG_ RouteInfoChar_21 : 328|8@1+ (1,0) [0|255] "ascii" DIAG_TESTER
 SG_ RouteInfoChar_22 : 336|8@1+ (1,0) [0|255] "ascii" DIAG_TESTER
 SG_ RouteInfoChar_23 : 344|8@1+ (1,0) [0|255] "ascii" DIAG_TESTER
 SG_ RouteInfoChar_24 : 352|8@1+ (1,0) [0|255] "ascii" DIAG_TESTER
 SG_ RouteInfoChar_25 : 360|8@1+ (1,0) [0|255] "ascii" DIAG_TESTER
 SG_ RouteInfoChar_26 : 368|8@1+ (1,0) [0|255] "ascii" DIAG_TESTER
 SG_ RouteInfoChar_27 : 376|8@1+ (1,0) [0|255] "ascii" DIAG_TESTER
 SG_ RouteInfoChar_28 : 384|8@1+ (1,0) [0|255] "ascii" DIAG_TESTER
 SG_ RouteInfoChar_29 : 392|8@1+ (1,0) [0|255] "ascii" DIAG_TESTER
 SG_ RouteInfoChar_30 : 400|8@1+ (1,0) [0|255] "ascii" DIAG_TESTER
 SG_ RouteInfoChar_31 : 408|8@1+ (1,0) [0|255] "ascii" DIAG_TESTER
 SG_ RouteInfoChar_32 : 416|8@1+ (1,0) [0|255] "ascii" DIAG_TESTER
 SG_ RouteInfoChar_33 : 424|8@1+ (1,0) [0|255] "ascii" DIAG_TESTER
 SG_ RouteInfoChar_34 : 432|8@1+ (1,0) [0|255] "ascii" DIAG_TESTER
 SG_ RouteInfoChar_35 : 440|8@1+ (1,0) [0|255] "ascii" DIAG_TESTER
 SG_ RouteInfoChar_36 : 448|8@1+ (1,0) [0|255] "ascii" DIAG_TESTER
 SG_ RouteInfoChar_37 : 456|8@1+ (1,0) [0|255] "ascii" DIAG_TESTER
 SG_ RouteInfoChar_38 : 464|8@1+ (1,0) [0|255] "ascii" DIAG_TESTER
 SG_ RouteInfoChar_39 : 472|8@1+ (1,0) [0|255] "ascii" DIAG_TESTER
 SG_ RouteInfoChar_40 : 480|8@1+ (1,0) [0|255] "ascii" DIAG_TESTER
 SG_ RouteInfoChar_41 : 488|8@1+ (1,0) [0|255] "ascii" DIAG_TESTER
 SG_ RouteInfoChar_42 : 496|8@1+ (1,0) [0|255] "ascii" DIAG_TESTER
 SG_ RouteInfoChar_43 : 504|8@1+ (1,0) [0|255] "ascii" DIAG_TESTER
CM_ BO_ 396 "Cycle=50ms; Channel=CAN0; CAN-FD; NominalBitrate=500kbit/s; DataBitrate=2000kbit/s;  Data request; receiver answers with response frame; PayloadRouteInfo='CENTRAL_GATEWAY -> DIAG_TESTER' in bytes 20-63; Gateway to CAN3";

BO_ 1548 RESP_012_DIAG_TESTER_TO_CENTRAL_GATEWAY: 16 DIAG_TESTER
 SG_ CRC8 : 0|8@1+ (1,0) [0|255] "" CENTRAL_GATEWAY
 SG_ ResponseCounter : 8|4@1+ (1,0) [0|15] "" CENTRAL_GATEWAY
 SG_ AckState : 12|4@1+ (1,0) [0|15] "" CENTRAL_GATEWAY
 SG_ ReceivedFrameId : 16|11@1+ (1,0) [0|2047] "" CENTRAL_GATEWAY
 SG_ ReceivedCounter : 27|4@1+ (1,0) [0|15] "" CENTRAL_GATEWAY
 SG_ ChecksumOk : 31|1@1+ (1,0) [0|1] "" CENTRAL_GATEWAY
 SG_ PayloadLength : 32|8@1+ (1,0) [0|64] "byte" CENTRAL_GATEWAY
 SG_ ErrorCode : 40|8@1+ (1,0) [0|255] "" CENTRAL_GATEWAY
 SG_ ProcessingTimeUs : 48|16@1+ (1,0) [0|65535] "us" CENTRAL_GATEWAY
 SG_ ResponseSequence : 64|16@1+ (1,0) [0|65535] "" CENTRAL_GATEWAY
 SG_ ReceivedCrc : 80|8@1+ (1,0) [0|255] "" CENTRAL_GATEWAY
 SG_ CalculatedCrc : 88|8@1+ (1,0) [0|255] "" CENTRAL_GATEWAY
CM_ BO_ 1548 "Cycle=50ms; Channel=CAN0; CAN-FD; NominalBitrate=500kbit/s; DataBitrate=2000kbit/s;  ResponseFor=0x18C; ACK/NACK with CRC, DLC and counter check;";

BO_ 397 DATA_013_CENTRAL_GATEWAY_SYNC_TIME_TO_CAMERA_FRONT_WIDE: 64 CENTRAL_GATEWAY
 SG_ CRC8 : 0|8@1+ (1,0) [0|255] "" CAMERA_FRONT_WIDE
 SG_ AliveCounter : 8|4@1+ (1,0) [0|15] "" CAMERA_FRONT_WIDE
 SG_ MuxState : 12|4@1+ (1,0) [0|15] "" CAMERA_FRONT_WIDE
 SG_ SIG_18D_00 : 16|12@1+ (0.1,0.0) [0|4095] "C" CAMERA_FRONT_WIDE
 SG_ SIG_18D_01 : 28|12@1+ (0.1,0.0) [0|4095] "km/h" CAMERA_FRONT_WIDE
 SG_ SIG_18D_02 : 40|12@1+ (0.1,0.0) [0|4095] "rpm" CAMERA_FRONT_WIDE
 SG_ SIG_18D_03 : 52|12@1+ (0.1,0.0) [0|4095] "A" CAMERA_FRONT_WIDE
 SG_ SIG_18D_04 : 64|12@1+ (0.1,0.0) [0|4095] "V" CAMERA_FRONT_WIDE
 SG_ SIG_18D_05 : 76|12@1+ (0.1,0.0) [0|4095] "Nm" CAMERA_FRONT_WIDE
 SG_ SIG_18D_06 : 88|12@1+ (0.1,0.0) [0|4095] "km/h" CAMERA_FRONT_WIDE
 SG_ SIG_18D_07 : 100|12@1+ (0.1,0.0) [0|4095] "Nm" CAMERA_FRONT_WIDE
 SG_ SIG_18D_08 : 112|12@1+ (0.1,0.0) [0|4095] "obj" CAMERA_FRONT_WIDE
 SG_ SIG_18D_09 : 124|12@1+ (0.1,0.0) [0|4095] "rpm" CAMERA_FRONT_WIDE
 SG_ SIG_18D_10 : 136|12@1+ (0.1,0.0) [0|4095] "rpm" CAMERA_FRONT_WIDE
 SG_ SIG_18D_11 : 148|12@1+ (0.1,0.0) [0|4095] "C" CAMERA_FRONT_WIDE
 SG_ RouteInfoChar_00 : 160|8@1+ (1,0) [0|255] "ascii" CAMERA_FRONT_WIDE
 SG_ RouteInfoChar_01 : 168|8@1+ (1,0) [0|255] "ascii" CAMERA_FRONT_WIDE
 SG_ RouteInfoChar_02 : 176|8@1+ (1,0) [0|255] "ascii" CAMERA_FRONT_WIDE
 SG_ RouteInfoChar_03 : 184|8@1+ (1,0) [0|255] "ascii" CAMERA_FRONT_WIDE
 SG_ RouteInfoChar_04 : 192|8@1+ (1,0) [0|255] "ascii" CAMERA_FRONT_WIDE
 SG_ RouteInfoChar_05 : 200|8@1+ (1,0) [0|255] "ascii" CAMERA_FRONT_WIDE
 SG_ RouteInfoChar_06 : 208|8@1+ (1,0) [0|255] "ascii" CAMERA_FRONT_WIDE
 SG_ RouteInfoChar_07 : 216|8@1+ (1,0) [0|255] "ascii" CAMERA_FRONT_WIDE
 SG_ RouteInfoChar_08 : 224|8@1+ (1,0) [0|255] "ascii" CAMERA_FRONT_WIDE
 SG_ RouteInfoChar_09 : 232|8@1+ (1,0) [0|255] "ascii" CAMERA_FRONT_WIDE
 SG_ RouteInfoChar_10 : 240|8@1+ (1,0) [0|255] "ascii" CAMERA_FRONT_WIDE
 SG_ RouteInfoChar_11 : 248|8@1+ (1,0) [0|255] "ascii" CAMERA_FRONT_WIDE
 SG_ RouteInfoChar_12 : 256|8@1+ (1,0) [0|255] "ascii" CAMERA_FRONT_WIDE
 SG_ RouteInfoChar_13 : 264|8@1+ (1,0) [0|255] "ascii" CAMERA_FRONT_WIDE
 SG_ RouteInfoChar_14 : 272|8@1+ (1,0) [0|255] "ascii" CAMERA_FRONT_WIDE
 SG_ RouteInfoChar_15 : 280|8@1+ (1,0) [0|255] "ascii" CAMERA_FRONT_WIDE
 SG_ RouteInfoChar_16 : 288|8@1+ (1,0) [0|255] "ascii" CAMERA_FRONT_WIDE
 SG_ RouteInfoChar_17 : 296|8@1+ (1,0) [0|255] "ascii" CAMERA_FRONT_WIDE
 SG_ RouteInfoChar_18 : 304|8@1+ (1,0) [0|255] "ascii" CAMERA_FRONT_WIDE
 SG_ RouteInfoChar_19 : 312|8@1+ (1,0) [0|255] "ascii" CAMERA_FRONT_WIDE
 SG_ RouteInfoChar_20 : 320|8@1+ (1,0) [0|255] "ascii" CAMERA_FRONT_WIDE
 SG_ RouteInfoChar_21 : 328|8@1+ (1,0) [0|255] "ascii" CAMERA_FRONT_WIDE
 SG_ RouteInfoChar_22 : 336|8@1+ (1,0) [0|255] "ascii" CAMERA_FRONT_WIDE
 SG_ RouteInfoChar_23 : 344|8@1+ (1,0) [0|255] "ascii" CAMERA_FRONT_WIDE
 SG_ RouteInfoChar_24 : 352|8@1+ (1,0) [0|255] "ascii" CAMERA_FRONT_WIDE
 SG_ RouteInfoChar_25 : 360|8@1+ (1,0) [0|255] "ascii" CAMERA_FRONT_WIDE
 SG_ RouteInfoChar_26 : 368|8@1+ (1,0) [0|255] "ascii" CAMERA_FRONT_WIDE
 SG_ RouteInfoChar_27 : 376|8@1+ (1,0) [0|255] "ascii" CAMERA_FRONT_WIDE
 SG_ RouteInfoChar_28 : 384|8@1+ (1,0) [0|255] "ascii" CAMERA_FRONT_WIDE
 SG_ RouteInfoChar_29 : 392|8@1+ (1,0) [0|255] "ascii" CAMERA_FRONT_WIDE
 SG_ RouteInfoChar_30 : 400|8@1+ (1,0) [0|255] "ascii" CAMERA_FRONT_WIDE
 SG_ RouteInfoChar_31 : 408|8@1+ (1,0) [0|255] "ascii" CAMERA_FRONT_WIDE
 SG_ RouteInfoChar_32 : 416|8@1+ (1,0) [0|255] "ascii" CAMERA_FRONT_WIDE
 SG_ RouteInfoChar_33 : 424|8@1+ (1,0) [0|255] "ascii" CAMERA_FRONT_WIDE
 SG_ RouteInfoChar_34 : 432|8@1+ (1,0) [0|255] "ascii" CAMERA_FRONT_WIDE
 SG_ RouteInfoChar_35 : 440|8@1+ (1,0) [0|255] "ascii" CAMERA_FRONT_WIDE
 SG_ RouteInfoChar_36 : 448|8@1+ (1,0) [0|255] "ascii" CAMERA_FRONT_WIDE
 SG_ RouteInfoChar_37 : 456|8@1+ (1,0) [0|255] "ascii" CAMERA_FRONT_WIDE
 SG_ RouteInfoChar_38 : 464|8@1+ (1,0) [0|255] "ascii" CAMERA_FRONT_WIDE
 SG_ RouteInfoChar_39 : 472|8@1+ (1,0) [0|255] "ascii" CAMERA_FRONT_WIDE
 SG_ RouteInfoChar_40 : 480|8@1+ (1,0) [0|255] "ascii" CAMERA_FRONT_WIDE
 SG_ RouteInfoChar_41 : 488|8@1+ (1,0) [0|255] "ascii" CAMERA_FRONT_WIDE
 SG_ RouteInfoChar_42 : 496|8@1+ (1,0) [0|255] "ascii" CAMERA_FRONT_WIDE
 SG_ RouteInfoChar_43 : 504|8@1+ (1,0) [0|255] "ascii" CAMERA_FRONT_WIDE
CM_ BO_ 397 "Cycle=40ms; Channel=CAN0; CAN-FD; NominalBitrate=500kbit/s; DataBitrate=2000kbit/s;  Data request; receiver answers with response frame; PayloadRouteInfo='CENTRAL_GATEWAY -> CAMERA_FRONT_WIDE' in bytes 20-63; Gateway to CAN3";

BO_ 1549 RESP_013_CAMERA_FRONT_WIDE_TO_CENTRAL_GATEWAY: 16 CAMERA_FRONT_WIDE
 SG_ CRC8 : 0|8@1+ (1,0) [0|255] "" CENTRAL_GATEWAY
 SG_ ResponseCounter : 8|4@1+ (1,0) [0|15] "" CENTRAL_GATEWAY
 SG_ AckState : 12|4@1+ (1,0) [0|15] "" CENTRAL_GATEWAY
 SG_ ReceivedFrameId : 16|11@1+ (1,0) [0|2047] "" CENTRAL_GATEWAY
 SG_ ReceivedCounter : 27|4@1+ (1,0) [0|15] "" CENTRAL_GATEWAY
 SG_ ChecksumOk : 31|1@1+ (1,0) [0|1] "" CENTRAL_GATEWAY
 SG_ PayloadLength : 32|8@1+ (1,0) [0|64] "byte" CENTRAL_GATEWAY
 SG_ ErrorCode : 40|8@1+ (1,0) [0|255] "" CENTRAL_GATEWAY
 SG_ ProcessingTimeUs : 48|16@1+ (1,0) [0|65535] "us" CENTRAL_GATEWAY
 SG_ ResponseSequence : 64|16@1+ (1,0) [0|65535] "" CENTRAL_GATEWAY
 SG_ ReceivedCrc : 80|8@1+ (1,0) [0|255] "" CENTRAL_GATEWAY
 SG_ CalculatedCrc : 88|8@1+ (1,0) [0|255] "" CENTRAL_GATEWAY
CM_ BO_ 1549 "Cycle=40ms; Channel=CAN0; CAN-FD; NominalBitrate=500kbit/s; DataBitrate=2000kbit/s;  ResponseFor=0x18D; ACK/NACK with CRC, DLC and counter check;";

BO_ 398 DATA_014_CENTRAL_GATEWAY_SYNC_TIME_TO_RADAR_FRONT_LONG_RANGE: 64 CENTRAL_GATEWAY
 SG_ CRC8 : 0|8@1+ (1,0) [0|255] "" RADAR_FRONT_LONG_RANGE
 SG_ AliveCounter : 8|4@1+ (1,0) [0|15] "" RADAR_FRONT_LONG_RANGE
 SG_ MuxState : 12|4@1+ (1,0) [0|15] "" RADAR_FRONT_LONG_RANGE
 SG_ SIG_18E_00 : 16|12@1+ (0.1,0.0) [0|4095] "rpm" RADAR_FRONT_LONG_RANGE
 SG_ SIG_18E_01 : 28|12@1+ (0.1,0.0) [0|4095] "m" RADAR_FRONT_LONG_RANGE
 SG_ SIG_18E_02 : 40|12@1+ (0.1,0.0) [0|4095] "deg" RADAR_FRONT_LONG_RANGE
 SG_ SIG_18E_03 : 52|12@1+ (0.1,0.0) [0|4095] "deg" RADAR_FRONT_LONG_RANGE
 SG_ SIG_18E_04 : 64|12@1+ (0.1,0.0) [0|4095] "C" RADAR_FRONT_LONG_RANGE
 SG_ SIG_18E_05 : 76|12@1+ (0.1,0.0) [0|4095] "m" RADAR_FRONT_LONG_RANGE
 SG_ SIG_18E_06 : 88|12@1+ (0.1,0.0) [0|4095] "deg" RADAR_FRONT_LONG_RANGE
 SG_ SIG_18E_07 : 100|12@1+ (0.1,0.0) [0|4095] "V" RADAR_FRONT_LONG_RANGE
 SG_ SIG_18E_08 : 112|12@1+ (0.1,0.0) [0|4095] "m" RADAR_FRONT_LONG_RANGE
 SG_ SIG_18E_09 : 124|12@1+ (0.1,0.0) [0|4095] "obj" RADAR_FRONT_LONG_RANGE
 SG_ SIG_18E_10 : 136|12@1+ (0.1,0.0) [0|4095] "%" RADAR_FRONT_LONG_RANGE
 SG_ SIG_18E_11 : 148|12@1+ (0.1,0.0) [0|4095] "Nm" RADAR_FRONT_LONG_RANGE
 SG_ RouteInfoChar_00 : 160|8@1+ (1,0) [0|255] "ascii" RADAR_FRONT_LONG_RANGE
 SG_ RouteInfoChar_01 : 168|8@1+ (1,0) [0|255] "ascii" RADAR_FRONT_LONG_RANGE
 SG_ RouteInfoChar_02 : 176|8@1+ (1,0) [0|255] "ascii" RADAR_FRONT_LONG_RANGE
 SG_ RouteInfoChar_03 : 184|8@1+ (1,0) [0|255] "ascii" RADAR_FRONT_LONG_RANGE
 SG_ RouteInfoChar_04 : 192|8@1+ (1,0) [0|255] "ascii" RADAR_FRONT_LONG_RANGE
 SG_ RouteInfoChar_05 : 200|8@1+ (1,0) [0|255] "ascii" RADAR_FRONT_LONG_RANGE
 SG_ RouteInfoChar_06 : 208|8@1+ (1,0) [0|255] "ascii" RADAR_FRONT_LONG_RANGE
 SG_ RouteInfoChar_07 : 216|8@1+ (1,0) [0|255] "ascii" RADAR_FRONT_LONG_RANGE
 SG_ RouteInfoChar_08 : 224|8@1+ (1,0) [0|255] "ascii" RADAR_FRONT_LONG_RANGE
 SG_ RouteInfoChar_09 : 232|8@1+ (1,0) [0|255] "ascii" RADAR_FRONT_LONG_RANGE
 SG_ RouteInfoChar_10 : 240|8@1+ (1,0) [0|255] "ascii" RADAR_FRONT_LONG_RANGE
 SG_ RouteInfoChar_11 : 248|8@1+ (1,0) [0|255] "ascii" RADAR_FRONT_LONG_RANGE
 SG_ RouteInfoChar_12 : 256|8@1+ (1,0) [0|255] "ascii" RADAR_FRONT_LONG_RANGE
 SG_ RouteInfoChar_13 : 264|8@1+ (1,0) [0|255] "ascii" RADAR_FRONT_LONG_RANGE
 SG_ RouteInfoChar_14 : 272|8@1+ (1,0) [0|255] "ascii" RADAR_FRONT_LONG_RANGE
 SG_ RouteInfoChar_15 : 280|8@1+ (1,0) [0|255] "ascii" RADAR_FRONT_LONG_RANGE
 SG_ RouteInfoChar_16 : 288|8@1+ (1,0) [0|255] "ascii" RADAR_FRONT_LONG_RANGE
 SG_ RouteInfoChar_17 : 296|8@1+ (1,0) [0|255] "ascii" RADAR_FRONT_LONG_RANGE
 SG_ RouteInfoChar_18 : 304|8@1+ (1,0) [0|255] "ascii" RADAR_FRONT_LONG_RANGE
 SG_ RouteInfoChar_19 : 312|8@1+ (1,0) [0|255] "ascii" RADAR_FRONT_LONG_RANGE
 SG_ RouteInfoChar_20 : 320|8@1+ (1,0) [0|255] "ascii" RADAR_FRONT_LONG_RANGE
 SG_ RouteInfoChar_21 : 328|8@1+ (1,0) [0|255] "ascii" RADAR_FRONT_LONG_RANGE
 SG_ RouteInfoChar_22 : 336|8@1+ (1,0) [0|255] "ascii" RADAR_FRONT_LONG_RANGE
 SG_ RouteInfoChar_23 : 344|8@1+ (1,0) [0|255] "ascii" RADAR_FRONT_LONG_RANGE
 SG_ RouteInfoChar_24 : 352|8@1+ (1,0) [0|255] "ascii" RADAR_FRONT_LONG_RANGE
 SG_ RouteInfoChar_25 : 360|8@1+ (1,0) [0|255] "ascii" RADAR_FRONT_LONG_RANGE
 SG_ RouteInfoChar_26 : 368|8@1+ (1,0) [0|255] "ascii" RADAR_FRONT_LONG_RANGE
 SG_ RouteInfoChar_27 : 376|8@1+ (1,0) [0|255] "ascii" RADAR_FRONT_LONG_RANGE
 SG_ RouteInfoChar_28 : 384|8@1+ (1,0) [0|255] "ascii" RADAR_FRONT_LONG_RANGE
 SG_ RouteInfoChar_29 : 392|8@1+ (1,0) [0|255] "ascii" RADAR_FRONT_LONG_RANGE
 SG_ RouteInfoChar_30 : 400|8@1+ (1,0) [0|255] "ascii" RADAR_FRONT_LONG_RANGE
 SG_ RouteInfoChar_31 : 408|8@1+ (1,0) [0|255] "ascii" RADAR_FRONT_LONG_RANGE
 SG_ RouteInfoChar_32 : 416|8@1+ (1,0) [0|255] "ascii" RADAR_FRONT_LONG_RANGE
 SG_ RouteInfoChar_33 : 424|8@1+ (1,0) [0|255] "ascii" RADAR_FRONT_LONG_RANGE
 SG_ RouteInfoChar_34 : 432|8@1+ (1,0) [0|255] "ascii" RADAR_FRONT_LONG_RANGE
 SG_ RouteInfoChar_35 : 440|8@1+ (1,0) [0|255] "ascii" RADAR_FRONT_LONG_RANGE
 SG_ RouteInfoChar_36 : 448|8@1+ (1,0) [0|255] "ascii" RADAR_FRONT_LONG_RANGE
 SG_ RouteInfoChar_37 : 456|8@1+ (1,0) [0|255] "ascii" RADAR_FRONT_LONG_RANGE
 SG_ RouteInfoChar_38 : 464|8@1+ (1,0) [0|255] "ascii" RADAR_FRONT_LONG_RANGE
 SG_ RouteInfoChar_39 : 472|8@1+ (1,0) [0|255] "ascii" RADAR_FRONT_LONG_RANGE
 SG_ RouteInfoChar_40 : 480|8@1+ (1,0) [0|255] "ascii" RADAR_FRONT_LONG_RANGE
 SG_ RouteInfoChar_41 : 488|8@1+ (1,0) [0|255] "ascii" RADAR_FRONT_LONG_RANGE
 SG_ RouteInfoChar_42 : 496|8@1+ (1,0) [0|255] "ascii" RADAR_FRONT_LONG_RANGE
 SG_ RouteInfoChar_43 : 504|8@1+ (1,0) [0|255] "ascii" RADAR_FRONT_LONG_RANGE
CM_ BO_ 398 "Cycle=20ms; Channel=CAN0; CAN-FD; NominalBitrate=500kbit/s; DataBitrate=2000kbit/s;  Data request; receiver answers with response frame; PayloadRouteInfo='CENTRAL_GATEWAY -> RADAR_FRONT_LONG_RANGE' in bytes 20-63; Gateway to CAN3";

BO_ 1550 RESP_014_RADAR_FRONT_LONG_RANGE_TO_CENTRAL_GATEWAY: 16 RADAR_FRONT_LONG_RANGE
 SG_ CRC8 : 0|8@1+ (1,0) [0|255] "" CENTRAL_GATEWAY
 SG_ ResponseCounter : 8|4@1+ (1,0) [0|15] "" CENTRAL_GATEWAY
 SG_ AckState : 12|4@1+ (1,0) [0|15] "" CENTRAL_GATEWAY
 SG_ ReceivedFrameId : 16|11@1+ (1,0) [0|2047] "" CENTRAL_GATEWAY
 SG_ ReceivedCounter : 27|4@1+ (1,0) [0|15] "" CENTRAL_GATEWAY
 SG_ ChecksumOk : 31|1@1+ (1,0) [0|1] "" CENTRAL_GATEWAY
 SG_ PayloadLength : 32|8@1+ (1,0) [0|64] "byte" CENTRAL_GATEWAY
 SG_ ErrorCode : 40|8@1+ (1,0) [0|255] "" CENTRAL_GATEWAY
 SG_ ProcessingTimeUs : 48|16@1+ (1,0) [0|65535] "us" CENTRAL_GATEWAY
 SG_ ResponseSequence : 64|16@1+ (1,0) [0|65535] "" CENTRAL_GATEWAY
 SG_ ReceivedCrc : 80|8@1+ (1,0) [0|255] "" CENTRAL_GATEWAY
 SG_ CalculatedCrc : 88|8@1+ (1,0) [0|255] "" CENTRAL_GATEWAY
CM_ BO_ 1550 "Cycle=20ms; Channel=CAN0; CAN-FD; NominalBitrate=500kbit/s; DataBitrate=2000kbit/s;  ResponseFor=0x18E; ACK/NACK with CRC, DLC and counter check;";

BO_ 399 DATA_015_CENTRAL_GATEWAY_SYNC_TIME_TO_RADAR_REAR_CORNER_LEFT: 64 CENTRAL_GATEWAY
 SG_ CRC8 : 0|8@1+ (1,0) [0|255] "" RADAR_REAR_CORNER_LEFT
 SG_ AliveCounter : 8|4@1+ (1,0) [0|15] "" RADAR_REAR_CORNER_LEFT
 SG_ MuxState : 12|4@1+ (1,0) [0|15] "" RADAR_REAR_CORNER_LEFT
 SG_ SIG_18F_00 : 16|12@1+ (0.1,0.0) [0|4095] "m" RADAR_REAR_CORNER_LEFT
 SG_ SIG_18F_01 : 28|12@1+ (0.1,0.0) [0|4095] "Nm" RADAR_REAR_CORNER_LEFT
 SG_ SIG_18F_02 : 40|12@1+ (0.1,0.0) [0|4095] "V" RADAR_REAR_CORNER_LEFT
 SG_ SIG_18F_03 : 52|12@1+ (0.1,0.0) [0|4095] "%" RADAR_REAR_CORNER_LEFT
 SG_ SIG_18F_04 : 64|12@1+ (0.1,0.0) [0|4095] "A" RADAR_REAR_CORNER_LEFT
 SG_ SIG_18F_05 : 76|12@1+ (0.1,0.0) [0|4095] "C" RADAR_REAR_CORNER_LEFT
 SG_ SIG_18F_06 : 88|12@1+ (0.1,0.0) [0|4095] "m" RADAR_REAR_CORNER_LEFT
 SG_ SIG_18F_07 : 100|12@1+ (0.1,0.0) [0|4095] "C" RADAR_REAR_CORNER_LEFT
 SG_ SIG_18F_08 : 112|12@1+ (0.1,0.0) [0|4095] "rpm" RADAR_REAR_CORNER_LEFT
 SG_ SIG_18F_09 : 124|12@1+ (0.1,0.0) [0|4095] "Nm" RADAR_REAR_CORNER_LEFT
 SG_ SIG_18F_10 : 136|12@1+ (0.1,0.0) [0|4095] "Nm" RADAR_REAR_CORNER_LEFT
 SG_ SIG_18F_11 : 148|12@1+ (0.1,0.0) [0|4095] "rpm" RADAR_REAR_CORNER_LEFT
 SG_ RouteInfoChar_00 : 160|8@1+ (1,0) [0|255] "ascii" RADAR_REAR_CORNER_LEFT
 SG_ RouteInfoChar_01 : 168|8@1+ (1,0) [0|255] "ascii" RADAR_REAR_CORNER_LEFT
 SG_ RouteInfoChar_02 : 176|8@1+ (1,0) [0|255] "ascii" RADAR_REAR_CORNER_LEFT
 SG_ RouteInfoChar_03 : 184|8@1+ (1,0) [0|255] "ascii" RADAR_REAR_CORNER_LEFT
 SG_ RouteInfoChar_04 : 192|8@1+ (1,0) [0|255] "ascii" RADAR_REAR_CORNER_LEFT
 SG_ RouteInfoChar_05 : 200|8@1+ (1,0) [0|255] "ascii" RADAR_REAR_CORNER_LEFT
 SG_ RouteInfoChar_06 : 208|8@1+ (1,0) [0|255] "ascii" RADAR_REAR_CORNER_LEFT
 SG_ RouteInfoChar_07 : 216|8@1+ (1,0) [0|255] "ascii" RADAR_REAR_CORNER_LEFT
 SG_ RouteInfoChar_08 : 224|8@1+ (1,0) [0|255] "ascii" RADAR_REAR_CORNER_LEFT
 SG_ RouteInfoChar_09 : 232|8@1+ (1,0) [0|255] "ascii" RADAR_REAR_CORNER_LEFT
 SG_ RouteInfoChar_10 : 240|8@1+ (1,0) [0|255] "ascii" RADAR_REAR_CORNER_LEFT
 SG_ RouteInfoChar_11 : 248|8@1+ (1,0) [0|255] "ascii" RADAR_REAR_CORNER_LEFT
 SG_ RouteInfoChar_12 : 256|8@1+ (1,0) [0|255] "ascii" RADAR_REAR_CORNER_LEFT
 SG_ RouteInfoChar_13 : 264|8@1+ (1,0) [0|255] "ascii" RADAR_REAR_CORNER_LEFT
 SG_ RouteInfoChar_14 : 272|8@1+ (1,0) [0|255] "ascii" RADAR_REAR_CORNER_LEFT
 SG_ RouteInfoChar_15 : 280|8@1+ (1,0) [0|255] "ascii" RADAR_REAR_CORNER_LEFT
 SG_ RouteInfoChar_16 : 288|8@1+ (1,0) [0|255] "ascii" RADAR_REAR_CORNER_LEFT
 SG_ RouteInfoChar_17 : 296|8@1+ (1,0) [0|255] "ascii" RADAR_REAR_CORNER_LEFT
 SG_ RouteInfoChar_18 : 304|8@1+ (1,0) [0|255] "ascii" RADAR_REAR_CORNER_LEFT
 SG_ RouteInfoChar_19 : 312|8@1+ (1,0) [0|255] "ascii" RADAR_REAR_CORNER_LEFT
 SG_ RouteInfoChar_20 : 320|8@1+ (1,0) [0|255] "ascii" RADAR_REAR_CORNER_LEFT
 SG_ RouteInfoChar_21 : 328|8@1+ (1,0) [0|255] "ascii" RADAR_REAR_CORNER_LEFT
 SG_ RouteInfoChar_22 : 336|8@1+ (1,0) [0|255] "ascii" RADAR_REAR_CORNER_LEFT
 SG_ RouteInfoChar_23 : 344|8@1+ (1,0) [0|255] "ascii" RADAR_REAR_CORNER_LEFT
 SG_ RouteInfoChar_24 : 352|8@1+ (1,0) [0|255] "ascii" RADAR_REAR_CORNER_LEFT
 SG_ RouteInfoChar_25 : 360|8@1+ (1,0) [0|255] "ascii" RADAR_REAR_CORNER_LEFT
 SG_ RouteInfoChar_26 : 368|8@1+ (1,0) [0|255] "ascii" RADAR_REAR_CORNER_LEFT
 SG_ RouteInfoChar_27 : 376|8@1+ (1,0) [0|255] "ascii" RADAR_REAR_CORNER_LEFT
 SG_ RouteInfoChar_28 : 384|8@1+ (1,0) [0|255] "ascii" RADAR_REAR_CORNER_LEFT
 SG_ RouteInfoChar_29 : 392|8@1+ (1,0) [0|255] "ascii" RADAR_REAR_CORNER_LEFT
 SG_ RouteInfoChar_30 : 400|8@1+ (1,0) [0|255] "ascii" RADAR_REAR_CORNER_LEFT
 SG_ RouteInfoChar_31 : 408|8@1+ (1,0) [0|255] "ascii" RADAR_REAR_CORNER_LEFT
 SG_ RouteInfoChar_32 : 416|8@1+ (1,0) [0|255] "ascii" RADAR_REAR_CORNER_LEFT
 SG_ RouteInfoChar_33 : 424|8@1+ (1,0) [0|255] "ascii" RADAR_REAR_CORNER_LEFT
 SG_ RouteInfoChar_34 : 432|8@1+ (1,0) [0|255] "ascii" RADAR_REAR_CORNER_LEFT
 SG_ RouteInfoChar_35 : 440|8@1+ (1,0) [0|255] "ascii" RADAR_REAR_CORNER_LEFT
 SG_ RouteInfoChar_36 : 448|8@1+ (1,0) [0|255] "ascii" RADAR_REAR_CORNER_LEFT
 SG_ RouteInfoChar_37 : 456|8@1+ (1,0) [0|255] "ascii" RADAR_REAR_CORNER_LEFT
 SG_ RouteInfoChar_38 : 464|8@1+ (1,0) [0|255] "ascii" RADAR_REAR_CORNER_LEFT
 SG_ RouteInfoChar_39 : 472|8@1+ (1,0) [0|255] "ascii" RADAR_REAR_CORNER_LEFT
 SG_ RouteInfoChar_40 : 480|8@1+ (1,0) [0|255] "ascii" RADAR_REAR_CORNER_LEFT
 SG_ RouteInfoChar_41 : 488|8@1+ (1,0) [0|255] "ascii" RADAR_REAR_CORNER_LEFT
 SG_ RouteInfoChar_42 : 496|8@1+ (1,0) [0|255] "ascii" RADAR_REAR_CORNER_LEFT
 SG_ RouteInfoChar_43 : 504|8@1+ (1,0) [0|255] "ascii" RADAR_REAR_CORNER_LEFT
CM_ BO_ 399 "Cycle=50ms; Channel=CAN0; CAN-FD; NominalBitrate=500kbit/s; DataBitrate=2000kbit/s;  Data request; receiver answers with response frame; PayloadRouteInfo='CENTRAL_GATEWAY -> RADAR_REAR_CORNER_LEFT' in bytes 20-63; Gateway to CAN3";

BO_ 1551 RESP_015_RADAR_REAR_CORNER_LEFT_TO_CENTRAL_GATEWAY: 16 RADAR_REAR_CORNER_LEFT
 SG_ CRC8 : 0|8@1+ (1,0) [0|255] "" CENTRAL_GATEWAY
 SG_ ResponseCounter : 8|4@1+ (1,0) [0|15] "" CENTRAL_GATEWAY
 SG_ AckState : 12|4@1+ (1,0) [0|15] "" CENTRAL_GATEWAY
 SG_ ReceivedFrameId : 16|11@1+ (1,0) [0|2047] "" CENTRAL_GATEWAY
 SG_ ReceivedCounter : 27|4@1+ (1,0) [0|15] "" CENTRAL_GATEWAY
 SG_ ChecksumOk : 31|1@1+ (1,0) [0|1] "" CENTRAL_GATEWAY
 SG_ PayloadLength : 32|8@1+ (1,0) [0|64] "byte" CENTRAL_GATEWAY
 SG_ ErrorCode : 40|8@1+ (1,0) [0|255] "" CENTRAL_GATEWAY
 SG_ ProcessingTimeUs : 48|16@1+ (1,0) [0|65535] "us" CENTRAL_GATEWAY
 SG_ ResponseSequence : 64|16@1+ (1,0) [0|65535] "" CENTRAL_GATEWAY
 SG_ ReceivedCrc : 80|8@1+ (1,0) [0|255] "" CENTRAL_GATEWAY
 SG_ CalculatedCrc : 88|8@1+ (1,0) [0|255] "" CENTRAL_GATEWAY
CM_ BO_ 1551 "Cycle=50ms; Channel=CAN0; CAN-FD; NominalBitrate=500kbit/s; DataBitrate=2000kbit/s;  ResponseFor=0x18F; ACK/NACK with CRC, DLC and counter check;";

BO_ 400 DATA_016_CENTRAL_GATEWAY_SYNC_TIME_TO_IMU_YAW_RATE_SENSOR: 64 CENTRAL_GATEWAY
 SG_ CRC8 : 0|8@1+ (1,0) [0|255] "" IMU_YAW_RATE_SENSOR
 SG_ AliveCounter : 8|4@1+ (1,0) [0|15] "" IMU_YAW_RATE_SENSOR
 SG_ MuxState : 12|4@1+ (1,0) [0|15] "" IMU_YAW_RATE_SENSOR
 SG_ SIG_190_00 : 16|12@1+ (0.1,0.0) [0|4095] "A" IMU_YAW_RATE_SENSOR
 SG_ SIG_190_01 : 28|12@1+ (0.1,0.0) [0|4095] "km/h" IMU_YAW_RATE_SENSOR
 SG_ SIG_190_02 : 40|12@1+ (0.1,0.0) [0|4095] "obj" IMU_YAW_RATE_SENSOR
 SG_ SIG_190_03 : 52|12@1+ (0.1,0.0) [0|4095] "m" IMU_YAW_RATE_SENSOR
 SG_ SIG_190_04 : 64|12@1+ (0.1,0.0) [0|4095] "Nm" IMU_YAW_RATE_SENSOR
 SG_ SIG_190_05 : 76|12@1+ (0.1,0.0) [0|4095] "obj" IMU_YAW_RATE_SENSOR
 SG_ SIG_190_06 : 88|12@1+ (0.1,0.0) [0|4095] "Nm" IMU_YAW_RATE_SENSOR
 SG_ SIG_190_07 : 100|12@1+ (0.1,0.0) [0|4095] "km/h" IMU_YAW_RATE_SENSOR
 SG_ SIG_190_08 : 112|12@1+ (0.1,0.0) [0|4095] "rpm" IMU_YAW_RATE_SENSOR
 SG_ SIG_190_09 : 124|12@1+ (0.1,0.0) [0|4095] "km/h" IMU_YAW_RATE_SENSOR
 SG_ SIG_190_10 : 136|12@1+ (0.1,0.0) [0|4095] "Nm" IMU_YAW_RATE_SENSOR
 SG_ SIG_190_11 : 148|12@1+ (0.1,0.0) [0|4095] "rpm" IMU_YAW_RATE_SENSOR
 SG_ RouteInfoChar_00 : 160|8@1+ (1,0) [0|255] "ascii" IMU_YAW_RATE_SENSOR
 SG_ RouteInfoChar_01 : 168|8@1+ (1,0) [0|255] "ascii" IMU_YAW_RATE_SENSOR
 SG_ RouteInfoChar_02 : 176|8@1+ (1,0) [0|255] "ascii" IMU_YAW_RATE_SENSOR
 SG_ RouteInfoChar_03 : 184|8@1+ (1,0) [0|255] "ascii" IMU_YAW_RATE_SENSOR
 SG_ RouteInfoChar_04 : 192|8@1+ (1,0) [0|255] "ascii" IMU_YAW_RATE_SENSOR
 SG_ RouteInfoChar_05 : 200|8@1+ (1,0) [0|255] "ascii" IMU_YAW_RATE_SENSOR
 SG_ RouteInfoChar_06 : 208|8@1+ (1,0) [0|255] "ascii" IMU_YAW_RATE_SENSOR
 SG_ RouteInfoChar_07 : 216|8@1+ (1,0) [0|255] "ascii" IMU_YAW_RATE_SENSOR
 SG_ RouteInfoChar_08 : 224|8@1+ (1,0) [0|255] "ascii" IMU_YAW_RATE_SENSOR
 SG_ RouteInfoChar_09 : 232|8@1+ (1,0) [0|255] "ascii" IMU_YAW_RATE_SENSOR
 SG_ RouteInfoChar_10 : 240|8@1+ (1,0) [0|255] "ascii" IMU_YAW_RATE_SENSOR
 SG_ RouteInfoChar_11 : 248|8@1+ (1,0) [0|255] "ascii" IMU_YAW_RATE_SENSOR
 SG_ RouteInfoChar_12 : 256|8@1+ (1,0) [0|255] "ascii" IMU_YAW_RATE_SENSOR
 SG_ RouteInfoChar_13 : 264|8@1+ (1,0) [0|255] "ascii" IMU_YAW_RATE_SENSOR
 SG_ RouteInfoChar_14 : 272|8@1+ (1,0) [0|255] "ascii" IMU_YAW_RATE_SENSOR
 SG_ RouteInfoChar_15 : 280|8@1+ (1,0) [0|255] "ascii" IMU_YAW_RATE_SENSOR
 SG_ RouteInfoChar_16 : 288|8@1+ (1,0) [0|255] "ascii" IMU_YAW_RATE_SENSOR
 SG_ RouteInfoChar_17 : 296|8@1+ (1,0) [0|255] "ascii" IMU_YAW_RATE_SENSOR
 SG_ RouteInfoChar_18 : 304|8@1+ (1,0) [0|255] "ascii" IMU_YAW_RATE_SENSOR
 SG_ RouteInfoChar_19 : 312|8@1+ (1,0) [0|255] "ascii" IMU_YAW_RATE_SENSOR
 SG_ RouteInfoChar_20 : 320|8@1+ (1,0) [0|255] "ascii" IMU_YAW_RATE_SENSOR
 SG_ RouteInfoChar_21 : 328|8@1+ (1,0) [0|255] "ascii" IMU_YAW_RATE_SENSOR
 SG_ RouteInfoChar_22 : 336|8@1+ (1,0) [0|255] "ascii" IMU_YAW_RATE_SENSOR
 SG_ RouteInfoChar_23 : 344|8@1+ (1,0) [0|255] "ascii" IMU_YAW_RATE_SENSOR
 SG_ RouteInfoChar_24 : 352|8@1+ (1,0) [0|255] "ascii" IMU_YAW_RATE_SENSOR
 SG_ RouteInfoChar_25 : 360|8@1+ (1,0) [0|255] "ascii" IMU_YAW_RATE_SENSOR
 SG_ RouteInfoChar_26 : 368|8@1+ (1,0) [0|255] "ascii" IMU_YAW_RATE_SENSOR
 SG_ RouteInfoChar_27 : 376|8@1+ (1,0) [0|255] "ascii" IMU_YAW_RATE_SENSOR
 SG_ RouteInfoChar_28 : 384|8@1+ (1,0) [0|255] "ascii" IMU_YAW_RATE_SENSOR
 SG_ RouteInfoChar_29 : 392|8@1+ (1,0) [0|255] "ascii" IMU_YAW_RATE_SENSOR
 SG_ RouteInfoChar_30 : 400|8@1+ (1,0) [0|255] "ascii" IMU_YAW_RATE_SENSOR
 SG_ RouteInfoChar_31 : 408|8@1+ (1,0) [0|255] "ascii" IMU_YAW_RATE_SENSOR
 SG_ RouteInfoChar_32 : 416|8@1+ (1,0) [0|255] "ascii" IMU_YAW_RATE_SENSOR
 SG_ RouteInfoChar_33 : 424|8@1+ (1,0) [0|255] "ascii" IMU_YAW_RATE_SENSOR
 SG_ RouteInfoChar_34 : 432|8@1+ (1,0) [0|255] "ascii" IMU_YAW_RATE_SENSOR
 SG_ RouteInfoChar_35 : 440|8@1+ (1,0) [0|255] "ascii" IMU_YAW_RATE_SENSOR
 SG_ RouteInfoChar_36 : 448|8@1+ (1,0) [0|255] "ascii" IMU_YAW_RATE_SENSOR
 SG_ RouteInfoChar_37 : 456|8@1+ (1,0) [0|255] "ascii" IMU_YAW_RATE_SENSOR
 SG_ RouteInfoChar_38 : 464|8@1+ (1,0) [0|255] "ascii" IMU_YAW_RATE_SENSOR
 SG_ RouteInfoChar_39 : 472|8@1+ (1,0) [0|255] "ascii" IMU_YAW_RATE_SENSOR
 SG_ RouteInfoChar_40 : 480|8@1+ (1,0) [0|255] "ascii" IMU_YAW_RATE_SENSOR
 SG_ RouteInfoChar_41 : 488|8@1+ (1,0) [0|255] "ascii" IMU_YAW_RATE_SENSOR
 SG_ RouteInfoChar_42 : 496|8@1+ (1,0) [0|255] "ascii" IMU_YAW_RATE_SENSOR
 SG_ RouteInfoChar_43 : 504|8@1+ (1,0) [0|255] "ascii" IMU_YAW_RATE_SENSOR
CM_ BO_ 400 "Cycle=10ms; Channel=CAN0; CAN-FD; NominalBitrate=500kbit/s; DataBitrate=2000kbit/s;  Data request; receiver answers with response frame; PayloadRouteInfo='CENTRAL_GATEWAY -> IMU_YAW_RATE_SENSOR' in bytes 20-63; Gateway to CAN3";

BO_ 1552 RESP_016_IMU_YAW_RATE_SENSOR_TO_CENTRAL_GATEWAY: 16 IMU_YAW_RATE_SENSOR
 SG_ CRC8 : 0|8@1+ (1,0) [0|255] "" CENTRAL_GATEWAY
 SG_ ResponseCounter : 8|4@1+ (1,0) [0|15] "" CENTRAL_GATEWAY
 SG_ AckState : 12|4@1+ (1,0) [0|15] "" CENTRAL_GATEWAY
 SG_ ReceivedFrameId : 16|11@1+ (1,0) [0|2047] "" CENTRAL_GATEWAY
 SG_ ReceivedCounter : 27|4@1+ (1,0) [0|15] "" CENTRAL_GATEWAY
 SG_ ChecksumOk : 31|1@1+ (1,0) [0|1] "" CENTRAL_GATEWAY
 SG_ PayloadLength : 32|8@1+ (1,0) [0|64] "byte" CENTRAL_GATEWAY
 SG_ ErrorCode : 40|8@1+ (1,0) [0|255] "" CENTRAL_GATEWAY
 SG_ ProcessingTimeUs : 48|16@1+ (1,0) [0|65535] "us" CENTRAL_GATEWAY
 SG_ ResponseSequence : 64|16@1+ (1,0) [0|65535] "" CENTRAL_GATEWAY
 SG_ ReceivedCrc : 80|8@1+ (1,0) [0|255] "" CENTRAL_GATEWAY
 SG_ CalculatedCrc : 88|8@1+ (1,0) [0|255] "" CENTRAL_GATEWAY
CM_ BO_ 1552 "Cycle=10ms; Channel=CAN0; CAN-FD; NominalBitrate=500kbit/s; DataBitrate=2000kbit/s;  ResponseFor=0x190; ACK/NACK with CRC, DLC and counter check;";

BO_ 401 DATA_017_CENTRAL_GATEWAY_SYNC_TIME_TO_LIDAR_FRONT: 64 CENTRAL_GATEWAY
 SG_ CRC8 : 0|8@1+ (1,0) [0|255] "" LIDAR_FRONT
 SG_ AliveCounter : 8|4@1+ (1,0) [0|15] "" LIDAR_FRONT
 SG_ MuxState : 12|4@1+ (1,0) [0|15] "" LIDAR_FRONT
 SG_ SIG_191_00 : 16|12@1+ (0.1,0.0) [0|4095] "km/h" LIDAR_FRONT
 SG_ SIG_191_01 : 28|12@1+ (0.1,0.0) [0|4095] "A" LIDAR_FRONT
 SG_ SIG_191_02 : 40|12@1+ (0.1,0.0) [0|4095] "rpm" LIDAR_FRONT
 SG_ SIG_191_03 : 52|12@1+ (0.1,0.0) [0|4095] "m" LIDAR_FRONT
 SG_ SIG_191_04 : 64|12@1+ (0.1,0.0) [0|4095] "Nm" LIDAR_FRONT
 SG_ SIG_191_05 : 76|12@1+ (0.1,0.0) [0|4095] "V" LIDAR_FRONT
 SG_ SIG_191_06 : 88|12@1+ (0.1,0.0) [0|4095] "C" LIDAR_FRONT
 SG_ SIG_191_07 : 100|12@1+ (0.1,0.0) [0|4095] "Nm" LIDAR_FRONT
 SG_ SIG_191_08 : 112|12@1+ (0.1,0.0) [0|4095] "m" LIDAR_FRONT
 SG_ SIG_191_09 : 124|12@1+ (0.1,0.0) [0|4095] "deg" LIDAR_FRONT
 SG_ SIG_191_10 : 136|12@1+ (0.1,0.0) [0|4095] "obj" LIDAR_FRONT
 SG_ SIG_191_11 : 148|12@1+ (0.1,0.0) [0|4095] "obj" LIDAR_FRONT
 SG_ RouteInfoChar_00 : 160|8@1+ (1,0) [0|255] "ascii" LIDAR_FRONT
 SG_ RouteInfoChar_01 : 168|8@1+ (1,0) [0|255] "ascii" LIDAR_FRONT
 SG_ RouteInfoChar_02 : 176|8@1+ (1,0) [0|255] "ascii" LIDAR_FRONT
 SG_ RouteInfoChar_03 : 184|8@1+ (1,0) [0|255] "ascii" LIDAR_FRONT
 SG_ RouteInfoChar_04 : 192|8@1+ (1,0) [0|255] "ascii" LIDAR_FRONT
 SG_ RouteInfoChar_05 : 200|8@1+ (1,0) [0|255] "ascii" LIDAR_FRONT
 SG_ RouteInfoChar_06 : 208|8@1+ (1,0) [0|255] "ascii" LIDAR_FRONT
 SG_ RouteInfoChar_07 : 216|8@1+ (1,0) [0|255] "ascii" LIDAR_FRONT
 SG_ RouteInfoChar_08 : 224|8@1+ (1,0) [0|255] "ascii" LIDAR_FRONT
 SG_ RouteInfoChar_09 : 232|8@1+ (1,0) [0|255] "ascii" LIDAR_FRONT
 SG_ RouteInfoChar_10 : 240|8@1+ (1,0) [0|255] "ascii" LIDAR_FRONT
 SG_ RouteInfoChar_11 : 248|8@1+ (1,0) [0|255] "ascii" LIDAR_FRONT
 SG_ RouteInfoChar_12 : 256|8@1+ (1,0) [0|255] "ascii" LIDAR_FRONT
 SG_ RouteInfoChar_13 : 264|8@1+ (1,0) [0|255] "ascii" LIDAR_FRONT
 SG_ RouteInfoChar_14 : 272|8@1+ (1,0) [0|255] "ascii" LIDAR_FRONT
 SG_ RouteInfoChar_15 : 280|8@1+ (1,0) [0|255] "ascii" LIDAR_FRONT
 SG_ RouteInfoChar_16 : 288|8@1+ (1,0) [0|255] "ascii" LIDAR_FRONT
 SG_ RouteInfoChar_17 : 296|8@1+ (1,0) [0|255] "ascii" LIDAR_FRONT
 SG_ RouteInfoChar_18 : 304|8@1+ (1,0) [0|255] "ascii" LIDAR_FRONT
 SG_ RouteInfoChar_19 : 312|8@1+ (1,0) [0|255] "ascii" LIDAR_FRONT
 SG_ RouteInfoChar_20 : 320|8@1+ (1,0) [0|255] "ascii" LIDAR_FRONT
 SG_ RouteInfoChar_21 : 328|8@1+ (1,0) [0|255] "ascii" LIDAR_FRONT
 SG_ RouteInfoChar_22 : 336|8@1+ (1,0) [0|255] "ascii" LIDAR_FRONT
 SG_ RouteInfoChar_23 : 344|8@1+ (1,0) [0|255] "ascii" LIDAR_FRONT
 SG_ RouteInfoChar_24 : 352|8@1+ (1,0) [0|255] "ascii" LIDAR_FRONT
 SG_ RouteInfoChar_25 : 360|8@1+ (1,0) [0|255] "ascii" LIDAR_FRONT
 SG_ RouteInfoChar_26 : 368|8@1+ (1,0) [0|255] "ascii" LIDAR_FRONT
 SG_ RouteInfoChar_27 : 376|8@1+ (1,0) [0|255] "ascii" LIDAR_FRONT
 SG_ RouteInfoChar_28 : 384|8@1+ (1,0) [0|255] "ascii" LIDAR_FRONT
 SG_ RouteInfoChar_29 : 392|8@1+ (1,0) [0|255] "ascii" LIDAR_FRONT
 SG_ RouteInfoChar_30 : 400|8@1+ (1,0) [0|255] "ascii" LIDAR_FRONT
 SG_ RouteInfoChar_31 : 408|8@1+ (1,0) [0|255] "ascii" LIDAR_FRONT
 SG_ RouteInfoChar_32 : 416|8@1+ (1,0) [0|255] "ascii" LIDAR_FRONT
 SG_ RouteInfoChar_33 : 424|8@1+ (1,0) [0|255] "ascii" LIDAR_FRONT
 SG_ RouteInfoChar_34 : 432|8@1+ (1,0) [0|255] "ascii" LIDAR_FRONT
 SG_ RouteInfoChar_35 : 440|8@1+ (1,0) [0|255] "ascii" LIDAR_FRONT
 SG_ RouteInfoChar_36 : 448|8@1+ (1,0) [0|255] "ascii" LIDAR_FRONT
 SG_ RouteInfoChar_37 : 456|8@1+ (1,0) [0|255] "ascii" LIDAR_FRONT
 SG_ RouteInfoChar_38 : 464|8@1+ (1,0) [0|255] "ascii" LIDAR_FRONT
 SG_ RouteInfoChar_39 : 472|8@1+ (1,0) [0|255] "ascii" LIDAR_FRONT
 SG_ RouteInfoChar_40 : 480|8@1+ (1,0) [0|255] "ascii" LIDAR_FRONT
 SG_ RouteInfoChar_41 : 488|8@1+ (1,0) [0|255] "ascii" LIDAR_FRONT
 SG_ RouteInfoChar_42 : 496|8@1+ (1,0) [0|255] "ascii" LIDAR_FRONT
 SG_ RouteInfoChar_43 : 504|8@1+ (1,0) [0|255] "ascii" LIDAR_FRONT
CM_ BO_ 401 "Cycle=20ms; Channel=CAN0; CAN-FD; NominalBitrate=500kbit/s; DataBitrate=2000kbit/s;  Data request; receiver answers with response frame; PayloadRouteInfo='CENTRAL_GATEWAY -> LIDAR_FRONT' in bytes 20-63; Gateway to CAN3";

BO_ 1553 RESP_017_LIDAR_FRONT_TO_CENTRAL_GATEWAY: 16 LIDAR_FRONT
 SG_ CRC8 : 0|8@1+ (1,0) [0|255] "" CENTRAL_GATEWAY
 SG_ ResponseCounter : 8|4@1+ (1,0) [0|15] "" CENTRAL_GATEWAY
 SG_ AckState : 12|4@1+ (1,0) [0|15] "" CENTRAL_GATEWAY
 SG_ ReceivedFrameId : 16|11@1+ (1,0) [0|2047] "" CENTRAL_GATEWAY
 SG_ ReceivedCounter : 27|4@1+ (1,0) [0|15] "" CENTRAL_GATEWAY
 SG_ ChecksumOk : 31|1@1+ (1,0) [0|1] "" CENTRAL_GATEWAY
 SG_ PayloadLength : 32|8@1+ (1,0) [0|64] "byte" CENTRAL_GATEWAY
 SG_ ErrorCode : 40|8@1+ (1,0) [0|255] "" CENTRAL_GATEWAY
 SG_ ProcessingTimeUs : 48|16@1+ (1,0) [0|65535] "us" CENTRAL_GATEWAY
 SG_ ResponseSequence : 64|16@1+ (1,0) [0|65535] "" CENTRAL_GATEWAY
 SG_ ReceivedCrc : 80|8@1+ (1,0) [0|255] "" CENTRAL_GATEWAY
 SG_ CalculatedCrc : 88|8@1+ (1,0) [0|255] "" CENTRAL_GATEWAY
CM_ BO_ 1553 "Cycle=20ms; Channel=CAN0; CAN-FD; NominalBitrate=500kbit/s; DataBitrate=2000kbit/s;  ResponseFor=0x191; ACK/NACK with CRC, DLC and counter check;";

BO_ 402 DATA_018_CENTRAL_GATEWAY_SYNC_TIME_TO_AMBIENT_TEMP_SENSOR: 64 CENTRAL_GATEWAY
 SG_ CRC8 : 0|8@1+ (1,0) [0|255] "" AMBIENT_TEMP_SENSOR
 SG_ AliveCounter : 8|4@1+ (1,0) [0|15] "" AMBIENT_TEMP_SENSOR
 SG_ MuxState : 12|4@1+ (1,0) [0|15] "" AMBIENT_TEMP_SENSOR
 SG_ SIG_192_00 : 16|12@1+ (0.1,0.0) [0|4095] "C" AMBIENT_TEMP_SENSOR
 SG_ SIG_192_01 : 28|12@1+ (0.1,0.0) [0|4095] "Nm" AMBIENT_TEMP_SENSOR
 SG_ SIG_192_02 : 40|12@1+ (0.1,0.0) [0|4095] "C" AMBIENT_TEMP_SENSOR
 SG_ SIG_192_03 : 52|12@1+ (0.1,0.0) [0|4095] "%" AMBIENT_TEMP_SENSOR
 SG_ SIG_192_04 : 64|12@1+ (0.1,0.0) [0|4095] "Nm" AMBIENT_TEMP_SENSOR
 SG_ SIG_192_05 : 76|12@1+ (0.1,0.0) [0|4095] "rpm" AMBIENT_TEMP_SENSOR
 SG_ SIG_192_06 : 88|12@1+ (0.1,0.0) [0|4095] "rpm" AMBIENT_TEMP_SENSOR
 SG_ SIG_192_07 : 100|12@1+ (0.1,0.0) [0|4095] "%" AMBIENT_TEMP_SENSOR
 SG_ SIG_192_08 : 112|12@1+ (0.1,0.0) [0|4095] "A" AMBIENT_TEMP_SENSOR
 SG_ SIG_192_09 : 124|12@1+ (0.1,0.0) [0|4095] "%" AMBIENT_TEMP_SENSOR
 SG_ SIG_192_10 : 136|12@1+ (0.1,0.0) [0|4095] "%" AMBIENT_TEMP_SENSOR
 SG_ SIG_192_11 : 148|12@1+ (0.1,0.0) [0|4095] "C" AMBIENT_TEMP_SENSOR
 SG_ RouteInfoChar_00 : 160|8@1+ (1,0) [0|255] "ascii" AMBIENT_TEMP_SENSOR
 SG_ RouteInfoChar_01 : 168|8@1+ (1,0) [0|255] "ascii" AMBIENT_TEMP_SENSOR
 SG_ RouteInfoChar_02 : 176|8@1+ (1,0) [0|255] "ascii" AMBIENT_TEMP_SENSOR
 SG_ RouteInfoChar_03 : 184|8@1+ (1,0) [0|255] "ascii" AMBIENT_TEMP_SENSOR
 SG_ RouteInfoChar_04 : 192|8@1+ (1,0) [0|255] "ascii" AMBIENT_TEMP_SENSOR
 SG_ RouteInfoChar_05 : 200|8@1+ (1,0) [0|255] "ascii" AMBIENT_TEMP_SENSOR
 SG_ RouteInfoChar_06 : 208|8@1+ (1,0) [0|255] "ascii" AMBIENT_TEMP_SENSOR
 SG_ RouteInfoChar_07 : 216|8@1+ (1,0) [0|255] "ascii" AMBIENT_TEMP_SENSOR
 SG_ RouteInfoChar_08 : 224|8@1+ (1,0) [0|255] "ascii" AMBIENT_TEMP_SENSOR
 SG_ RouteInfoChar_09 : 232|8@1+ (1,0) [0|255] "ascii" AMBIENT_TEMP_SENSOR
 SG_ RouteInfoChar_10 : 240|8@1+ (1,0) [0|255] "ascii" AMBIENT_TEMP_SENSOR
 SG_ RouteInfoChar_11 : 248|8@1+ (1,0) [0|255] "ascii" AMBIENT_TEMP_SENSOR
 SG_ RouteInfoChar_12 : 256|8@1+ (1,0) [0|255] "ascii" AMBIENT_TEMP_SENSOR
 SG_ RouteInfoChar_13 : 264|8@1+ (1,0) [0|255] "ascii" AMBIENT_TEMP_SENSOR
 SG_ RouteInfoChar_14 : 272|8@1+ (1,0) [0|255] "ascii" AMBIENT_TEMP_SENSOR
 SG_ RouteInfoChar_15 : 280|8@1+ (1,0) [0|255] "ascii" AMBIENT_TEMP_SENSOR
 SG_ RouteInfoChar_16 : 288|8@1+ (1,0) [0|255] "ascii" AMBIENT_TEMP_SENSOR
 SG_ RouteInfoChar_17 : 296|8@1+ (1,0) [0|255] "ascii" AMBIENT_TEMP_SENSOR
 SG_ RouteInfoChar_18 : 304|8@1+ (1,0) [0|255] "ascii" AMBIENT_TEMP_SENSOR
 SG_ RouteInfoChar_19 : 312|8@1+ (1,0) [0|255] "ascii" AMBIENT_TEMP_SENSOR
 SG_ RouteInfoChar_20 : 320|8@1+ (1,0) [0|255] "ascii" AMBIENT_TEMP_SENSOR
 SG_ RouteInfoChar_21 : 328|8@1+ (1,0) [0|255] "ascii" AMBIENT_TEMP_SENSOR
 SG_ RouteInfoChar_22 : 336|8@1+ (1,0) [0|255] "ascii" AMBIENT_TEMP_SENSOR
 SG_ RouteInfoChar_23 : 344|8@1+ (1,0) [0|255] "ascii" AMBIENT_TEMP_SENSOR
 SG_ RouteInfoChar_24 : 352|8@1+ (1,0) [0|255] "ascii" AMBIENT_TEMP_SENSOR
 SG_ RouteInfoChar_25 : 360|8@1+ (1,0) [0|255] "ascii" AMBIENT_TEMP_SENSOR
 SG_ RouteInfoChar_26 : 368|8@1+ (1,0) [0|255] "ascii" AMBIENT_TEMP_SENSOR
 SG_ RouteInfoChar_27 : 376|8@1+ (1,0) [0|255] "ascii" AMBIENT_TEMP_SENSOR
 SG_ RouteInfoChar_28 : 384|8@1+ (1,0) [0|255] "ascii" AMBIENT_TEMP_SENSOR
 SG_ RouteInfoChar_29 : 392|8@1+ (1,0) [0|255] "ascii" AMBIENT_TEMP_SENSOR
 SG_ RouteInfoChar_30 : 400|8@1+ (1,0) [0|255] "ascii" AMBIENT_TEMP_SENSOR
 SG_ RouteInfoChar_31 : 408|8@1+ (1,0) [0|255] "ascii" AMBIENT_TEMP_SENSOR
 SG_ RouteInfoChar_32 : 416|8@1+ (1,0) [0|255] "ascii" AMBIENT_TEMP_SENSOR
 SG_ RouteInfoChar_33 : 424|8@1+ (1,0) [0|255] "ascii" AMBIENT_TEMP_SENSOR
 SG_ RouteInfoChar_34 : 432|8@1+ (1,0) [0|255] "ascii" AMBIENT_TEMP_SENSOR
 SG_ RouteInfoChar_35 : 440|8@1+ (1,0) [0|255] "ascii" AMBIENT_TEMP_SENSOR
 SG_ RouteInfoChar_36 : 448|8@1+ (1,0) [0|255] "ascii" AMBIENT_TEMP_SENSOR
 SG_ RouteInfoChar_37 : 456|8@1+ (1,0) [0|255] "ascii" AMBIENT_TEMP_SENSOR
 SG_ RouteInfoChar_38 : 464|8@1+ (1,0) [0|255] "ascii" AMBIENT_TEMP_SENSOR
 SG_ RouteInfoChar_39 : 472|8@1+ (1,0) [0|255] "ascii" AMBIENT_TEMP_SENSOR
 SG_ RouteInfoChar_40 : 480|8@1+ (1,0) [0|255] "ascii" AMBIENT_TEMP_SENSOR
 SG_ RouteInfoChar_41 : 488|8@1+ (1,0) [0|255] "ascii" AMBIENT_TEMP_SENSOR
 SG_ RouteInfoChar_42 : 496|8@1+ (1,0) [0|255] "ascii" AMBIENT_TEMP_SENSOR
 SG_ RouteInfoChar_43 : 504|8@1+ (1,0) [0|255] "ascii" AMBIENT_TEMP_SENSOR
CM_ BO_ 402 "Cycle=50ms; Channel=CAN0; CAN-FD; NominalBitrate=500kbit/s; DataBitrate=2000kbit/s;  Data request; receiver answers with response frame; PayloadRouteInfo='CENTRAL_GATEWAY -> AMBIENT_TEMP_SENSOR' in bytes 20-63; Gateway to CAN3";

BO_ 1554 RESP_018_AMBIENT_TEMP_SENSOR_TO_CENTRAL_GATEWAY: 16 AMBIENT_TEMP_SENSOR
 SG_ CRC8 : 0|8@1+ (1,0) [0|255] "" CENTRAL_GATEWAY
 SG_ ResponseCounter : 8|4@1+ (1,0) [0|15] "" CENTRAL_GATEWAY
 SG_ AckState : 12|4@1+ (1,0) [0|15] "" CENTRAL_GATEWAY
 SG_ ReceivedFrameId : 16|11@1+ (1,0) [0|2047] "" CENTRAL_GATEWAY
 SG_ ReceivedCounter : 27|4@1+ (1,0) [0|15] "" CENTRAL_GATEWAY
 SG_ ChecksumOk : 31|1@1+ (1,0) [0|1] "" CENTRAL_GATEWAY
 SG_ PayloadLength : 32|8@1+ (1,0) [0|64] "byte" CENTRAL_GATEWAY
 SG_ ErrorCode : 40|8@1+ (1,0) [0|255] "" CENTRAL_GATEWAY
 SG_ ProcessingTimeUs : 48|16@1+ (1,0) [0|65535] "us" CENTRAL_GATEWAY
 SG_ ResponseSequence : 64|16@1+ (1,0) [0|65535] "" CENTRAL_GATEWAY
 SG_ ReceivedCrc : 80|8@1+ (1,0) [0|255] "" CENTRAL_GATEWAY
 SG_ CalculatedCrc : 88|8@1+ (1,0) [0|255] "" CENTRAL_GATEWAY
CM_ BO_ 1554 "Cycle=50ms; Channel=CAN0; CAN-FD; NominalBitrate=500kbit/s; DataBitrate=2000kbit/s;  ResponseFor=0x192; ACK/NACK with CRC, DLC and counter check;";

BO_ 403 DATA_019_CENTRAL_GATEWAY_SYNC_TIME_TO_ADAS_ECU_TEMP_SENSOR: 64 CENTRAL_GATEWAY
 SG_ CRC8 : 0|8@1+ (1,0) [0|255] "" ADAS_ECU_TEMP_SENSOR
 SG_ AliveCounter : 8|4@1+ (1,0) [0|15] "" ADAS_ECU_TEMP_SENSOR
 SG_ MuxState : 12|4@1+ (1,0) [0|15] "" ADAS_ECU_TEMP_SENSOR
 SG_ SIG_193_00 : 16|12@1+ (0.1,0.0) [0|4095] "km/h" ADAS_ECU_TEMP_SENSOR
 SG_ SIG_193_01 : 28|12@1+ (0.1,0.0) [0|4095] "rpm" ADAS_ECU_TEMP_SENSOR
 SG_ SIG_193_02 : 40|12@1+ (0.1,0.0) [0|4095] "km/h" ADAS_ECU_TEMP_SENSOR
 SG_ SIG_193_03 : 52|12@1+ (0.1,0.0) [0|4095] "%" ADAS_ECU_TEMP_SENSOR
 SG_ SIG_193_04 : 64|12@1+ (0.1,0.0) [0|4095] "A" ADAS_ECU_TEMP_SENSOR
 SG_ SIG_193_05 : 76|12@1+ (0.1,0.0) [0|4095] "rpm" ADAS_ECU_TEMP_SENSOR
 SG_ SIG_193_06 : 88|12@1+ (0.1,0.0) [0|4095] "Nm" ADAS_ECU_TEMP_SENSOR
 SG_ SIG_193_07 : 100|12@1+ (0.1,0.0) [0|4095] "Nm" ADAS_ECU_TEMP_SENSOR
 SG_ SIG_193_08 : 112|12@1+ (0.1,0.0) [0|4095] "Nm" ADAS_ECU_TEMP_SENSOR
 SG_ SIG_193_09 : 124|12@1+ (0.1,0.0) [0|4095] "m" ADAS_ECU_TEMP_SENSOR
 SG_ SIG_193_10 : 136|12@1+ (0.1,0.0) [0|4095] "C" ADAS_ECU_TEMP_SENSOR
 SG_ SIG_193_11 : 148|12@1+ (0.1,0.0) [0|4095] "deg" ADAS_ECU_TEMP_SENSOR
 SG_ RouteInfoChar_00 : 160|8@1+ (1,0) [0|255] "ascii" ADAS_ECU_TEMP_SENSOR
 SG_ RouteInfoChar_01 : 168|8@1+ (1,0) [0|255] "ascii" ADAS_ECU_TEMP_SENSOR
 SG_ RouteInfoChar_02 : 176|8@1+ (1,0) [0|255] "ascii" ADAS_ECU_TEMP_SENSOR
 SG_ RouteInfoChar_03 : 184|8@1+ (1,0) [0|255] "ascii" ADAS_ECU_TEMP_SENSOR
 SG_ RouteInfoChar_04 : 192|8@1+ (1,0) [0|255] "ascii" ADAS_ECU_TEMP_SENSOR
 SG_ RouteInfoChar_05 : 200|8@1+ (1,0) [0|255] "ascii" ADAS_ECU_TEMP_SENSOR
 SG_ RouteInfoChar_06 : 208|8@1+ (1,0) [0|255] "ascii" ADAS_ECU_TEMP_SENSOR
 SG_ RouteInfoChar_07 : 216|8@1+ (1,0) [0|255] "ascii" ADAS_ECU_TEMP_SENSOR
 SG_ RouteInfoChar_08 : 224|8@1+ (1,0) [0|255] "ascii" ADAS_ECU_TEMP_SENSOR
 SG_ RouteInfoChar_09 : 232|8@1+ (1,0) [0|255] "ascii" ADAS_ECU_TEMP_SENSOR
 SG_ RouteInfoChar_10 : 240|8@1+ (1,0) [0|255] "ascii" ADAS_ECU_TEMP_SENSOR
 SG_ RouteInfoChar_11 : 248|8@1+ (1,0) [0|255] "ascii" ADAS_ECU_TEMP_SENSOR
 SG_ RouteInfoChar_12 : 256|8@1+ (1,0) [0|255] "ascii" ADAS_ECU_TEMP_SENSOR
 SG_ RouteInfoChar_13 : 264|8@1+ (1,0) [0|255] "ascii" ADAS_ECU_TEMP_SENSOR
 SG_ RouteInfoChar_14 : 272|8@1+ (1,0) [0|255] "ascii" ADAS_ECU_TEMP_SENSOR
 SG_ RouteInfoChar_15 : 280|8@1+ (1,0) [0|255] "ascii" ADAS_ECU_TEMP_SENSOR
 SG_ RouteInfoChar_16 : 288|8@1+ (1,0) [0|255] "ascii" ADAS_ECU_TEMP_SENSOR
 SG_ RouteInfoChar_17 : 296|8@1+ (1,0) [0|255] "ascii" ADAS_ECU_TEMP_SENSOR
 SG_ RouteInfoChar_18 : 304|8@1+ (1,0) [0|255] "ascii" ADAS_ECU_TEMP_SENSOR
 SG_ RouteInfoChar_19 : 312|8@1+ (1,0) [0|255] "ascii" ADAS_ECU_TEMP_SENSOR
 SG_ RouteInfoChar_20 : 320|8@1+ (1,0) [0|255] "ascii" ADAS_ECU_TEMP_SENSOR
 SG_ RouteInfoChar_21 : 328|8@1+ (1,0) [0|255] "ascii" ADAS_ECU_TEMP_SENSOR
 SG_ RouteInfoChar_22 : 336|8@1+ (1,0) [0|255] "ascii" ADAS_ECU_TEMP_SENSOR
 SG_ RouteInfoChar_23 : 344|8@1+ (1,0) [0|255] "ascii" ADAS_ECU_TEMP_SENSOR
 SG_ RouteInfoChar_24 : 352|8@1+ (1,0) [0|255] "ascii" ADAS_ECU_TEMP_SENSOR
 SG_ RouteInfoChar_25 : 360|8@1+ (1,0) [0|255] "ascii" ADAS_ECU_TEMP_SENSOR
 SG_ RouteInfoChar_26 : 368|8@1+ (1,0) [0|255] "ascii" ADAS_ECU_TEMP_SENSOR
 SG_ RouteInfoChar_27 : 376|8@1+ (1,0) [0|255] "ascii" ADAS_ECU_TEMP_SENSOR
 SG_ RouteInfoChar_28 : 384|8@1+ (1,0) [0|255] "ascii" ADAS_ECU_TEMP_SENSOR
 SG_ RouteInfoChar_29 : 392|8@1+ (1,0) [0|255] "ascii" ADAS_ECU_TEMP_SENSOR
 SG_ RouteInfoChar_30 : 400|8@1+ (1,0) [0|255] "ascii" ADAS_ECU_TEMP_SENSOR
 SG_ RouteInfoChar_31 : 408|8@1+ (1,0) [0|255] "ascii" ADAS_ECU_TEMP_SENSOR
 SG_ RouteInfoChar_32 : 416|8@1+ (1,0) [0|255] "ascii" ADAS_ECU_TEMP_SENSOR
 SG_ RouteInfoChar_33 : 424|8@1+ (1,0) [0|255] "ascii" ADAS_ECU_TEMP_SENSOR
 SG_ RouteInfoChar_34 : 432|8@1+ (1,0) [0|255] "ascii" ADAS_ECU_TEMP_SENSOR
 SG_ RouteInfoChar_35 : 440|8@1+ (1,0) [0|255] "ascii" ADAS_ECU_TEMP_SENSOR
 SG_ RouteInfoChar_36 : 448|8@1+ (1,0) [0|255] "ascii" ADAS_ECU_TEMP_SENSOR
 SG_ RouteInfoChar_37 : 456|8@1+ (1,0) [0|255] "ascii" ADAS_ECU_TEMP_SENSOR
 SG_ RouteInfoChar_38 : 464|8@1+ (1,0) [0|255] "ascii" ADAS_ECU_TEMP_SENSOR
 SG_ RouteInfoChar_39 : 472|8@1+ (1,0) [0|255] "ascii" ADAS_ECU_TEMP_SENSOR
 SG_ RouteInfoChar_40 : 480|8@1+ (1,0) [0|255] "ascii" ADAS_ECU_TEMP_SENSOR
 SG_ RouteInfoChar_41 : 488|8@1+ (1,0) [0|255] "ascii" ADAS_ECU_TEMP_SENSOR
 SG_ RouteInfoChar_42 : 496|8@1+ (1,0) [0|255] "ascii" ADAS_ECU_TEMP_SENSOR
 SG_ RouteInfoChar_43 : 504|8@1+ (1,0) [0|255] "ascii" ADAS_ECU_TEMP_SENSOR
CM_ BO_ 403 "Cycle=50ms; Channel=CAN0; CAN-FD; NominalBitrate=500kbit/s; DataBitrate=2000kbit/s;  Data request; receiver answers with response frame; PayloadRouteInfo='CENTRAL_GATEWAY -> ADAS_ECU_TEMP_SENSOR' in bytes 20-63; Gateway to CAN3";

BO_ 1555 RESP_019_ADAS_ECU_TEMP_SENSOR_TO_CENTRAL_GATEWAY: 16 ADAS_ECU_TEMP_SENSOR
 SG_ CRC8 : 0|8@1+ (1,0) [0|255] "" CENTRAL_GATEWAY
 SG_ ResponseCounter : 8|4@1+ (1,0) [0|15] "" CENTRAL_GATEWAY
 SG_ AckState : 12|4@1+ (1,0) [0|15] "" CENTRAL_GATEWAY
 SG_ ReceivedFrameId : 16|11@1+ (1,0) [0|2047] "" CENTRAL_GATEWAY
 SG_ ReceivedCounter : 27|4@1+ (1,0) [0|15] "" CENTRAL_GATEWAY
 SG_ ChecksumOk : 31|1@1+ (1,0) [0|1] "" CENTRAL_GATEWAY
 SG_ PayloadLength : 32|8@1+ (1,0) [0|64] "byte" CENTRAL_GATEWAY
 SG_ ErrorCode : 40|8@1+ (1,0) [0|255] "" CENTRAL_GATEWAY
 SG_ ProcessingTimeUs : 48|16@1+ (1,0) [0|65535] "us" CENTRAL_GATEWAY
 SG_ ResponseSequence : 64|16@1+ (1,0) [0|65535] "" CENTRAL_GATEWAY
 SG_ ReceivedCrc : 80|8@1+ (1,0) [0|255] "" CENTRAL_GATEWAY
 SG_ CalculatedCrc : 88|8@1+ (1,0) [0|255] "" CENTRAL_GATEWAY
CM_ BO_ 1555 "Cycle=50ms; Channel=CAN0; CAN-FD; NominalBitrate=500kbit/s; DataBitrate=2000kbit/s;  ResponseFor=0x193; ACK/NACK with CRC, DLC and counter check;";

BO_ 404 DATA_020_DIAG_TESTER_DIAGNOSTIC_REQUEST_TO_CENTRAL_GATEWAY: 64 DIAG_TESTER
 SG_ CRC8 : 0|8@1+ (1,0) [0|255] "" CENTRAL_GATEWAY
 SG_ AliveCounter : 8|4@1+ (1,0) [0|15] "" CENTRAL_GATEWAY
 SG_ MuxState : 12|4@1+ (1,0) [0|15] "" CENTRAL_GATEWAY
 SG_ SIG_194_00 : 16|12@1+ (0.1,0.0) [0|4095] "%" CENTRAL_GATEWAY
 SG_ SIG_194_01 : 28|12@1+ (0.1,0.0) [0|4095] "deg" CENTRAL_GATEWAY
 SG_ SIG_194_02 : 40|12@1+ (0.1,0.0) [0|4095] "V" CENTRAL_GATEWAY
 SG_ SIG_194_03 : 52|12@1+ (0.1,0.0) [0|4095] "C" CENTRAL_GATEWAY
 SG_ SIG_194_04 : 64|12@1+ (0.1,0.0) [0|4095] "Nm" CENTRAL_GATEWAY
 SG_ SIG_194_05 : 76|12@1+ (0.1,0.0) [0|4095] "rpm" CENTRAL_GATEWAY
 SG_ SIG_194_06 : 88|12@1+ (0.1,0.0) [0|4095] "C" CENTRAL_GATEWAY
 SG_ SIG_194_07 : 100|12@1+ (0.1,0.0) [0|4095] "m" CENTRAL_GATEWAY
 SG_ SIG_194_08 : 112|12@1+ (0.1,0.0) [0|4095] "rpm" CENTRAL_GATEWAY
 SG_ SIG_194_09 : 124|12@1+ (0.1,0.0) [0|4095] "km/h" CENTRAL_GATEWAY
 SG_ SIG_194_10 : 136|12@1+ (0.1,0.0) [0|4095] "m" CENTRAL_GATEWAY
 SG_ SIG_194_11 : 148|12@1+ (0.1,0.0) [0|4095] "km/h" CENTRAL_GATEWAY
 SG_ RouteInfoChar_00 : 160|8@1+ (1,0) [0|255] "ascii" CENTRAL_GATEWAY
 SG_ RouteInfoChar_01 : 168|8@1+ (1,0) [0|255] "ascii" CENTRAL_GATEWAY
 SG_ RouteInfoChar_02 : 176|8@1+ (1,0) [0|255] "ascii" CENTRAL_GATEWAY
 SG_ RouteInfoChar_03 : 184|8@1+ (1,0) [0|255] "ascii" CENTRAL_GATEWAY
 SG_ RouteInfoChar_04 : 192|8@1+ (1,0) [0|255] "ascii" CENTRAL_GATEWAY
 SG_ RouteInfoChar_05 : 200|8@1+ (1,0) [0|255] "ascii" CENTRAL_GATEWAY
 SG_ RouteInfoChar_06 : 208|8@1+ (1,0) [0|255] "ascii" CENTRAL_GATEWAY
 SG_ RouteInfoChar_07 : 216|8@1+ (1,0) [0|255] "ascii" CENTRAL_GATEWAY
 SG_ RouteInfoChar_08 : 224|8@1+ (1,0) [0|255] "ascii" CENTRAL_GATEWAY
 SG_ RouteInfoChar_09 : 232|8@1+ (1,0) [0|255] "ascii" CENTRAL_GATEWAY
 SG_ RouteInfoChar_10 : 240|8@1+ (1,0) [0|255] "ascii" CENTRAL_GATEWAY
 SG_ RouteInfoChar_11 : 248|8@1+ (1,0) [0|255] "ascii" CENTRAL_GATEWAY
 SG_ RouteInfoChar_12 : 256|8@1+ (1,0) [0|255] "ascii" CENTRAL_GATEWAY
 SG_ RouteInfoChar_13 : 264|8@1+ (1,0) [0|255] "ascii" CENTRAL_GATEWAY
 SG_ RouteInfoChar_14 : 272|8@1+ (1,0) [0|255] "ascii" CENTRAL_GATEWAY
 SG_ RouteInfoChar_15 : 280|8@1+ (1,0) [0|255] "ascii" CENTRAL_GATEWAY
 SG_ RouteInfoChar_16 : 288|8@1+ (1,0) [0|255] "ascii" CENTRAL_GATEWAY
 SG_ RouteInfoChar_17 : 296|8@1+ (1,0) [0|255] "ascii" CENTRAL_GATEWAY
 SG_ RouteInfoChar_18 : 304|8@1+ (1,0) [0|255] "ascii" CENTRAL_GATEWAY
 SG_ RouteInfoChar_19 : 312|8@1+ (1,0) [0|255] "ascii" CENTRAL_GATEWAY
 SG_ RouteInfoChar_20 : 320|8@1+ (1,0) [0|255] "ascii" CENTRAL_GATEWAY
 SG_ RouteInfoChar_21 : 328|8@1+ (1,0) [0|255] "ascii" CENTRAL_GATEWAY
 SG_ RouteInfoChar_22 : 336|8@1+ (1,0) [0|255] "ascii" CENTRAL_GATEWAY
 SG_ RouteInfoChar_23 : 344|8@1+ (1,0) [0|255] "ascii" CENTRAL_GATEWAY
 SG_ RouteInfoChar_24 : 352|8@1+ (1,0) [0|255] "ascii" CENTRAL_GATEWAY
 SG_ RouteInfoChar_25 : 360|8@1+ (1,0) [0|255] "ascii" CENTRAL_GATEWAY
 SG_ RouteInfoChar_26 : 368|8@1+ (1,0) [0|255] "ascii" CENTRAL_GATEWAY
 SG_ RouteInfoChar_27 : 376|8@1+ (1,0) [0|255] "ascii" CENTRAL_GATEWAY
 SG_ RouteInfoChar_28 : 384|8@1+ (1,0) [0|255] "ascii" CENTRAL_GATEWAY
 SG_ RouteInfoChar_29 : 392|8@1+ (1,0) [0|255] "ascii" CENTRAL_GATEWAY
 SG_ RouteInfoChar_30 : 400|8@1+ (1,0) [0|255] "ascii" CENTRAL_GATEWAY
 SG_ RouteInfoChar_31 : 408|8@1+ (1,0) [0|255] "ascii" CENTRAL_GATEWAY
 SG_ RouteInfoChar_32 : 416|8@1+ (1,0) [0|255] "ascii" CENTRAL_GATEWAY
 SG_ RouteInfoChar_33 : 424|8@1+ (1,0) [0|255] "ascii" CENTRAL_GATEWAY
 SG_ RouteInfoChar_34 : 432|8@1+ (1,0) [0|255] "ascii" CENTRAL_GATEWAY
 SG_ RouteInfoChar_35 : 440|8@1+ (1,0) [0|255] "ascii" CENTRAL_GATEWAY
 SG_ RouteInfoChar_36 : 448|8@1+ (1,0) [0|255] "ascii" CENTRAL_GATEWAY
 SG_ RouteInfoChar_37 : 456|8@1+ (1,0) [0|255] "ascii" CENTRAL_GATEWAY
 SG_ RouteInfoChar_38 : 464|8@1+ (1,0) [0|255] "ascii" CENTRAL_GATEWAY
 SG_ RouteInfoChar_39 : 472|8@1+ (1,0) [0|255] "ascii" CENTRAL_GATEWAY
 SG_ RouteInfoChar_40 : 480|8@1+ (1,0) [0|255] "ascii" CENTRAL_GATEWAY
 SG_ RouteInfoChar_41 : 488|8@1+ (1,0) [0|255] "ascii" CENTRAL_GATEWAY
 SG_ RouteInfoChar_42 : 496|8@1+ (1,0) [0|255] "ascii" CENTRAL_GATEWAY
 SG_ RouteInfoChar_43 : 504|8@1+ (1,0) [0|255] "ascii" CENTRAL_GATEWAY
CM_ BO_ 404 "Cycle=50ms; Channel=CAN3; CAN-FD; NominalBitrate=500kbit/s; DataBitrate=2000kbit/s;  Data request; receiver answers with response frame; PayloadRouteInfo='DIAG_TESTER -> CENTRAL_GATEWAY' in bytes 20-63;";

BO_ 1556 RESP_020_CENTRAL_GATEWAY_TO_DIAG_TESTER: 16 CENTRAL_GATEWAY
 SG_ CRC8 : 0|8@1+ (1,0) [0|255] "" DIAG_TESTER
 SG_ ResponseCounter : 8|4@1+ (1,0) [0|15] "" DIAG_TESTER
 SG_ AckState : 12|4@1+ (1,0) [0|15] "" DIAG_TESTER
 SG_ ReceivedFrameId : 16|11@1+ (1,0) [0|2047] "" DIAG_TESTER
 SG_ ReceivedCounter : 27|4@1+ (1,0) [0|15] "" DIAG_TESTER
 SG_ ChecksumOk : 31|1@1+ (1,0) [0|1] "" DIAG_TESTER
 SG_ PayloadLength : 32|8@1+ (1,0) [0|64] "byte" DIAG_TESTER
 SG_ ErrorCode : 40|8@1+ (1,0) [0|255] "" DIAG_TESTER
 SG_ ProcessingTimeUs : 48|16@1+ (1,0) [0|65535] "us" DIAG_TESTER
 SG_ ResponseSequence : 64|16@1+ (1,0) [0|65535] "" DIAG_TESTER
 SG_ ReceivedCrc : 80|8@1+ (1,0) [0|255] "" DIAG_TESTER
 SG_ CalculatedCrc : 88|8@1+ (1,0) [0|255] "" DIAG_TESTER
CM_ BO_ 1556 "Cycle=50ms; Channel=CAN3; CAN-FD; NominalBitrate=500kbit/s; DataBitrate=2000kbit/s;  ResponseFor=0x194; ACK/NACK with CRC, DLC and counter check;";

BO_ 405 DATA_021_LIDAR_FRONT_OBJECT_LIST_TO_ADAS_DOMAIN: 64 LIDAR_FRONT
 SG_ CRC8 : 0|8@1+ (1,0) [0|255] "" ADAS_DOMAIN
 SG_ AliveCounter : 8|4@1+ (1,0) [0|15] "" ADAS_DOMAIN
 SG_ MuxState : 12|4@1+ (1,0) [0|15] "" ADAS_DOMAIN
 SG_ SIG_195_00 : 16|12@1+ (0.1,0.0) [0|4095] "rpm" ADAS_DOMAIN
 SG_ SIG_195_01 : 28|12@1+ (0.1,0.0) [0|4095] "Nm" ADAS_DOMAIN
 SG_ SIG_195_02 : 40|12@1+ (0.1,0.0) [0|4095] "deg" ADAS_DOMAIN
 SG_ SIG_195_03 : 52|12@1+ (0.1,0.0) [0|4095] "%" ADAS_DOMAIN
 SG_ SIG_195_04 : 64|12@1+ (0.1,0.0) [0|4095] "C" ADAS_DOMAIN
 SG_ SIG_195_05 : 76|12@1+ (0.1,0.0) [0|4095] "C" ADAS_DOMAIN
 SG_ SIG_195_06 : 88|12@1+ (0.1,0.0) [0|4095] "Nm" ADAS_DOMAIN
 SG_ SIG_195_07 : 100|12@1+ (0.1,0.0) [0|4095] "%" ADAS_DOMAIN
 SG_ SIG_195_08 : 112|12@1+ (0.1,0.0) [0|4095] "km/h" ADAS_DOMAIN
 SG_ SIG_195_09 : 124|12@1+ (0.1,0.0) [0|4095] "deg" ADAS_DOMAIN
 SG_ SIG_195_10 : 136|12@1+ (0.1,0.0) [0|4095] "%" ADAS_DOMAIN
 SG_ SIG_195_11 : 148|12@1+ (0.1,0.0) [0|4095] "km/h" ADAS_DOMAIN
 SG_ RouteInfoChar_00 : 160|8@1+ (1,0) [0|255] "ascii" ADAS_DOMAIN
 SG_ RouteInfoChar_01 : 168|8@1+ (1,0) [0|255] "ascii" ADAS_DOMAIN
 SG_ RouteInfoChar_02 : 176|8@1+ (1,0) [0|255] "ascii" ADAS_DOMAIN
 SG_ RouteInfoChar_03 : 184|8@1+ (1,0) [0|255] "ascii" ADAS_DOMAIN
 SG_ RouteInfoChar_04 : 192|8@1+ (1,0) [0|255] "ascii" ADAS_DOMAIN
 SG_ RouteInfoChar_05 : 200|8@1+ (1,0) [0|255] "ascii" ADAS_DOMAIN
 SG_ RouteInfoChar_06 : 208|8@1+ (1,0) [0|255] "ascii" ADAS_DOMAIN
 SG_ RouteInfoChar_07 : 216|8@1+ (1,0) [0|255] "ascii" ADAS_DOMAIN
 SG_ RouteInfoChar_08 : 224|8@1+ (1,0) [0|255] "ascii" ADAS_DOMAIN
 SG_ RouteInfoChar_09 : 232|8@1+ (1,0) [0|255] "ascii" ADAS_DOMAIN
 SG_ RouteInfoChar_10 : 240|8@1+ (1,0) [0|255] "ascii" ADAS_DOMAIN
 SG_ RouteInfoChar_11 : 248|8@1+ (1,0) [0|255] "ascii" ADAS_DOMAIN
 SG_ RouteInfoChar_12 : 256|8@1+ (1,0) [0|255] "ascii" ADAS_DOMAIN
 SG_ RouteInfoChar_13 : 264|8@1+ (1,0) [0|255] "ascii" ADAS_DOMAIN
 SG_ RouteInfoChar_14 : 272|8@1+ (1,0) [0|255] "ascii" ADAS_DOMAIN
 SG_ RouteInfoChar_15 : 280|8@1+ (1,0) [0|255] "ascii" ADAS_DOMAIN
 SG_ RouteInfoChar_16 : 288|8@1+ (1,0) [0|255] "ascii" ADAS_DOMAIN
 SG_ RouteInfoChar_17 : 296|8@1+ (1,0) [0|255] "ascii" ADAS_DOMAIN
 SG_ RouteInfoChar_18 : 304|8@1+ (1,0) [0|255] "ascii" ADAS_DOMAIN
 SG_ RouteInfoChar_19 : 312|8@1+ (1,0) [0|255] "ascii" ADAS_DOMAIN
 SG_ RouteInfoChar_20 : 320|8@1+ (1,0) [0|255] "ascii" ADAS_DOMAIN
 SG_ RouteInfoChar_21 : 328|8@1+ (1,0) [0|255] "ascii" ADAS_DOMAIN
 SG_ RouteInfoChar_22 : 336|8@1+ (1,0) [0|255] "ascii" ADAS_DOMAIN
 SG_ RouteInfoChar_23 : 344|8@1+ (1,0) [0|255] "ascii" ADAS_DOMAIN
 SG_ RouteInfoChar_24 : 352|8@1+ (1,0) [0|255] "ascii" ADAS_DOMAIN
 SG_ RouteInfoChar_25 : 360|8@1+ (1,0) [0|255] "ascii" ADAS_DOMAIN
 SG_ RouteInfoChar_26 : 368|8@1+ (1,0) [0|255] "ascii" ADAS_DOMAIN
 SG_ RouteInfoChar_27 : 376|8@1+ (1,0) [0|255] "ascii" ADAS_DOMAIN
 SG_ RouteInfoChar_28 : 384|8@1+ (1,0) [0|255] "ascii" ADAS_DOMAIN
 SG_ RouteInfoChar_29 : 392|8@1+ (1,0) [0|255] "ascii" ADAS_DOMAIN
 SG_ RouteInfoChar_30 : 400|8@1+ (1,0) [0|255] "ascii" ADAS_DOMAIN
 SG_ RouteInfoChar_31 : 408|8@1+ (1,0) [0|255] "ascii" ADAS_DOMAIN
 SG_ RouteInfoChar_32 : 416|8@1+ (1,0) [0|255] "ascii" ADAS_DOMAIN
 SG_ RouteInfoChar_33 : 424|8@1+ (1,0) [0|255] "ascii" ADAS_DOMAIN
 SG_ RouteInfoChar_34 : 432|8@1+ (1,0) [0|255] "ascii" ADAS_DOMAIN
 SG_ RouteInfoChar_35 : 440|8@1+ (1,0) [0|255] "ascii" ADAS_DOMAIN
 SG_ RouteInfoChar_36 : 448|8@1+ (1,0) [0|255] "ascii" ADAS_DOMAIN
 SG_ RouteInfoChar_37 : 456|8@1+ (1,0) [0|255] "ascii" ADAS_DOMAIN
 SG_ RouteInfoChar_38 : 464|8@1+ (1,0) [0|255] "ascii" ADAS_DOMAIN
 SG_ RouteInfoChar_39 : 472|8@1+ (1,0) [0|255] "ascii" ADAS_DOMAIN
 SG_ RouteInfoChar_40 : 480|8@1+ (1,0) [0|255] "ascii" ADAS_DOMAIN
 SG_ RouteInfoChar_41 : 488|8@1+ (1,0) [0|255] "ascii" ADAS_DOMAIN
 SG_ RouteInfoChar_42 : 496|8@1+ (1,0) [0|255] "ascii" ADAS_DOMAIN
 SG_ RouteInfoChar_43 : 504|8@1+ (1,0) [0|255] "ascii" ADAS_DOMAIN
CM_ BO_ 405 "Cycle=10ms; Channel=CAN1; CAN-FD; NominalBitrate=500kbit/s; DataBitrate=2000kbit/s;  Data request; receiver answers with response frame; PayloadRouteInfo='LIDAR_FRONT -> ADAS_DOMAIN' in bytes 20-63;";

BO_ 1557 RESP_021_ADAS_DOMAIN_TO_LIDAR_FRONT: 16 ADAS_DOMAIN
 SG_ CRC8 : 0|8@1+ (1,0) [0|255] "" LIDAR_FRONT
 SG_ ResponseCounter : 8|4@1+ (1,0) [0|15] "" LIDAR_FRONT
 SG_ AckState : 12|4@1+ (1,0) [0|15] "" LIDAR_FRONT
 SG_ ReceivedFrameId : 16|11@1+ (1,0) [0|2047] "" LIDAR_FRONT
 SG_ ReceivedCounter : 27|4@1+ (1,0) [0|15] "" LIDAR_FRONT
 SG_ ChecksumOk : 31|1@1+ (1,0) [0|1] "" LIDAR_FRONT
 SG_ PayloadLength : 32|8@1+ (1,0) [0|64] "byte" LIDAR_FRONT
 SG_ ErrorCode : 40|8@1+ (1,0) [0|255] "" LIDAR_FRONT
 SG_ ProcessingTimeUs : 48|16@1+ (1,0) [0|65535] "us" LIDAR_FRONT
 SG_ ResponseSequence : 64|16@1+ (1,0) [0|65535] "" LIDAR_FRONT
 SG_ ReceivedCrc : 80|8@1+ (1,0) [0|255] "" LIDAR_FRONT
 SG_ CalculatedCrc : 88|8@1+ (1,0) [0|255] "" LIDAR_FRONT
CM_ BO_ 1557 "Cycle=10ms; Channel=CAN1; CAN-FD; NominalBitrate=500kbit/s; DataBitrate=2000kbit/s;  ResponseFor=0x195; ACK/NACK with CRC, DLC and counter check;";

BO_ 406 DATA_022_AMBIENT_TEMP_SENSOR_AMBIENT_TEMPERATURE_TO_CENTRAL_GATEWAY: 64 AMBIENT_TEMP_SENSOR
 SG_ CRC8 : 0|8@1+ (1,0) [0|255] "" CENTRAL_GATEWAY
 SG_ AliveCounter : 8|4@1+ (1,0) [0|15] "" CENTRAL_GATEWAY
 SG_ MuxState : 12|4@1+ (1,0) [0|15] "" CENTRAL_GATEWAY
 SG_ SIG_196_00 : 16|12@1+ (0.1,0.0) [0|4095] "%" CENTRAL_GATEWAY
 SG_ SIG_196_01 : 28|12@1+ (0.1,0.0) [0|4095] "V" CENTRAL_GATEWAY
 SG_ SIG_196_02 : 40|12@1+ (0.1,0.0) [0|4095] "C" CENTRAL_GATEWAY
 SG_ SIG_196_03 : 52|12@1+ (0.1,0.0) [0|4095] "V" CENTRAL_GATEWAY
 SG_ SIG_196_04 : 64|12@1+ (0.1,0.0) [0|4095] "%" CENTRAL_GATEWAY
 SG_ SIG_196_05 : 76|12@1+ (0.1,0.0) [0|4095] "m" CENTRAL_GATEWAY
 SG_ SIG_196_06 : 88|12@1+ (0.1,0.0) [0|4095] "C" CENTRAL_GATEWAY
 SG_ SIG_196_07 : 100|12@1+ (0.1,0.0) [0|4095] "deg" CENTRAL_GATEWAY
 SG_ SIG_196_08 : 112|12@1+ (0.1,0.0) [0|4095] "Nm" CENTRAL_GATEWAY
 SG_ SIG_196_09 : 124|12@1+ (0.1,0.0) [0|4095] "V" CENTRAL_GATEWAY
 SG_ SIG_196_10 : 136|12@1+ (0.1,0.0) [0|4095] "Nm" CENTRAL_GATEWAY
 SG_ SIG_196_11 : 148|12@1+ (0.1,0.0) [0|4095] "km/h" CENTRAL_GATEWAY
 SG_ RouteInfoChar_00 : 160|8@1+ (1,0) [0|255] "ascii" CENTRAL_GATEWAY
 SG_ RouteInfoChar_01 : 168|8@1+ (1,0) [0|255] "ascii" CENTRAL_GATEWAY
 SG_ RouteInfoChar_02 : 176|8@1+ (1,0) [0|255] "ascii" CENTRAL_GATEWAY
 SG_ RouteInfoChar_03 : 184|8@1+ (1,0) [0|255] "ascii" CENTRAL_GATEWAY
 SG_ RouteInfoChar_04 : 192|8@1+ (1,0) [0|255] "ascii" CENTRAL_GATEWAY
 SG_ RouteInfoChar_05 : 200|8@1+ (1,0) [0|255] "ascii" CENTRAL_GATEWAY
 SG_ RouteInfoChar_06 : 208|8@1+ (1,0) [0|255] "ascii" CENTRAL_GATEWAY
 SG_ RouteInfoChar_07 : 216|8@1+ (1,0) [0|255] "ascii" CENTRAL_GATEWAY
 SG_ RouteInfoChar_08 : 224|8@1+ (1,0) [0|255] "ascii" CENTRAL_GATEWAY
 SG_ RouteInfoChar_09 : 232|8@1+ (1,0) [0|255] "ascii" CENTRAL_GATEWAY
 SG_ RouteInfoChar_10 : 240|8@1+ (1,0) [0|255] "ascii" CENTRAL_GATEWAY
 SG_ RouteInfoChar_11 : 248|8@1+ (1,0) [0|255] "ascii" CENTRAL_GATEWAY
 SG_ RouteInfoChar_12 : 256|8@1+ (1,0) [0|255] "ascii" CENTRAL_GATEWAY
 SG_ RouteInfoChar_13 : 264|8@1+ (1,0) [0|255] "ascii" CENTRAL_GATEWAY
 SG_ RouteInfoChar_14 : 272|8@1+ (1,0) [0|255] "ascii" CENTRAL_GATEWAY
 SG_ RouteInfoChar_15 : 280|8@1+ (1,0) [0|255] "ascii" CENTRAL_GATEWAY
 SG_ RouteInfoChar_16 : 288|8@1+ (1,0) [0|255] "ascii" CENTRAL_GATEWAY
 SG_ RouteInfoChar_17 : 296|8@1+ (1,0) [0|255] "ascii" CENTRAL_GATEWAY
 SG_ RouteInfoChar_18 : 304|8@1+ (1,0) [0|255] "ascii" CENTRAL_GATEWAY
 SG_ RouteInfoChar_19 : 312|8@1+ (1,0) [0|255] "ascii" CENTRAL_GATEWAY
 SG_ RouteInfoChar_20 : 320|8@1+ (1,0) [0|255] "ascii" CENTRAL_GATEWAY
 SG_ RouteInfoChar_21 : 328|8@1+ (1,0) [0|255] "ascii" CENTRAL_GATEWAY
 SG_ RouteInfoChar_22 : 336|8@1+ (1,0) [0|255] "ascii" CENTRAL_GATEWAY
 SG_ RouteInfoChar_23 : 344|8@1+ (1,0) [0|255] "ascii" CENTRAL_GATEWAY
 SG_ RouteInfoChar_24 : 352|8@1+ (1,0) [0|255] "ascii" CENTRAL_GATEWAY
 SG_ RouteInfoChar_25 : 360|8@1+ (1,0) [0|255] "ascii" CENTRAL_GATEWAY
 SG_ RouteInfoChar_26 : 368|8@1+ (1,0) [0|255] "ascii" CENTRAL_GATEWAY
 SG_ RouteInfoChar_27 : 376|8@1+ (1,0) [0|255] "ascii" CENTRAL_GATEWAY
 SG_ RouteInfoChar_28 : 384|8@1+ (1,0) [0|255] "ascii" CENTRAL_GATEWAY
 SG_ RouteInfoChar_29 : 392|8@1+ (1,0) [0|255] "ascii" CENTRAL_GATEWAY
 SG_ RouteInfoChar_30 : 400|8@1+ (1,0) [0|255] "ascii" CENTRAL_GATEWAY
 SG_ RouteInfoChar_31 : 408|8@1+ (1,0) [0|255] "ascii" CENTRAL_GATEWAY
 SG_ RouteInfoChar_32 : 416|8@1+ (1,0) [0|255] "ascii" CENTRAL_GATEWAY
 SG_ RouteInfoChar_33 : 424|8@1+ (1,0) [0|255] "ascii" CENTRAL_GATEWAY
 SG_ RouteInfoChar_34 : 432|8@1+ (1,0) [0|255] "ascii" CENTRAL_GATEWAY
 SG_ RouteInfoChar_35 : 440|8@1+ (1,0) [0|255] "ascii" CENTRAL_GATEWAY
 SG_ RouteInfoChar_36 : 448|8@1+ (1,0) [0|255] "ascii" CENTRAL_GATEWAY
 SG_ RouteInfoChar_37 : 456|8@1+ (1,0) [0|255] "ascii" CENTRAL_GATEWAY
 SG_ RouteInfoChar_38 : 464|8@1+ (1,0) [0|255] "ascii" CENTRAL_GATEWAY
 SG_ RouteInfoChar_39 : 472|8@1+ (1,0) [0|255] "ascii" CENTRAL_GATEWAY
 SG_ RouteInfoChar_40 : 480|8@1+ (1,0) [0|255] "ascii" CENTRAL_GATEWAY
 SG_ RouteInfoChar_41 : 488|8@1+ (1,0) [0|255] "ascii" CENTRAL_GATEWAY
 SG_ RouteInfoChar_42 : 496|8@1+ (1,0) [0|255] "ascii" CENTRAL_GATEWAY
 SG_ RouteInfoChar_43 : 504|8@1+ (1,0) [0|255] "ascii" CENTRAL_GATEWAY
CM_ BO_ 406 "Cycle=50ms; Channel=CAN3; CAN-FD; NominalBitrate=500kbit/s; DataBitrate=2000kbit/s;  Data request; receiver answers with response frame; PayloadRouteInfo='AMBIENT_TEMP_SENSOR -> CENTRAL_GATEWAY' in bytes 20-63;";

BO_ 1558 RESP_022_CENTRAL_GATEWAY_TO_AMBIENT_TEMP_SENSOR: 16 CENTRAL_GATEWAY
 SG_ CRC8 : 0|8@1+ (1,0) [0|255] "" AMBIENT_TEMP_SENSOR
 SG_ ResponseCounter : 8|4@1+ (1,0) [0|15] "" AMBIENT_TEMP_SENSOR
 SG_ AckState : 12|4@1+ (1,0) [0|15] "" AMBIENT_TEMP_SENSOR
 SG_ ReceivedFrameId : 16|11@1+ (1,0) [0|2047] "" AMBIENT_TEMP_SENSOR
 SG_ ReceivedCounter : 27|4@1+ (1,0) [0|15] "" AMBIENT_TEMP_SENSOR
 SG_ ChecksumOk : 31|1@1+ (1,0) [0|1] "" AMBIENT_TEMP_SENSOR
 SG_ PayloadLength : 32|8@1+ (1,0) [0|64] "byte" AMBIENT_TEMP_SENSOR
 SG_ ErrorCode : 40|8@1+ (1,0) [0|255] "" AMBIENT_TEMP_SENSOR
 SG_ ProcessingTimeUs : 48|16@1+ (1,0) [0|65535] "us" AMBIENT_TEMP_SENSOR
 SG_ ResponseSequence : 64|16@1+ (1,0) [0|65535] "" AMBIENT_TEMP_SENSOR
 SG_ ReceivedCrc : 80|8@1+ (1,0) [0|255] "" AMBIENT_TEMP_SENSOR
 SG_ CalculatedCrc : 88|8@1+ (1,0) [0|255] "" AMBIENT_TEMP_SENSOR
CM_ BO_ 1558 "Cycle=50ms; Channel=CAN3; CAN-FD; NominalBitrate=500kbit/s; DataBitrate=2000kbit/s;  ResponseFor=0x196; ACK/NACK with CRC, DLC and counter check;";

BO_ 407 DATA_023_ADAS_ECU_TEMP_SENSOR_ECU_TEMPERATURE_TO_CENTRAL_GATEWAY: 64 ADAS_ECU_TEMP_SENSOR
 SG_ CRC8 : 0|8@1+ (1,0) [0|255] "" CENTRAL_GATEWAY
 SG_ AliveCounter : 8|4@1+ (1,0) [0|15] "" CENTRAL_GATEWAY
 SG_ MuxState : 12|4@1+ (1,0) [0|15] "" CENTRAL_GATEWAY
 SG_ SIG_197_00 : 16|12@1+ (0.1,0.0) [0|4095] "obj" CENTRAL_GATEWAY
 SG_ SIG_197_01 : 28|12@1+ (0.1,0.0) [0|4095] "m" CENTRAL_GATEWAY
 SG_ SIG_197_02 : 40|12@1+ (0.1,0.0) [0|4095] "km/h" CENTRAL_GATEWAY
 SG_ SIG_197_03 : 52|12@1+ (0.1,0.0) [0|4095] "A" CENTRAL_GATEWAY
 SG_ SIG_197_04 : 64|12@1+ (0.1,0.0) [0|4095] "km/h" CENTRAL_GATEWAY
 SG_ SIG_197_05 : 76|12@1+ (0.1,0.0) [0|4095] "km/h" CENTRAL_GATEWAY
 SG_ SIG_197_06 : 88|12@1+ (0.1,0.0) [0|4095] "obj" CENTRAL_GATEWAY
 SG_ SIG_197_07 : 100|12@1+ (0.1,0.0) [0|4095] "C" CENTRAL_GATEWAY
 SG_ SIG_197_08 : 112|12@1+ (0.1,0.0) [0|4095] "m" CENTRAL_GATEWAY
 SG_ SIG_197_09 : 124|12@1+ (0.1,0.0) [0|4095] "m" CENTRAL_GATEWAY
 SG_ SIG_197_10 : 136|12@1+ (0.1,0.0) [0|4095] "deg" CENTRAL_GATEWAY
 SG_ SIG_197_11 : 148|12@1+ (0.1,0.0) [0|4095] "km/h" CENTRAL_GATEWAY
 SG_ RouteInfoChar_00 : 160|8@1+ (1,0) [0|255] "ascii" CENTRAL_GATEWAY
 SG_ RouteInfoChar_01 : 168|8@1+ (1,0) [0|255] "ascii" CENTRAL_GATEWAY
 SG_ RouteInfoChar_02 : 176|8@1+ (1,0) [0|255] "ascii" CENTRAL_GATEWAY
 SG_ RouteInfoChar_03 : 184|8@1+ (1,0) [0|255] "ascii" CENTRAL_GATEWAY
 SG_ RouteInfoChar_04 : 192|8@1+ (1,0) [0|255] "ascii" CENTRAL_GATEWAY
 SG_ RouteInfoChar_05 : 200|8@1+ (1,0) [0|255] "ascii" CENTRAL_GATEWAY
 SG_ RouteInfoChar_06 : 208|8@1+ (1,0) [0|255] "ascii" CENTRAL_GATEWAY
 SG_ RouteInfoChar_07 : 216|8@1+ (1,0) [0|255] "ascii" CENTRAL_GATEWAY
 SG_ RouteInfoChar_08 : 224|8@1+ (1,0) [0|255] "ascii" CENTRAL_GATEWAY
 SG_ RouteInfoChar_09 : 232|8@1+ (1,0) [0|255] "ascii" CENTRAL_GATEWAY
 SG_ RouteInfoChar_10 : 240|8@1+ (1,0) [0|255] "ascii" CENTRAL_GATEWAY
 SG_ RouteInfoChar_11 : 248|8@1+ (1,0) [0|255] "ascii" CENTRAL_GATEWAY
 SG_ RouteInfoChar_12 : 256|8@1+ (1,0) [0|255] "ascii" CENTRAL_GATEWAY
 SG_ RouteInfoChar_13 : 264|8@1+ (1,0) [0|255] "ascii" CENTRAL_GATEWAY
 SG_ RouteInfoChar_14 : 272|8@1+ (1,0) [0|255] "ascii" CENTRAL_GATEWAY
 SG_ RouteInfoChar_15 : 280|8@1+ (1,0) [0|255] "ascii" CENTRAL_GATEWAY
 SG_ RouteInfoChar_16 : 288|8@1+ (1,0) [0|255] "ascii" CENTRAL_GATEWAY
 SG_ RouteInfoChar_17 : 296|8@1+ (1,0) [0|255] "ascii" CENTRAL_GATEWAY
 SG_ RouteInfoChar_18 : 304|8@1+ (1,0) [0|255] "ascii" CENTRAL_GATEWAY
 SG_ RouteInfoChar_19 : 312|8@1+ (1,0) [0|255] "ascii" CENTRAL_GATEWAY
 SG_ RouteInfoChar_20 : 320|8@1+ (1,0) [0|255] "ascii" CENTRAL_GATEWAY
 SG_ RouteInfoChar_21 : 328|8@1+ (1,0) [0|255] "ascii" CENTRAL_GATEWAY
 SG_ RouteInfoChar_22 : 336|8@1+ (1,0) [0|255] "ascii" CENTRAL_GATEWAY
 SG_ RouteInfoChar_23 : 344|8@1+ (1,0) [0|255] "ascii" CENTRAL_GATEWAY
 SG_ RouteInfoChar_24 : 352|8@1+ (1,0) [0|255] "ascii" CENTRAL_GATEWAY
 SG_ RouteInfoChar_25 : 360|8@1+ (1,0) [0|255] "ascii" CENTRAL_GATEWAY
 SG_ RouteInfoChar_26 : 368|8@1+ (1,0) [0|255] "ascii" CENTRAL_GATEWAY
 SG_ RouteInfoChar_27 : 376|8@1+ (1,0) [0|255] "ascii" CENTRAL_GATEWAY
 SG_ RouteInfoChar_28 : 384|8@1+ (1,0) [0|255] "ascii" CENTRAL_GATEWAY
 SG_ RouteInfoChar_29 : 392|8@1+ (1,0) [0|255] "ascii" CENTRAL_GATEWAY
 SG_ RouteInfoChar_30 : 400|8@1+ (1,0) [0|255] "ascii" CENTRAL_GATEWAY
 SG_ RouteInfoChar_31 : 408|8@1+ (1,0) [0|255] "ascii" CENTRAL_GATEWAY
 SG_ RouteInfoChar_32 : 416|8@1+ (1,0) [0|255] "ascii" CENTRAL_GATEWAY
 SG_ RouteInfoChar_33 : 424|8@1+ (1,0) [0|255] "ascii" CENTRAL_GATEWAY
 SG_ RouteInfoChar_34 : 432|8@1+ (1,0) [0|255] "ascii" CENTRAL_GATEWAY
 SG_ RouteInfoChar_35 : 440|8@1+ (1,0) [0|255] "ascii" CENTRAL_GATEWAY
 SG_ RouteInfoChar_36 : 448|8@1+ (1,0) [0|255] "ascii" CENTRAL_GATEWAY
 SG_ RouteInfoChar_37 : 456|8@1+ (1,0) [0|255] "ascii" CENTRAL_GATEWAY
 SG_ RouteInfoChar_38 : 464|8@1+ (1,0) [0|255] "ascii" CENTRAL_GATEWAY
 SG_ RouteInfoChar_39 : 472|8@1+ (1,0) [0|255] "ascii" CENTRAL_GATEWAY
 SG_ RouteInfoChar_40 : 480|8@1+ (1,0) [0|255] "ascii" CENTRAL_GATEWAY
 SG_ RouteInfoChar_41 : 488|8@1+ (1,0) [0|255] "ascii" CENTRAL_GATEWAY
 SG_ RouteInfoChar_42 : 496|8@1+ (1,0) [0|255] "ascii" CENTRAL_GATEWAY
 SG_ RouteInfoChar_43 : 504|8@1+ (1,0) [0|255] "ascii" CENTRAL_GATEWAY
CM_ BO_ 407 "Cycle=50ms; Channel=CAN3; CAN-FD; NominalBitrate=500kbit/s; DataBitrate=2000kbit/s;  Data request; receiver answers with response frame; PayloadRouteInfo='ADAS_ECU_TEMP_SENSOR -> CENTRAL_GATEWAY' in bytes 20-63;";

BO_ 1559 RESP_023_CENTRAL_GATEWAY_TO_ADAS_ECU_TEMP_SENSOR: 16 CENTRAL_GATEWAY
 SG_ CRC8 : 0|8@1+ (1,0) [0|255] "" ADAS_ECU_TEMP_SENSOR
 SG_ ResponseCounter : 8|4@1+ (1,0) [0|15] "" ADAS_ECU_TEMP_SENSOR
 SG_ AckState : 12|4@1+ (1,0) [0|15] "" ADAS_ECU_TEMP_SENSOR
 SG_ ReceivedFrameId : 16|11@1+ (1,0) [0|2047] "" ADAS_ECU_TEMP_SENSOR
 SG_ ReceivedCounter : 27|4@1+ (1,0) [0|15] "" ADAS_ECU_TEMP_SENSOR
 SG_ ChecksumOk : 31|1@1+ (1,0) [0|1] "" ADAS_ECU_TEMP_SENSOR
 SG_ PayloadLength : 32|8@1+ (1,0) [0|64] "byte" ADAS_ECU_TEMP_SENSOR
 SG_ ErrorCode : 40|8@1+ (1,0) [0|255] "" ADAS_ECU_TEMP_SENSOR
 SG_ ProcessingTimeUs : 48|16@1+ (1,0) [0|65535] "us" ADAS_ECU_TEMP_SENSOR
 SG_ ResponseSequence : 64|16@1+ (1,0) [0|65535] "" ADAS_ECU_TEMP_SENSOR
 SG_ ReceivedCrc : 80|8@1+ (1,0) [0|255] "" ADAS_ECU_TEMP_SENSOR
 SG_ CalculatedCrc : 88|8@1+ (1,0) [0|255] "" ADAS_ECU_TEMP_SENSOR
CM_ BO_ 1559 "Cycle=50ms; Channel=CAN3; CAN-FD; NominalBitrate=500kbit/s; DataBitrate=2000kbit/s;  ResponseFor=0x197; ACK/NACK with CRC, DLC and counter check;";
