VERSION "Realistic CAN Trace Generator"

NS_ :

BS_:

BU_: AIRBAG_CONTROL_UNIT BODY_CONTROL_MODULE CENTRAL_GATEWAY DIAG_TESTER DOOR_MODULE_FL DOOR_MODULE_FR DOOR_MODULE_RL DOOR_MODULE_RR HVAC_CONTROLLER INFOTAINMENT_HEAD_UNIT INSTRUMENT_CLUSTER_KOMBI KESSY_KEYLESS_ACCESS LIGHT_CONTROL_MODULE PARK_DISTANCE_CONTROL RAIN_LIGHT_SENSOR REAR_VIEW_CAMERA SEAT_CONTROLLER_DRIVER SEAT_CONTROLLER_PASSENGER SUNROOF_CONTROLLER TAILGATE_MODULE TELEMATICS_CONTROL_UNIT WIPER_CONTROLLER

BO_ 384 DATA_000_BODY_CONTROL_MODULE_BODY_STATE_TO_KESSY_KEYLESS_ACCESS: 64 BODY_CONTROL_MODULE
 SG_ CRC8 : 0|8@1+ (1,0) [0|255] "" KESSY_KEYLESS_ACCESS
 SG_ AliveCounter : 8|4@1+ (1,0) [0|15] "" KESSY_KEYLESS_ACCESS
 SG_ MuxState : 12|4@1+ (1,0) [0|15] "" KESSY_KEYLESS_ACCESS
 SG_ SIG_180_00 : 16|12@1+ (0.1,0.0) [0|4095] "rpm" KESSY_KEYLESS_ACCESS
 SG_ SIG_180_01 : 28|12@1+ (0.1,0.0) [0|4095] "km/h" KESSY_KEYLESS_ACCESS
 SG_ SIG_180_02 : 40|12@1+ (0.1,0.0) [0|4095] "V" KESSY_KEYLESS_ACCESS
 SG_ SIG_180_03 : 52|12@1+ (0.1,0.0) [0|4095] "Nm" KESSY_KEYLESS_ACCESS
 SG_ SIG_180_04 : 64|12@1+ (0.1,0.0) [0|4095] "Nm" KESSY_KEYLESS_ACCESS
 SG_ SIG_180_05 : 76|12@1+ (0.1,0.0) [0|4095] "deg" KESSY_KEYLESS_ACCESS
 SG_ SIG_180_06 : 88|12@1+ (0.1,0.0) [0|4095] "rpm" KESSY_KEYLESS_ACCESS
 SG_ SIG_180_07 : 100|12@1+ (0.1,0.0) [0|4095] "m" KESSY_KEYLESS_ACCESS
 SG_ SIG_180_08 : 112|12@1+ (0.1,0.0) [0|4095] "rpm" KESSY_KEYLESS_ACCESS
 SG_ SIG_180_09 : 124|12@1+ (0.1,0.0) [0|4095] "obj" KESSY_KEYLESS_ACCESS
 SG_ SIG_180_10 : 136|12@1+ (0.1,0.0) [0|4095] "%" KESSY_KEYLESS_ACCESS
 SG_ SIG_180_11 : 148|12@1+ (0.1,0.0) [0|4095] "km/h" KESSY_KEYLESS_ACCESS
 SG_ RouteInfoChar_00 : 160|8@1+ (1,0) [0|255] "ascii" KESSY_KEYLESS_ACCESS
 SG_ RouteInfoChar_01 : 168|8@1+ (1,0) [0|255] "ascii" KESSY_KEYLESS_ACCESS
 SG_ RouteInfoChar_02 : 176|8@1+ (1,0) [0|255] "ascii" KESSY_KEYLESS_ACCESS
 SG_ RouteInfoChar_03 : 184|8@1+ (1,0) [0|255] "ascii" KESSY_KEYLESS_ACCESS
 SG_ RouteInfoChar_04 : 192|8@1+ (1,0) [0|255] "ascii" KESSY_KEYLESS_ACCESS
 SG_ RouteInfoChar_05 : 200|8@1+ (1,0) [0|255] "ascii" KESSY_KEYLESS_ACCESS
 SG_ RouteInfoChar_06 : 208|8@1+ (1,0) [0|255] "ascii" KESSY_KEYLESS_ACCESS
 SG_ RouteInfoChar_07 : 216|8@1+ (1,0) [0|255] "ascii" KESSY_KEYLESS_ACCESS
 SG_ RouteInfoChar_08 : 224|8@1+ (1,0) [0|255] "ascii" KESSY_KEYLESS_ACCESS
 SG_ RouteInfoChar_09 : 232|8@1+ (1,0) [0|255] "ascii" KESSY_KEYLESS_ACCESS
 SG_ RouteInfoChar_10 : 240|8@1+ (1,0) [0|255] "ascii" KESSY_KEYLESS_ACCESS
 SG_ RouteInfoChar_11 : 248|8@1+ (1,0) [0|255] "ascii" KESSY_KEYLESS_ACCESS
 SG_ RouteInfoChar_12 : 256|8@1+ (1,0) [0|255] "ascii" KESSY_KEYLESS_ACCESS
 SG_ RouteInfoChar_13 : 264|8@1+ (1,0) [0|255] "ascii" KESSY_KEYLESS_ACCESS
 SG_ RouteInfoChar_14 : 272|8@1+ (1,0) [0|255] "ascii" KESSY_KEYLESS_ACCESS
 SG_ RouteInfoChar_15 : 280|8@1+ (1,0) [0|255] "ascii" KESSY_KEYLESS_ACCESS
 SG_ RouteInfoChar_16 : 288|8@1+ (1,0) [0|255] "ascii" KESSY_KEYLESS_ACCESS
 SG_ RouteInfoChar_17 : 296|8@1+ (1,0) [0|255] "ascii" KESSY_KEYLESS_ACCESS
 SG_ RouteInfoChar_18 : 304|8@1+ (1,0) [0|255] "ascii" KESSY_KEYLESS_ACCESS
 SG_ RouteInfoChar_19 : 312|8@1+ (1,0) [0|255] "ascii" KESSY_KEYLESS_ACCESS
 SG_ RouteInfoChar_20 : 320|8@1+ (1,0) [0|255] "ascii" KESSY_KEYLESS_ACCESS
 SG_ RouteInfoChar_21 : 328|8@1+ (1,0) [0|255] "ascii" KESSY_KEYLESS_ACCESS
 SG_ RouteInfoChar_22 : 336|8@1+ (1,0) [0|255] "ascii" KESSY_KEYLESS_ACCESS
 SG_ RouteInfoChar_23 : 344|8@1+ (1,0) [0|255] "ascii" KESSY_KEYLESS_ACCESS
 SG_ RouteInfoChar_24 : 352|8@1+ (1,0) [0|255] "ascii" KESSY_KEYLESS_ACCESS
 SG_ RouteInfoChar_25 : 360|8@1+ (1,0) [0|255] "ascii" KESSY_KEYLESS_ACCESS
 SG_ RouteInfoChar_26 : 368|8@1+ (1,0) [0|255] "ascii" KESSY_KEYLESS_ACCESS
 SG_ RouteInfoChar_27 : 376|8@1+ (1,0) [0|255] "ascii" KESSY_KEYLESS_ACCESS
 SG_ RouteInfoChar_28 : 384|8@1+ (1,0) [0|255] "ascii" KESSY_KEYLESS_ACCESS
 SG_ RouteInfoChar_29 : 392|8@1+ (1,0) [0|255] "ascii" KESSY_KEYLESS_ACCESS
 SG_ RouteInfoChar_30 : 400|8@1+ (1,0) [0|255] "ascii" KESSY_KEYLESS_ACCESS
 SG_ RouteInfoChar_31 : 408|8@1+ (1,0) [0|255] "ascii" KESSY_KEYLESS_ACCESS
 SG_ RouteInfoChar_32 : 416|8@1+ (1,0) [0|255] "ascii" KESSY_KEYLESS_ACCESS
 SG_ RouteInfoChar_33 : 424|8@1+ (1,0) [0|255] "ascii" KESSY_KEYLESS_ACCESS
 SG_ RouteInfoChar_34 : 432|8@1+ (1,0) [0|255] "ascii" KESSY_KEYLESS_ACCESS
 SG_ RouteInfoChar_35 : 440|8@1+ (1,0) [0|255] "ascii" KESSY_KEYLESS_ACCESS
 SG_ RouteInfoChar_36 : 448|8@1+ (1,0) [0|255] "ascii" KESSY_KEYLESS_ACCESS
 SG_ RouteInfoChar_37 : 456|8@1+ (1,0) [0|255] "ascii" KESSY_KEYLESS_ACCESS
 SG_ RouteInfoChar_38 : 464|8@1+ (1,0) [0|255] "ascii" KESSY_KEYLESS_ACCESS
 SG_ RouteInfoChar_39 : 472|8@1+ (1,0) [0|255] "ascii" KESSY_KEYLESS_ACCESS
 SG_ RouteInfoChar_40 : 480|8@1+ (1,0) [0|255] "ascii" KESSY_KEYLESS_ACCESS
 SG_ RouteInfoChar_41 : 488|8@1+ (1,0) [0|255] "ascii" KESSY_KEYLESS_ACCESS
 SG_ RouteInfoChar_42 : 496|8@1+ (1,0) [0|255] "ascii" KESSY_KEYLESS_ACCESS
 SG_ RouteInfoChar_43 : 504|8@1+ (1,0) [0|255] "ascii" KESSY_KEYLESS_ACCESS

CM_ BO_ 384 "Cycle=50ms; Channel=CAN0; CAN-FD; NominalBitrate=500kbit/s; DataBitrate=2000kbit/s;  Data request; receiver answers with response frame; PayloadRouteInfo='BODY_CONTROL_MODULE -> KESSY_KEYLESS_ACCESS' in bytes 20-63; Gateway to CAN4";

BO_ 1536 RESP_000_KESSY_KEYLESS_ACCESS_TO_BODY_CONTROL_MODULE: 16 KESSY_KEYLESS_ACCESS
 SG_ CRC8 : 0|8@1+ (1,0) [0|255] "" BODY_CONTROL_MODULE
 SG_ ResponseCounter : 8|4@1+ (1,0) [0|15] "" BODY_CONTROL_MODULE
 SG_ AckState : 12|4@1+ (1,0) [0|15] "" BODY_CONTROL_MODULE
 SG_ ReceivedFrameId : 16|11@1+ (1,0) [0|2047] "" BODY_CONTROL_MODULE
 SG_ ReceivedCounter : 27|4@1+ (1,0) [0|15] "" BODY_CONTROL_MODULE
 SG_ ChecksumOk : 31|1@1+ (1,0) [0|1] "" BODY_CONTROL_MODULE
 SG_ PayloadLength : 32|8@1+ (1,0) [0|64] "byte" BODY_CONTROL_MODULE
 SG_ ErrorCode : 40|8@1+ (1,0) [0|255] "" BODY_CONTROL_MODULE
 SG_ ProcessingTimeUs : 48|16@1+ (1,0) [0|65535] "us" BODY_CONTROL_MODULE
 SG_ ResponseSequence : 64|16@1+ (1,0) [0|65535] "" BODY_CONTROL_MODULE
 SG_ ReceivedCrc : 80|8@1+ (1,0) [0|255] "" BODY_CONTROL_MODULE
 SG_ CalculatedCrc : 88|8@1+ (1,0) [0|255] "" BODY_CONTROL_MODULE

CM_ BO_ 1536 "Cycle=50ms; Channel=CAN0; CAN-FD; NominalBitrate=500kbit/s; DataBitrate=2000kbit/s;  ResponseFor=0x180; ACK/NACK with CRC, DLC and counter check;";

BO_ 385 DATA_001_BODY_CONTROL_MODULE_BODY_STATE_TO_TAILGATE_MODULE: 64 BODY_CONTROL_MODULE
 SG_ CRC8 : 0|8@1+ (1,0) [0|255] "" TAILGATE_MODULE
 SG_ AliveCounter : 8|4@1+ (1,0) [0|15] "" TAILGATE_MODULE
 SG_ MuxState : 12|4@1+ (1,0) [0|15] "" TAILGATE_MODULE
 SG_ SIG_181_00 : 16|12@1+ (0.1,0.0) [0|4095] "km/h" TAILGATE_MODULE
 SG_ SIG_181_01 : 28|12@1+ (0.1,0.0) [0|4095] "rpm" TAILGATE_MODULE
 SG_ SIG_181_02 : 40|12@1+ (0.1,0.0) [0|4095] "Nm" TAILGATE_MODULE
 SG_ SIG_181_03 : 52|12@1+ (0.1,0.0) [0|4095] "Nm" TAILGATE_MODULE
 SG_ SIG_181_04 : 64|12@1+ (0.1,0.0) [0|4095] "m" TAILGATE_MODULE
 SG_ SIG_181_05 : 76|12@1+ (0.1,0.0) [0|4095] "obj" TAILGATE_MODULE
 SG_ SIG_181_06 : 88|12@1+ (0.1,0.0) [0|4095] "km/h" TAILGATE_MODULE
 SG_ SIG_181_07 : 100|12@1+ (0.1,0.0) [0|4095] "m" TAILGATE_MODULE
 SG_ SIG_181_08 : 112|12@1+ (0.1,0.0) [0|4095] "Nm" TAILGATE_MODULE
 SG_ SIG_181_09 : 124|12@1+ (0.1,0.0) [0|4095] "m" TAILGATE_MODULE
 SG_ SIG_181_10 : 136|12@1+ (0.1,0.0) [0|4095] "%" TAILGATE_MODULE
 SG_ SIG_181_11 : 148|12@1+ (0.1,0.0) [0|4095] "Nm" TAILGATE_MODULE
 SG_ RouteInfoChar_00 : 160|8@1+ (1,0) [0|255] "ascii" TAILGATE_MODULE
 SG_ RouteInfoChar_01 : 168|8@1+ (1,0) [0|255] "ascii" TAILGATE_MODULE
 SG_ RouteInfoChar_02 : 176|8@1+ (1,0) [0|255] "ascii" TAILGATE_MODULE
 SG_ RouteInfoChar_03 : 184|8@1+ (1,0) [0|255] "ascii" TAILGATE_MODULE
 SG_ RouteInfoChar_04 : 192|8@1+ (1,0) [0|255] "ascii" TAILGATE_MODULE
 SG_ RouteInfoChar_05 : 200|8@1+ (1,0) [0|255] "ascii" TAILGATE_MODULE
 SG_ RouteInfoChar_06 : 208|8@1+ (1,0) [0|255] "ascii" TAILGATE_MODULE
 SG_ RouteInfoChar_07 : 216|8@1+ (1,0) [0|255] "ascii" TAILGATE_MODULE
 SG_ RouteInfoChar_08 : 224|8@1+ (1,0) [0|255] "ascii" TAILGATE_MODULE
 SG_ RouteInfoChar_09 : 232|8@1+ (1,0) [0|255] "ascii" TAILGATE_MODULE
 SG_ RouteInfoChar_10 : 240|8@1+ (1,0) [0|255] "ascii" TAILGATE_MODULE
 SG_ RouteInfoChar_11 : 248|8@1+ (1,0) [0|255] "ascii" TAILGATE_MODULE
 SG_ RouteInfoChar_12 : 256|8@1+ (1,0) [0|255] "ascii" TAILGATE_MODULE
 SG_ RouteInfoChar_13 : 264|8@1+ (1,0) [0|255] "ascii" TAILGATE_MODULE
 SG_ RouteInfoChar_14 : 272|8@1+ (1,0) [0|255] "ascii" TAILGATE_MODULE
 SG_ RouteInfoChar_15 : 280|8@1+ (1,0) [0|255] "ascii" TAILGATE_MODULE
 SG_ RouteInfoChar_16 : 288|8@1+ (1,0) [0|255] "ascii" TAILGATE_MODULE
 SG_ RouteInfoChar_17 : 296|8@1+ (1,0) [0|255] "ascii" TAILGATE_MODULE
 SG_ RouteInfoChar_18 : 304|8@1+ (1,0) [0|255] "ascii" TAILGATE_MODULE
 SG_ RouteInfoChar_19 : 312|8@1+ (1,0) [0|255] "ascii" TAILGATE_MODULE
 SG_ RouteInfoChar_20 : 320|8@1+ (1,0) [0|255] "ascii" TAILGATE_MODULE
 SG_ RouteInfoChar_21 : 328|8@1+ (1,0) [0|255] "ascii" TAILGATE_MODULE
 SG_ RouteInfoChar_22 : 336|8@1+ (1,0) [0|255] "ascii" TAILGATE_MODULE
 SG_ RouteInfoChar_23 : 344|8@1+ (1,0) [0|255] "ascii" TAILGATE_MODULE
 SG_ RouteInfoChar_24 : 352|8@1+ (1,0) [0|255] "ascii" TAILGATE_MODULE
 SG_ RouteInfoChar_25 : 360|8@1+ (1,0) [0|255] "ascii" TAILGATE_MODULE
 SG_ RouteInfoChar_26 : 368|8@1+ (1,0) [0|255] "ascii" TAILGATE_MODULE
 SG_ RouteInfoChar_27 : 376|8@1+ (1,0) [0|255] "ascii" TAILGATE_MODULE
 SG_ RouteInfoChar_28 : 384|8@1+ (1,0) [0|255] "ascii" TAILGATE_MODULE
 SG_ RouteInfoChar_29 : 392|8@1+ (1,0) [0|255] "ascii" TAILGATE_MODULE
 SG_ RouteInfoChar_30 : 400|8@1+ (1,0) [0|255] "ascii" TAILGATE_MODULE
 SG_ RouteInfoChar_31 : 408|8@1+ (1,0) [0|255] "ascii" TAILGATE_MODULE
 SG_ RouteInfoChar_32 : 416|8@1+ (1,0) [0|255] "ascii" TAILGATE_MODULE
 SG_ RouteInfoChar_33 : 424|8@1+ (1,0) [0|255] "ascii" TAILGATE_MODULE
 SG_ RouteInfoChar_34 : 432|8@1+ (1,0) [0|255] "ascii" TAILGATE_MODULE
 SG_ RouteInfoChar_35 : 440|8@1+ (1,0) [0|255] "ascii" TAILGATE_MODULE
 SG_ RouteInfoChar_36 : 448|8@1+ (1,0) [0|255] "ascii" TAILGATE_MODULE
 SG_ RouteInfoChar_37 : 456|8@1+ (1,0) [0|255] "ascii" TAILGATE_MODULE
 SG_ RouteInfoChar_38 : 464|8@1+ (1,0) [0|255] "ascii" TAILGATE_MODULE
 SG_ RouteInfoChar_39 : 472|8@1+ (1,0) [0|255] "ascii" TAILGATE_MODULE
 SG_ RouteInfoChar_40 : 480|8@1+ (1,0) [0|255] "ascii" TAILGATE_MODULE
 SG_ RouteInfoChar_41 : 488|8@1+ (1,0) [0|255] "ascii" TAILGATE_MODULE
 SG_ RouteInfoChar_42 : 496|8@1+ (1,0) [0|255] "ascii" TAILGATE_MODULE
 SG_ RouteInfoChar_43 : 504|8@1+ (1,0) [0|255] "ascii" TAILGATE_MODULE

CM_ BO_ 385 "Cycle=50ms; Channel=CAN0; CAN-FD; NominalBitrate=500kbit/s; DataBitrate=2000kbit/s;  Data request; receiver answers with response frame; PayloadRouteInfo='BODY_CONTROL_MODULE -> TAILGATE_MODULE' in bytes 20-63; Gateway to CAN4";

BO_ 1537 RESP_001_TAILGATE_MODULE_TO_BODY_CONTROL_MODULE: 16 TAILGATE_MODULE
 SG_ CRC8 : 0|8@1+ (1,0) [0|255] "" BODY_CONTROL_MODULE
 SG_ ResponseCounter : 8|4@1+ (1,0) [0|15] "" BODY_CONTROL_MODULE
 SG_ AckState : 12|4@1+ (1,0) [0|15] "" BODY_CONTROL_MODULE
 SG_ ReceivedFrameId : 16|11@1+ (1,0) [0|2047] "" BODY_CONTROL_MODULE
 SG_ ReceivedCounter : 27|4@1+ (1,0) [0|15] "" BODY_CONTROL_MODULE
 SG_ ChecksumOk : 31|1@1+ (1,0) [0|1] "" BODY_CONTROL_MODULE
 SG_ PayloadLength : 32|8@1+ (1,0) [0|64] "byte" BODY_CONTROL_MODULE
 SG_ ErrorCode : 40|8@1+ (1,0) [0|255] "" BODY_CONTROL_MODULE
 SG_ ProcessingTimeUs : 48|16@1+ (1,0) [0|65535] "us" BODY_CONTROL_MODULE
 SG_ ResponseSequence : 64|16@1+ (1,0) [0|65535] "" BODY_CONTROL_MODULE
 SG_ ReceivedCrc : 80|8@1+ (1,0) [0|255] "" BODY_CONTROL_MODULE
 SG_ CalculatedCrc : 88|8@1+ (1,0) [0|255] "" BODY_CONTROL_MODULE

CM_ BO_ 1537 "Cycle=50ms; Channel=CAN0; CAN-FD; NominalBitrate=500kbit/s; DataBitrate=2000kbit/s;  ResponseFor=0x181; ACK/NACK with CRC, DLC and counter check;";

BO_ 386 DATA_002_BODY_CONTROL_MODULE_BODY_STATE_TO_HVAC_CONTROLLER: 64 BODY_CONTROL_MODULE
 SG_ CRC8 : 0|8@1+ (1,0) [0|255] "" HVAC_CONTROLLER
 SG_ AliveCounter : 8|4@1+ (1,0) [0|15] "" HVAC_CONTROLLER
 SG_ MuxState : 12|4@1+ (1,0) [0|15] "" HVAC_CONTROLLER
 SG_ SIG_182_00 : 16|12@1+ (0.1,0.0) [0|4095] "C" HVAC_CONTROLLER
 SG_ SIG_182_01 : 28|12@1+ (0.1,0.0) [0|4095] "obj" HVAC_CONTROLLER
 SG_ SIG_182_02 : 40|12@1+ (0.1,0.0) [0|4095] "V" HVAC_CONTROLLER
 SG_ SIG_182_03 : 52|12@1+ (0.1,0.0) [0|4095] "km/h" HVAC_CONTROLLER
 SG_ SIG_182_04 : 64|12@1+ (0.1,0.0) [0|4095] "deg" HVAC_CONTROLLER
 SG_ SIG_182_05 : 76|12@1+ (0.1,0.0) [0|4095] "%" HVAC_CONTROLLER
 SG_ SIG_182_06 : 88|12@1+ (0.1,0.0) [0|4095] "A" HVAC_CONTROLLER
 SG_ SIG_182_07 : 100|12@1+ (0.1,0.0) [0|4095] "V" HVAC_CONTROLLER
 SG_ SIG_182_08 : 112|12@1+ (0.1,0.0) [0|4095] "deg" HVAC_CONTROLLER
 SG_ SIG_182_09 : 124|12@1+ (0.1,0.0) [0|4095] "Nm" HVAC_CONTROLLER
 SG_ SIG_182_10 : 136|12@1+ (0.1,0.0) [0|4095] "A" HVAC_CONTROLLER
 SG_ SIG_182_11 : 148|12@1+ (0.1,0.0) [0|4095] "rpm" HVAC_CONTROLLER
 SG_ RouteInfoChar_00 : 160|8@1+ (1,0) [0|255] "ascii" HVAC_CONTROLLER
 SG_ RouteInfoChar_01 : 168|8@1+ (1,0) [0|255] "ascii" HVAC_CONTROLLER
 SG_ RouteInfoChar_02 : 176|8@1+ (1,0) [0|255] "ascii" HVAC_CONTROLLER
 SG_ RouteInfoChar_03 : 184|8@1+ (1,0) [0|255] "ascii" HVAC_CONTROLLER
 SG_ RouteInfoChar_04 : 192|8@1+ (1,0) [0|255] "ascii" HVAC_CONTROLLER
 SG_ RouteInfoChar_05 : 200|8@1+ (1,0) [0|255] "ascii" HVAC_CONTROLLER
 SG_ RouteInfoChar_06 : 208|8@1+ (1,0) [0|255] "ascii" HVAC_CONTROLLER
 SG_ RouteInfoChar_07 : 216|8@1+ (1,0) [0|255] "ascii" HVAC_CONTROLLER
 SG_ RouteInfoChar_08 : 224|8@1+ (1,0) [0|255] "ascii" HVAC_CONTROLLER
 SG_ RouteInfoChar_09 : 232|8@1+ (1,0) [0|255] "ascii" HVAC_CONTROLLER
 SG_ RouteInfoChar_10 : 240|8@1+ (1,0) [0|255] "ascii" HVAC_CONTROLLER
 SG_ RouteInfoChar_11 : 248|8@1+ (1,0) [0|255] "ascii" HVAC_CONTROLLER
 SG_ RouteInfoChar_12 : 256|8@1+ (1,0) [0|255] "ascii" HVAC_CONTROLLER
 SG_ RouteInfoChar_13 : 264|8@1+ (1,0) [0|255] "ascii" HVAC_CONTROLLER
 SG_ RouteInfoChar_14 : 272|8@1+ (1,0) [0|255] "ascii" HVAC_CONTROLLER
 SG_ RouteInfoChar_15 : 280|8@1+ (1,0) [0|255] "ascii" HVAC_CONTROLLER
 SG_ RouteInfoChar_16 : 288|8@1+ (1,0) [0|255] "ascii" HVAC_CONTROLLER
 SG_ RouteInfoChar_17 : 296|8@1+ (1,0) [0|255] "ascii" HVAC_CONTROLLER
 SG_ RouteInfoChar_18 : 304|8@1+ (1,0) [0|255] "ascii" HVAC_CONTROLLER
 SG_ RouteInfoChar_19 : 312|8@1+ (1,0) [0|255] "ascii" HVAC_CONTROLLER
 SG_ RouteInfoChar_20 : 320|8@1+ (1,0) [0|255] "ascii" HVAC_CONTROLLER
 SG_ RouteInfoChar_21 : 328|8@1+ (1,0) [0|255] "ascii" HVAC_CONTROLLER
 SG_ RouteInfoChar_22 : 336|8@1+ (1,0) [0|255] "ascii" HVAC_CONTROLLER
 SG_ RouteInfoChar_23 : 344|8@1+ (1,0) [0|255] "ascii" HVAC_CONTROLLER
 SG_ RouteInfoChar_24 : 352|8@1+ (1,0) [0|255] "ascii" HVAC_CONTROLLER
 SG_ RouteInfoChar_25 : 360|8@1+ (1,0) [0|255] "ascii" HVAC_CONTROLLER
 SG_ RouteInfoChar_26 : 368|8@1+ (1,0) [0|255] "ascii" HVAC_CONTROLLER
 SG_ RouteInfoChar_27 : 376|8@1+ (1,0) [0|255] "ascii" HVAC_CONTROLLER
 SG_ RouteInfoChar_28 : 384|8@1+ (1,0) [0|255] "ascii" HVAC_CONTROLLER
 SG_ RouteInfoChar_29 : 392|8@1+ (1,0) [0|255] "ascii" HVAC_CONTROLLER
 SG_ RouteInfoChar_30 : 400|8@1+ (1,0) [0|255] "ascii" HVAC_CONTROLLER
 SG_ RouteInfoChar_31 : 408|8@1+ (1,0) [0|255] "ascii" HVAC_CONTROLLER
 SG_ RouteInfoChar_32 : 416|8@1+ (1,0) [0|255] "ascii" HVAC_CONTROLLER
 SG_ RouteInfoChar_33 : 424|8@1+ (1,0) [0|255] "ascii" HVAC_CONTROLLER
 SG_ RouteInfoChar_34 : 432|8@1+ (1,0) [0|255] "ascii" HVAC_CONTROLLER
 SG_ RouteInfoChar_35 : 440|8@1+ (1,0) [0|255] "ascii" HVAC_CONTROLLER
 SG_ RouteInfoChar_36 : 448|8@1+ (1,0) [0|255] "ascii" HVAC_CONTROLLER
 SG_ RouteInfoChar_37 : 456|8@1+ (1,0) [0|255] "ascii" HVAC_CONTROLLER
 SG_ RouteInfoChar_38 : 464|8@1+ (1,0) [0|255] "ascii" HVAC_CONTROLLER
 SG_ RouteInfoChar_39 : 472|8@1+ (1,0) [0|255] "ascii" HVAC_CONTROLLER
 SG_ RouteInfoChar_40 : 480|8@1+ (1,0) [0|255] "ascii" HVAC_CONTROLLER
 SG_ RouteInfoChar_41 : 488|8@1+ (1,0) [0|255] "ascii" HVAC_CONTROLLER
 SG_ RouteInfoChar_42 : 496|8@1+ (1,0) [0|255] "ascii" HVAC_CONTROLLER
 SG_ RouteInfoChar_43 : 504|8@1+ (1,0) [0|255] "ascii" HVAC_CONTROLLER

CM_ BO_ 386 "Cycle=50ms; Channel=CAN0; CAN-FD; NominalBitrate=500kbit/s; DataBitrate=2000kbit/s;  Data request; receiver answers with response frame; PayloadRouteInfo='BODY_CONTROL_MODULE -> HVAC_CONTROLLER' in bytes 20-63; Gateway to CAN4";

BO_ 1538 RESP_002_HVAC_CONTROLLER_TO_BODY_CONTROL_MODULE: 16 HVAC_CONTROLLER
 SG_ CRC8 : 0|8@1+ (1,0) [0|255] "" BODY_CONTROL_MODULE
 SG_ ResponseCounter : 8|4@1+ (1,0) [0|15] "" BODY_CONTROL_MODULE
 SG_ AckState : 12|4@1+ (1,0) [0|15] "" BODY_CONTROL_MODULE
 SG_ ReceivedFrameId : 16|11@1+ (1,0) [0|2047] "" BODY_CONTROL_MODULE
 SG_ ReceivedCounter : 27|4@1+ (1,0) [0|15] "" BODY_CONTROL_MODULE
 SG_ ChecksumOk : 31|1@1+ (1,0) [0|1] "" BODY_CONTROL_MODULE
 SG_ PayloadLength : 32|8@1+ (1,0) [0|64] "byte" BODY_CONTROL_MODULE
 SG_ ErrorCode : 40|8@1+ (1,0) [0|255] "" BODY_CONTROL_MODULE
 SG_ ProcessingTimeUs : 48|16@1+ (1,0) [0|65535] "us" BODY_CONTROL_MODULE
 SG_ ResponseSequence : 64|16@1+ (1,0) [0|65535] "" BODY_CONTROL_MODULE
 SG_ ReceivedCrc : 80|8@1+ (1,0) [0|255] "" BODY_CONTROL_MODULE
 SG_ CalculatedCrc : 88|8@1+ (1,0) [0|255] "" BODY_CONTROL_MODULE

CM_ BO_ 1538 "Cycle=50ms; Channel=CAN0; CAN-FD; NominalBitrate=500kbit/s; DataBitrate=2000kbit/s;  ResponseFor=0x182; ACK/NACK with CRC, DLC and counter check;";

BO_ 387 DATA_003_BODY_CONTROL_MODULE_BODY_STATE_TO_SUNROOF_CONTROLLER: 64 BODY_CONTROL_MODULE
 SG_ CRC8 : 0|8@1+ (1,0) [0|255] "" SUNROOF_CONTROLLER
 SG_ AliveCounter : 8|4@1+ (1,0) [0|15] "" SUNROOF_CONTROLLER
 SG_ MuxState : 12|4@1+ (1,0) [0|15] "" SUNROOF_CONTROLLER
 SG_ SIG_183_00 : 16|12@1+ (0.1,0.0) [0|4095] "rpm" SUNROOF_CONTROLLER
 SG_ SIG_183_01 : 28|12@1+ (0.1,0.0) [0|4095] "%" SUNROOF_CONTROLLER
 SG_ SIG_183_02 : 40|12@1+ (0.1,0.0) [0|4095] "rpm" SUNROOF_CONTROLLER
 SG_ SIG_183_03 : 52|12@1+ (0.1,0.0) [0|4095] "A" SUNROOF_CONTROLLER
 SG_ SIG_183_04 : 64|12@1+ (0.1,0.0) [0|4095] "A" SUNROOF_CONTROLLER
 SG_ SIG_183_05 : 76|12@1+ (0.1,0.0) [0|4095] "obj" SUNROOF_CONTROLLER
 SG_ SIG_183_06 : 88|12@1+ (0.1,0.0) [0|4095] "V" SUNROOF_CONTROLLER
 SG_ SIG_183_07 : 100|12@1+ (0.1,0.0) [0|4095] "km/h" SUNROOF_CONTROLLER
 SG_ SIG_183_08 : 112|12@1+ (0.1,0.0) [0|4095] "C" SUNROOF_CONTROLLER
 SG_ SIG_183_09 : 124|12@1+ (0.1,0.0) [0|4095] "m" SUNROOF_CONTROLLER
 SG_ SIG_183_10 : 136|12@1+ (0.1,0.0) [0|4095] "rpm" SUNROOF_CONTROLLER
 SG_ SIG_183_11 : 148|12@1+ (0.1,0.0) [0|4095] "%" SUNROOF_CONTROLLER
 SG_ RouteInfoChar_00 : 160|8@1+ (1,0) [0|255] "ascii" SUNROOF_CONTROLLER
 SG_ RouteInfoChar_01 : 168|8@1+ (1,0) [0|255] "ascii" SUNROOF_CONTROLLER
 SG_ RouteInfoChar_02 : 176|8@1+ (1,0) [0|255] "ascii" SUNROOF_CONTROLLER
 SG_ RouteInfoChar_03 : 184|8@1+ (1,0) [0|255] "ascii" SUNROOF_CONTROLLER
 SG_ RouteInfoChar_04 : 192|8@1+ (1,0) [0|255] "ascii" SUNROOF_CONTROLLER
 SG_ RouteInfoChar_05 : 200|8@1+ (1,0) [0|255] "ascii" SUNROOF_CONTROLLER
 SG_ RouteInfoChar_06 : 208|8@1+ (1,0) [0|255] "ascii" SUNROOF_CONTROLLER
 SG_ RouteInfoChar_07 : 216|8@1+ (1,0) [0|255] "ascii" SUNROOF_CONTROLLER
 SG_ RouteInfoChar_08 : 224|8@1+ (1,0) [0|255] "ascii" SUNROOF_CONTROLLER
 SG_ RouteInfoChar_09 : 232|8@1+ (1,0) [0|255] "ascii" SUNROOF_CONTROLLER
 SG_ RouteInfoChar_10 : 240|8@1+ (1,0) [0|255] "ascii" SUNROOF_CONTROLLER
 SG_ RouteInfoChar_11 : 248|8@1+ (1,0) [0|255] "ascii" SUNROOF_CONTROLLER
 SG_ RouteInfoChar_12 : 256|8@1+ (1,0) [0|255] "ascii" SUNROOF_CONTROLLER
 SG_ RouteInfoChar_13 : 264|8@1+ (1,0) [0|255] "ascii" SUNROOF_CONTROLLER
 SG_ RouteInfoChar_14 : 272|8@1+ (1,0) [0|255] "ascii" SUNROOF_CONTROLLER
 SG_ RouteInfoChar_15 : 280|8@1+ (1,0) [0|255] "ascii" SUNROOF_CONTROLLER
 SG_ RouteInfoChar_16 : 288|8@1+ (1,0) [0|255] "ascii" SUNROOF_CONTROLLER
 SG_ RouteInfoChar_17 : 296|8@1+ (1,0) [0|255] "ascii" SUNROOF_CONTROLLER
 SG_ RouteInfoChar_18 : 304|8@1+ (1,0) [0|255] "ascii" SUNROOF_CONTROLLER
 SG_ RouteInfoChar_19 : 312|8@1+ (1,0) [0|255] "ascii" SUNROOF_CONTROLLER
 SG_ RouteInfoChar_20 : 320|8@1+ (1,0) [0|255] "ascii" SUNROOF_CONTROLLER
 SG_ RouteInfoChar_21 : 328|8@1+ (1,0) [0|255] "ascii" SUNROOF_CONTROLLER
 SG_ RouteInfoChar_22 : 336|8@1+ (1,0) [0|255] "ascii" SUNROOF_CONTROLLER
 SG_ RouteInfoChar_23 : 344|8@1+ (1,0) [0|255] "ascii" SUNROOF_CONTROLLER
 SG_ RouteInfoChar_24 : 352|8@1+ (1,0) [0|255] "ascii" SUNROOF_CONTROLLER
 SG_ RouteInfoChar_25 : 360|8@1+ (1,0) [0|255] "ascii" SUNROOF_CONTROLLER
 SG_ RouteInfoChar_26 : 368|8@1+ (1,0) [0|255] "ascii" SUNROOF_CONTROLLER
 SG_ RouteInfoChar_27 : 376|8@1+ (1,0) [0|255] "ascii" SUNROOF_CONTROLLER
 SG_ RouteInfoChar_28 : 384|8@1+ (1,0) [0|255] "ascii" SUNROOF_CONTROLLER
 SG_ RouteInfoChar_29 : 392|8@1+ (1,0) [0|255] "ascii" SUNROOF_CONTROLLER
 SG_ RouteInfoChar_30 : 400|8@1+ (1,0) [0|255] "ascii" SUNROOF_CONTROLLER
 SG_ RouteInfoChar_31 : 408|8@1+ (1,0) [0|255] "ascii" SUNROOF_CONTROLLER
 SG_ RouteInfoChar_32 : 416|8@1+ (1,0) [0|255] "ascii" SUNROOF_CONTROLLER
 SG_ RouteInfoChar_33 : 424|8@1+ (1,0) [0|255] "ascii" SUNROOF_CONTROLLER
 SG_ RouteInfoChar_34 : 432|8@1+ (1,0) [0|255] "ascii" SUNROOF_CONTROLLER
 SG_ RouteInfoChar_35 : 440|8@1+ (1,0) [0|255] "ascii" SUNROOF_CONTROLLER
 SG_ RouteInfoChar_36 : 448|8@1+ (1,0) [0|255] "ascii" SUNROOF_CONTROLLER
 SG_ RouteInfoChar_37 : 456|8@1+ (1,0) [0|255] "ascii" SUNROOF_CONTROLLER
 SG_ RouteInfoChar_38 : 464|8@1+ (1,0) [0|255] "ascii" SUNROOF_CONTROLLER
 SG_ RouteInfoChar_39 : 472|8@1+ (1,0) [0|255] "ascii" SUNROOF_CONTROLLER
 SG_ RouteInfoChar_40 : 480|8@1+ (1,0) [0|255] "ascii" SUNROOF_CONTROLLER
 SG_ RouteInfoChar_41 : 488|8@1+ (1,0) [0|255] "ascii" SUNROOF_CONTROLLER
 SG_ RouteInfoChar_42 : 496|8@1+ (1,0) [0|255] "ascii" SUNROOF_CONTROLLER
 SG_ RouteInfoChar_43 : 504|8@1+ (1,0) [0|255] "ascii" SUNROOF_CONTROLLER

CM_ BO_ 387 "Cycle=50ms; Channel=CAN0; CAN-FD; NominalBitrate=500kbit/s; DataBitrate=2000kbit/s;  Data request; receiver answers with response frame; PayloadRouteInfo='BODY_CONTROL_MODULE -> SUNROOF_CONTROLLER' in bytes 20-63; Gateway to CAN4";

BO_ 1539 RESP_003_SUNROOF_CONTROLLER_TO_BODY_CONTROL_MODULE: 16 SUNROOF_CONTROLLER
 SG_ CRC8 : 0|8@1+ (1,0) [0|255] "" BODY_CONTROL_MODULE
 SG_ ResponseCounter : 8|4@1+ (1,0) [0|15] "" BODY_CONTROL_MODULE
 SG_ AckState : 12|4@1+ (1,0) [0|15] "" BODY_CONTROL_MODULE
 SG_ ReceivedFrameId : 16|11@1+ (1,0) [0|2047] "" BODY_CONTROL_MODULE
 SG_ ReceivedCounter : 27|4@1+ (1,0) [0|15] "" BODY_CONTROL_MODULE
 SG_ ChecksumOk : 31|1@1+ (1,0) [0|1] "" BODY_CONTROL_MODULE
 SG_ PayloadLength : 32|8@1+ (1,0) [0|64] "byte" BODY_CONTROL_MODULE
 SG_ ErrorCode : 40|8@1+ (1,0) [0|255] "" BODY_CONTROL_MODULE
 SG_ ProcessingTimeUs : 48|16@1+ (1,0) [0|65535] "us" BODY_CONTROL_MODULE
 SG_ ResponseSequence : 64|16@1+ (1,0) [0|65535] "" BODY_CONTROL_MODULE
 SG_ ReceivedCrc : 80|8@1+ (1,0) [0|255] "" BODY_CONTROL_MODULE
 SG_ CalculatedCrc : 88|8@1+ (1,0) [0|255] "" BODY_CONTROL_MODULE

CM_ BO_ 1539 "Cycle=50ms; Channel=CAN0; CAN-FD; NominalBitrate=500kbit/s; DataBitrate=2000kbit/s;  ResponseFor=0x183; ACK/NACK with CRC, DLC and counter check;";

BO_ 388 DATA_004_BODY_CONTROL_MODULE_BODY_STATE_TO_SEAT_CONTROLLER_DRIVER: 64 BODY_CONTROL_MODULE
 SG_ CRC8 : 0|8@1+ (1,0) [0|255] "" SEAT_CONTROLLER_DRIVER
 SG_ AliveCounter : 8|4@1+ (1,0) [0|15] "" SEAT_CONTROLLER_DRIVER
 SG_ MuxState : 12|4@1+ (1,0) [0|15] "" SEAT_CONTROLLER_DRIVER
 SG_ SIG_184_00 : 16|12@1+ (0.1,0.0) [0|4095] "rpm" SEAT_CONTROLLER_DRIVER
 SG_ SIG_184_01 : 28|12@1+ (0.1,0.0) [0|4095] "m" SEAT_CONTROLLER_DRIVER
 SG_ SIG_184_02 : 40|12@1+ (0.1,0.0) [0|4095] "V" SEAT_CONTROLLER_DRIVER
 SG_ SIG_184_03 : 52|12@1+ (0.1,0.0) [0|4095] "obj" SEAT_CONTROLLER_DRIVER
 SG_ SIG_184_04 : 64|12@1+ (0.1,0.0) [0|4095] "A" SEAT_CONTROLLER_DRIVER
 SG_ SIG_184_05 : 76|12@1+ (0.1,0.0) [0|4095] "obj" SEAT_CONTROLLER_DRIVER
 SG_ SIG_184_06 : 88|12@1+ (0.1,0.0) [0|4095] "Nm" SEAT_CONTROLLER_DRIVER
 SG_ SIG_184_07 : 100|12@1+ (0.1,0.0) [0|4095] "rpm" SEAT_CONTROLLER_DRIVER
 SG_ SIG_184_08 : 112|12@1+ (0.1,0.0) [0|4095] "km/h" SEAT_CONTROLLER_DRIVER
 SG_ SIG_184_09 : 124|12@1+ (0.1,0.0) [0|4095] "Nm" SEAT_CONTROLLER_DRIVER
 SG_ SIG_184_10 : 136|12@1+ (0.1,0.0) [0|4095] "V" SEAT_CONTROLLER_DRIVER
 SG_ SIG_184_11 : 148|12@1+ (0.1,0.0) [0|4095] "rpm" SEAT_CONTROLLER_DRIVER
 SG_ RouteInfoChar_00 : 160|8@1+ (1,0) [0|255] "ascii" SEAT_CONTROLLER_DRIVER
 SG_ RouteInfoChar_01 : 168|8@1+ (1,0) [0|255] "ascii" SEAT_CONTROLLER_DRIVER
 SG_ RouteInfoChar_02 : 176|8@1+ (1,0) [0|255] "ascii" SEAT_CONTROLLER_DRIVER
 SG_ RouteInfoChar_03 : 184|8@1+ (1,0) [0|255] "ascii" SEAT_CONTROLLER_DRIVER
 SG_ RouteInfoChar_04 : 192|8@1+ (1,0) [0|255] "ascii" SEAT_CONTROLLER_DRIVER
 SG_ RouteInfoChar_05 : 200|8@1+ (1,0) [0|255] "ascii" SEAT_CONTROLLER_DRIVER
 SG_ RouteInfoChar_06 : 208|8@1+ (1,0) [0|255] "ascii" SEAT_CONTROLLER_DRIVER
 SG_ RouteInfoChar_07 : 216|8@1+ (1,0) [0|255] "ascii" SEAT_CONTROLLER_DRIVER
 SG_ RouteInfoChar_08 : 224|8@1+ (1,0) [0|255] "ascii" SEAT_CONTROLLER_DRIVER
 SG_ RouteInfoChar_09 : 232|8@1+ (1,0) [0|255] "ascii" SEAT_CONTROLLER_DRIVER
 SG_ RouteInfoChar_10 : 240|8@1+ (1,0) [0|255] "ascii" SEAT_CONTROLLER_DRIVER
 SG_ RouteInfoChar_11 : 248|8@1+ (1,0) [0|255] "ascii" SEAT_CONTROLLER_DRIVER
 SG_ RouteInfoChar_12 : 256|8@1+ (1,0) [0|255] "ascii" SEAT_CONTROLLER_DRIVER
 SG_ RouteInfoChar_13 : 264|8@1+ (1,0) [0|255] "ascii" SEAT_CONTROLLER_DRIVER
 SG_ RouteInfoChar_14 : 272|8@1+ (1,0) [0|255] "ascii" SEAT_CONTROLLER_DRIVER
 SG_ RouteInfoChar_15 : 280|8@1+ (1,0) [0|255] "ascii" SEAT_CONTROLLER_DRIVER
 SG_ RouteInfoChar_16 : 288|8@1+ (1,0) [0|255] "ascii" SEAT_CONTROLLER_DRIVER
 SG_ RouteInfoChar_17 : 296|8@1+ (1,0) [0|255] "ascii" SEAT_CONTROLLER_DRIVER
 SG_ RouteInfoChar_18 : 304|8@1+ (1,0) [0|255] "ascii" SEAT_CONTROLLER_DRIVER
 SG_ RouteInfoChar_19 : 312|8@1+ (1,0) [0|255] "ascii" SEAT_CONTROLLER_DRIVER
 SG_ RouteInfoChar_20 : 320|8@1+ (1,0) [0|255] "ascii" SEAT_CONTROLLER_DRIVER
 SG_ RouteInfoChar_21 : 328|8@1+ (1,0) [0|255] "ascii" SEAT_CONTROLLER_DRIVER
 SG_ RouteInfoChar_22 : 336|8@1+ (1,0) [0|255] "ascii" SEAT_CONTROLLER_DRIVER
 SG_ RouteInfoChar_23 : 344|8@1+ (1,0) [0|255] "ascii" SEAT_CONTROLLER_DRIVER
 SG_ RouteInfoChar_24 : 352|8@1+ (1,0) [0|255] "ascii" SEAT_CONTROLLER_DRIVER
 SG_ RouteInfoChar_25 : 360|8@1+ (1,0) [0|255] "ascii" SEAT_CONTROLLER_DRIVER
 SG_ RouteInfoChar_26 : 368|8@1+ (1,0) [0|255] "ascii" SEAT_CONTROLLER_DRIVER
 SG_ RouteInfoChar_27 : 376|8@1+ (1,0) [0|255] "ascii" SEAT_CONTROLLER_DRIVER
 SG_ RouteInfoChar_28 : 384|8@1+ (1,0) [0|255] "ascii" SEAT_CONTROLLER_DRIVER
 SG_ RouteInfoChar_29 : 392|8@1+ (1,0) [0|255] "ascii" SEAT_CONTROLLER_DRIVER
 SG_ RouteInfoChar_30 : 400|8@1+ (1,0) [0|255] "ascii" SEAT_CONTROLLER_DRIVER
 SG_ RouteInfoChar_31 : 408|8@1+ (1,0) [0|255] "ascii" SEAT_CONTROLLER_DRIVER
 SG_ RouteInfoChar_32 : 416|8@1+ (1,0) [0|255] "ascii" SEAT_CONTROLLER_DRIVER
 SG_ RouteInfoChar_33 : 424|8@1+ (1,0) [0|255] "ascii" SEAT_CONTROLLER_DRIVER
 SG_ RouteInfoChar_34 : 432|8@1+ (1,0) [0|255] "ascii" SEAT_CONTROLLER_DRIVER
 SG_ RouteInfoChar_35 : 440|8@1+ (1,0) [0|255] "ascii" SEAT_CONTROLLER_DRIVER
 SG_ RouteInfoChar_36 : 448|8@1+ (1,0) [0|255] "ascii" SEAT_CONTROLLER_DRIVER
 SG_ RouteInfoChar_37 : 456|8@1+ (1,0) [0|255] "ascii" SEAT_CONTROLLER_DRIVER
 SG_ RouteInfoChar_38 : 464|8@1+ (1,0) [0|255] "ascii" SEAT_CONTROLLER_DRIVER
 SG_ RouteInfoChar_39 : 472|8@1+ (1,0) [0|255] "ascii" SEAT_CONTROLLER_DRIVER
 SG_ RouteInfoChar_40 : 480|8@1+ (1,0) [0|255] "ascii" SEAT_CONTROLLER_DRIVER
 SG_ RouteInfoChar_41 : 488|8@1+ (1,0) [0|255] "ascii" SEAT_CONTROLLER_DRIVER
 SG_ RouteInfoChar_42 : 496|8@1+ (1,0) [0|255] "ascii" SEAT_CONTROLLER_DRIVER
 SG_ RouteInfoChar_43 : 504|8@1+ (1,0) [0|255] "ascii" SEAT_CONTROLLER_DRIVER

CM_ BO_ 388 "Cycle=50ms; Channel=CAN0; CAN-FD; NominalBitrate=500kbit/s; DataBitrate=2000kbit/s;  Data request; receiver answers with response frame; PayloadRouteInfo='BODY_CONTROL_MODULE -> SEAT_CONTROLLER_DRIVER' in bytes 20-63; Gateway to CAN4";

BO_ 1540 RESP_004_SEAT_CONTROLLER_DRIVER_TO_BODY_CONTROL_MODULE: 16 SEAT_CONTROLLER_DRIVER
 SG_ CRC8 : 0|8@1+ (1,0) [0|255] "" BODY_CONTROL_MODULE
 SG_ ResponseCounter : 8|4@1+ (1,0) [0|15] "" BODY_CONTROL_MODULE
 SG_ AckState : 12|4@1+ (1,0) [0|15] "" BODY_CONTROL_MODULE
 SG_ ReceivedFrameId : 16|11@1+ (1,0) [0|2047] "" BODY_CONTROL_MODULE
 SG_ ReceivedCounter : 27|4@1+ (1,0) [0|15] "" BODY_CONTROL_MODULE
 SG_ ChecksumOk : 31|1@1+ (1,0) [0|1] "" BODY_CONTROL_MODULE
 SG_ PayloadLength : 32|8@1+ (1,0) [0|64] "byte" BODY_CONTROL_MODULE
 SG_ ErrorCode : 40|8@1+ (1,0) [0|255] "" BODY_CONTROL_MODULE
 SG_ ProcessingTimeUs : 48|16@1+ (1,0) [0|65535] "us" BODY_CONTROL_MODULE
 SG_ ResponseSequence : 64|16@1+ (1,0) [0|65535] "" BODY_CONTROL_MODULE
 SG_ ReceivedCrc : 80|8@1+ (1,0) [0|255] "" BODY_CONTROL_MODULE
 SG_ CalculatedCrc : 88|8@1+ (1,0) [0|255] "" BODY_CONTROL_MODULE

CM_ BO_ 1540 "Cycle=50ms; Channel=CAN0; CAN-FD; NominalBitrate=500kbit/s; DataBitrate=2000kbit/s;  ResponseFor=0x184; ACK/NACK with CRC, DLC and counter check;";

BO_ 389 DATA_005_BODY_CONTROL_MODULE_BODY_STATE_TO_SEAT_CONTROLLER_PASSENGER: 64 BODY_CONTROL_MODULE
 SG_ CRC8 : 0|8@1+ (1,0) [0|255] "" SEAT_CONTROLLER_PASSENGER
 SG_ AliveCounter : 8|4@1+ (1,0) [0|15] "" SEAT_CONTROLLER_PASSENGER
 SG_ MuxState : 12|4@1+ (1,0) [0|15] "" SEAT_CONTROLLER_PASSENGER
 SG_ SIG_185_00 : 16|12@1+ (0.1,0.0) [0|4095] "Nm" SEAT_CONTROLLER_PASSENGER
 SG_ SIG_185_01 : 28|12@1+ (0.1,0.0) [0|4095] "rpm" SEAT_CONTROLLER_PASSENGER
 SG_ SIG_185_02 : 40|12@1+ (0.1,0.0) [0|4095] "%" SEAT_CONTROLLER_PASSENGER
 SG_ SIG_185_03 : 52|12@1+ (0.1,0.0) [0|4095] "V" SEAT_CONTROLLER_PASSENGER
 SG_ SIG_185_04 : 64|12@1+ (0.1,0.0) [0|4095] "C" SEAT_CONTROLLER_PASSENGER
 SG_ SIG_185_05 : 76|12@1+ (0.1,0.0) [0|4095] "A" SEAT_CONTROLLER_PASSENGER
 SG_ SIG_185_06 : 88|12@1+ (0.1,0.0) [0|4095] "deg" SEAT_CONTROLLER_PASSENGER
 SG_ SIG_185_07 : 100|12@1+ (0.1,0.0) [0|4095] "A" SEAT_CONTROLLER_PASSENGER
 SG_ SIG_185_08 : 112|12@1+ (0.1,0.0) [0|4095] "A" SEAT_CONTROLLER_PASSENGER
 SG_ SIG_185_09 : 124|12@1+ (0.1,0.0) [0|4095] "Nm" SEAT_CONTROLLER_PASSENGER
 SG_ SIG_185_10 : 136|12@1+ (0.1,0.0) [0|4095] "V" SEAT_CONTROLLER_PASSENGER
 SG_ SIG_185_11 : 148|12@1+ (0.1,0.0) [0|4095] "rpm" SEAT_CONTROLLER_PASSENGER
 SG_ RouteInfoChar_00 : 160|8@1+ (1,0) [0|255] "ascii" SEAT_CONTROLLER_PASSENGER
 SG_ RouteInfoChar_01 : 168|8@1+ (1,0) [0|255] "ascii" SEAT_CONTROLLER_PASSENGER
 SG_ RouteInfoChar_02 : 176|8@1+ (1,0) [0|255] "ascii" SEAT_CONTROLLER_PASSENGER
 SG_ RouteInfoChar_03 : 184|8@1+ (1,0) [0|255] "ascii" SEAT_CONTROLLER_PASSENGER
 SG_ RouteInfoChar_04 : 192|8@1+ (1,0) [0|255] "ascii" SEAT_CONTROLLER_PASSENGER
 SG_ RouteInfoChar_05 : 200|8@1+ (1,0) [0|255] "ascii" SEAT_CONTROLLER_PASSENGER
 SG_ RouteInfoChar_06 : 208|8@1+ (1,0) [0|255] "ascii" SEAT_CONTROLLER_PASSENGER
 SG_ RouteInfoChar_07 : 216|8@1+ (1,0) [0|255] "ascii" SEAT_CONTROLLER_PASSENGER
 SG_ RouteInfoChar_08 : 224|8@1+ (1,0) [0|255] "ascii" SEAT_CONTROLLER_PASSENGER
 SG_ RouteInfoChar_09 : 232|8@1+ (1,0) [0|255] "ascii" SEAT_CONTROLLER_PASSENGER
 SG_ RouteInfoChar_10 : 240|8@1+ (1,0) [0|255] "ascii" SEAT_CONTROLLER_PASSENGER
 SG_ RouteInfoChar_11 : 248|8@1+ (1,0) [0|255] "ascii" SEAT_CONTROLLER_PASSENGER
 SG_ RouteInfoChar_12 : 256|8@1+ (1,0) [0|255] "ascii" SEAT_CONTROLLER_PASSENGER
 SG_ RouteInfoChar_13 : 264|8@1+ (1,0) [0|255] "ascii" SEAT_CONTROLLER_PASSENGER
 SG_ RouteInfoChar_14 : 272|8@1+ (1,0) [0|255] "ascii" SEAT_CONTROLLER_PASSENGER
 SG_ RouteInfoChar_15 : 280|8@1+ (1,0) [0|255] "ascii" SEAT_CONTROLLER_PASSENGER
 SG_ RouteInfoChar_16 : 288|8@1+ (1,0) [0|255] "ascii" SEAT_CONTROLLER_PASSENGER
 SG_ RouteInfoChar_17 : 296|8@1+ (1,0) [0|255] "ascii" SEAT_CONTROLLER_PASSENGER
 SG_ RouteInfoChar_18 : 304|8@1+ (1,0) [0|255] "ascii" SEAT_CONTROLLER_PASSENGER
 SG_ RouteInfoChar_19 : 312|8@1+ (1,0) [0|255] "ascii" SEAT_CONTROLLER_PASSENGER
 SG_ RouteInfoChar_20 : 320|8@1+ (1,0) [0|255] "ascii" SEAT_CONTROLLER_PASSENGER
 SG_ RouteInfoChar_21 : 328|8@1+ (1,0) [0|255] "ascii" SEAT_CONTROLLER_PASSENGER
 SG_ RouteInfoChar_22 : 336|8@1+ (1,0) [0|255] "ascii" SEAT_CONTROLLER_PASSENGER
 SG_ RouteInfoChar_23 : 344|8@1+ (1,0) [0|255] "ascii" SEAT_CONTROLLER_PASSENGER
 SG_ RouteInfoChar_24 : 352|8@1+ (1,0) [0|255] "ascii" SEAT_CONTROLLER_PASSENGER
 SG_ RouteInfoChar_25 : 360|8@1+ (1,0) [0|255] "ascii" SEAT_CONTROLLER_PASSENGER
 SG_ RouteInfoChar_26 : 368|8@1+ (1,0) [0|255] "ascii" SEAT_CONTROLLER_PASSENGER
 SG_ RouteInfoChar_27 : 376|8@1+ (1,0) [0|255] "ascii" SEAT_CONTROLLER_PASSENGER
 SG_ RouteInfoChar_28 : 384|8@1+ (1,0) [0|255] "ascii" SEAT_CONTROLLER_PASSENGER
 SG_ RouteInfoChar_29 : 392|8@1+ (1,0) [0|255] "ascii" SEAT_CONTROLLER_PASSENGER
 SG_ RouteInfoChar_30 : 400|8@1+ (1,0) [0|255] "ascii" SEAT_CONTROLLER_PASSENGER
 SG_ RouteInfoChar_31 : 408|8@1+ (1,0) [0|255] "ascii" SEAT_CONTROLLER_PASSENGER
 SG_ RouteInfoChar_32 : 416|8@1+ (1,0) [0|255] "ascii" SEAT_CONTROLLER_PASSENGER
 SG_ RouteInfoChar_33 : 424|8@1+ (1,0) [0|255] "ascii" SEAT_CONTROLLER_PASSENGER
 SG_ RouteInfoChar_34 : 432|8@1+ (1,0) [0|255] "ascii" SEAT_CONTROLLER_PASSENGER
 SG_ RouteInfoChar_35 : 440|8@1+ (1,0) [0|255] "ascii" SEAT_CONTROLLER_PASSENGER
 SG_ RouteInfoChar_36 : 448|8@1+ (1,0) [0|255] "ascii" SEAT_CONTROLLER_PASSENGER
 SG_ RouteInfoChar_37 : 456|8@1+ (1,0) [0|255] "ascii" SEAT_CONTROLLER_PASSENGER
 SG_ RouteInfoChar_38 : 464|8@1+ (1,0) [0|255] "ascii" SEAT_CONTROLLER_PASSENGER
 SG_ RouteInfoChar_39 : 472|8@1+ (1,0) [0|255] "ascii" SEAT_CONTROLLER_PASSENGER
 SG_ RouteInfoChar_40 : 480|8@1+ (1,0) [0|255] "ascii" SEAT_CONTROLLER_PASSENGER
 SG_ RouteInfoChar_41 : 488|8@1+ (1,0) [0|255] "ascii" SEAT_CONTROLLER_PASSENGER
 SG_ RouteInfoChar_42 : 496|8@1+ (1,0) [0|255] "ascii" SEAT_CONTROLLER_PASSENGER
 SG_ RouteInfoChar_43 : 504|8@1+ (1,0) [0|255] "ascii" SEAT_CONTROLLER_PASSENGER

CM_ BO_ 389 "Cycle=50ms; Channel=CAN0; CAN-FD; NominalBitrate=500kbit/s; DataBitrate=2000kbit/s;  Data request; receiver answers with response frame; PayloadRouteInfo='BODY_CONTROL_MODULE -> SEAT_CONTROLLER_PASSENGER' in bytes 20-63; Gateway to CAN4";

BO_ 1541 RESP_005_SEAT_CONTROLLER_PASSENGER_TO_BODY_CONTROL_MODULE: 16 SEAT_CONTROLLER_PASSENGER
 SG_ CRC8 : 0|8@1+ (1,0) [0|255] "" BODY_CONTROL_MODULE
 SG_ ResponseCounter : 8|4@1+ (1,0) [0|15] "" BODY_CONTROL_MODULE
 SG_ AckState : 12|4@1+ (1,0) [0|15] "" BODY_CONTROL_MODULE
 SG_ ReceivedFrameId : 16|11@1+ (1,0) [0|2047] "" BODY_CONTROL_MODULE
 SG_ ReceivedCounter : 27|4@1+ (1,0) [0|15] "" BODY_CONTROL_MODULE
 SG_ ChecksumOk : 31|1@1+ (1,0) [0|1] "" BODY_CONTROL_MODULE
 SG_ PayloadLength : 32|8@1+ (1,0) [0|64] "byte" BODY_CONTROL_MODULE
 SG_ ErrorCode : 40|8@1+ (1,0) [0|255] "" BODY_CONTROL_MODULE
 SG_ ProcessingTimeUs : 48|16@1+ (1,0) [0|65535] "us" BODY_CONTROL_MODULE
 SG_ ResponseSequence : 64|16@1+ (1,0) [0|65535] "" BODY_CONTROL_MODULE
 SG_ ReceivedCrc : 80|8@1+ (1,0) [0|255] "" BODY_CONTROL_MODULE
 SG_ CalculatedCrc : 88|8@1+ (1,0) [0|255] "" BODY_CONTROL_MODULE

CM_ BO_ 1541 "Cycle=50ms; Channel=CAN0; CAN-FD; NominalBitrate=500kbit/s; DataBitrate=2000kbit/s;  ResponseFor=0x185; ACK/NACK with CRC, DLC and counter check;";

BO_ 390 DATA_006_BODY_CONTROL_MODULE_BODY_STATE_TO_PARK_DISTANCE_CONTROL: 64 BODY_CONTROL_MODULE
 SG_ CRC8 : 0|8@1+ (1,0) [0|255] "" PARK_DISTANCE_CONTROL
 SG_ AliveCounter : 8|4@1+ (1,0) [0|15] "" PARK_DISTANCE_CONTROL
 SG_ MuxState : 12|4@1+ (1,0) [0|15] "" PARK_DISTANCE_CONTROL
 SG_ SIG_186_00 : 16|12@1+ (0.1,0.0) [0|4095] "obj" PARK_DISTANCE_CONTROL
 SG_ SIG_186_01 : 28|12@1+ (0.1,0.0) [0|4095] "deg" PARK_DISTANCE_CONTROL
 SG_ SIG_186_02 : 40|12@1+ (0.1,0.0) [0|4095] "m" PARK_DISTANCE_CONTROL
 SG_ SIG_186_03 : 52|12@1+ (0.1,0.0) [0|4095] "Nm" PARK_DISTANCE_CONTROL
 SG_ SIG_186_04 : 64|12@1+ (0.1,0.0) [0|4095] "deg" PARK_DISTANCE_CONTROL
 SG_ SIG_186_05 : 76|12@1+ (0.1,0.0) [0|4095] "C" PARK_DISTANCE_CONTROL
 SG_ SIG_186_06 : 88|12@1+ (0.1,0.0) [0|4095] "%" PARK_DISTANCE_CONTROL
 SG_ SIG_186_07 : 100|12@1+ (0.1,0.0) [0|4095] "V" PARK_DISTANCE_CONTROL
 SG_ SIG_186_08 : 112|12@1+ (0.1,0.0) [0|4095] "m" PARK_DISTANCE_CONTROL
 SG_ SIG_186_09 : 124|12@1+ (0.1,0.0) [0|4095] "Nm" PARK_DISTANCE_CONTROL
 SG_ SIG_186_10 : 136|12@1+ (0.1,0.0) [0|4095] "A" PARK_DISTANCE_CONTROL
 SG_ SIG_186_11 : 148|12@1+ (0.1,0.0) [0|4095] "km/h" PARK_DISTANCE_CONTROL
 SG_ RouteInfoChar_00 : 160|8@1+ (1,0) [0|255] "ascii" PARK_DISTANCE_CONTROL
 SG_ RouteInfoChar_01 : 168|8@1+ (1,0) [0|255] "ascii" PARK_DISTANCE_CONTROL
 SG_ RouteInfoChar_02 : 176|8@1+ (1,0) [0|255] "ascii" PARK_DISTANCE_CONTROL
 SG_ RouteInfoChar_03 : 184|8@1+ (1,0) [0|255] "ascii" PARK_DISTANCE_CONTROL
 SG_ RouteInfoChar_04 : 192|8@1+ (1,0) [0|255] "ascii" PARK_DISTANCE_CONTROL
 SG_ RouteInfoChar_05 : 200|8@1+ (1,0) [0|255] "ascii" PARK_DISTANCE_CONTROL
 SG_ RouteInfoChar_06 : 208|8@1+ (1,0) [0|255] "ascii" PARK_DISTANCE_CONTROL
 SG_ RouteInfoChar_07 : 216|8@1+ (1,0) [0|255] "ascii" PARK_DISTANCE_CONTROL
 SG_ RouteInfoChar_08 : 224|8@1+ (1,0) [0|255] "ascii" PARK_DISTANCE_CONTROL
 SG_ RouteInfoChar_09 : 232|8@1+ (1,0) [0|255] "ascii" PARK_DISTANCE_CONTROL
 SG_ RouteInfoChar_10 : 240|8@1+ (1,0) [0|255] "ascii" PARK_DISTANCE_CONTROL
 SG_ RouteInfoChar_11 : 248|8@1+ (1,0) [0|255] "ascii" PARK_DISTANCE_CONTROL
 SG_ RouteInfoChar_12 : 256|8@1+ (1,0) [0|255] "ascii" PARK_DISTANCE_CONTROL
 SG_ RouteInfoChar_13 : 264|8@1+ (1,0) [0|255] "ascii" PARK_DISTANCE_CONTROL
 SG_ RouteInfoChar_14 : 272|8@1+ (1,0) [0|255] "ascii" PARK_DISTANCE_CONTROL
 SG_ RouteInfoChar_15 : 280|8@1+ (1,0) [0|255] "ascii" PARK_DISTANCE_CONTROL
 SG_ RouteInfoChar_16 : 288|8@1+ (1,0) [0|255] "ascii" PARK_DISTANCE_CONTROL
 SG_ RouteInfoChar_17 : 296|8@1+ (1,0) [0|255] "ascii" PARK_DISTANCE_CONTROL
 SG_ RouteInfoChar_18 : 304|8@1+ (1,0) [0|255] "ascii" PARK_DISTANCE_CONTROL
 SG_ RouteInfoChar_19 : 312|8@1+ (1,0) [0|255] "ascii" PARK_DISTANCE_CONTROL
 SG_ RouteInfoChar_20 : 320|8@1+ (1,0) [0|255] "ascii" PARK_DISTANCE_CONTROL
 SG_ RouteInfoChar_21 : 328|8@1+ (1,0) [0|255] "ascii" PARK_DISTANCE_CONTROL
 SG_ RouteInfoChar_22 : 336|8@1+ (1,0) [0|255] "ascii" PARK_DISTANCE_CONTROL
 SG_ RouteInfoChar_23 : 344|8@1+ (1,0) [0|255] "ascii" PARK_DISTANCE_CONTROL
 SG_ RouteInfoChar_24 : 352|8@1+ (1,0) [0|255] "ascii" PARK_DISTANCE_CONTROL
 SG_ RouteInfoChar_25 : 360|8@1+ (1,0) [0|255] "ascii" PARK_DISTANCE_CONTROL
 SG_ RouteInfoChar_26 : 368|8@1+ (1,0) [0|255] "ascii" PARK_DISTANCE_CONTROL
 SG_ RouteInfoChar_27 : 376|8@1+ (1,0) [0|255] "ascii" PARK_DISTANCE_CONTROL
 SG_ RouteInfoChar_28 : 384|8@1+ (1,0) [0|255] "ascii" PARK_DISTANCE_CONTROL
 SG_ RouteInfoChar_29 : 392|8@1+ (1,0) [0|255] "ascii" PARK_DISTANCE_CONTROL
 SG_ RouteInfoChar_30 : 400|8@1+ (1,0) [0|255] "ascii" PARK_DISTANCE_CONTROL
 SG_ RouteInfoChar_31 : 408|8@1+ (1,0) [0|255] "ascii" PARK_DISTANCE_CONTROL
 SG_ RouteInfoChar_32 : 416|8@1+ (1,0) [0|255] "ascii" PARK_DISTANCE_CONTROL
 SG_ RouteInfoChar_33 : 424|8@1+ (1,0) [0|255] "ascii" PARK_DISTANCE_CONTROL
 SG_ RouteInfoChar_34 : 432|8@1+ (1,0) [0|255] "ascii" PARK_DISTANCE_CONTROL
 SG_ RouteInfoChar_35 : 440|8@1+ (1,0) [0|255] "ascii" PARK_DISTANCE_CONTROL
 SG_ RouteInfoChar_36 : 448|8@1+ (1,0) [0|255] "ascii" PARK_DISTANCE_CONTROL
 SG_ RouteInfoChar_37 : 456|8@1+ (1,0) [0|255] "ascii" PARK_DISTANCE_CONTROL
 SG_ RouteInfoChar_38 : 464|8@1+ (1,0) [0|255] "ascii" PARK_DISTANCE_CONTROL
 SG_ RouteInfoChar_39 : 472|8@1+ (1,0) [0|255] "ascii" PARK_DISTANCE_CONTROL
 SG_ RouteInfoChar_40 : 480|8@1+ (1,0) [0|255] "ascii" PARK_DISTANCE_CONTROL
 SG_ RouteInfoChar_41 : 488|8@1+ (1,0) [0|255] "ascii" PARK_DISTANCE_CONTROL
 SG_ RouteInfoChar_42 : 496|8@1+ (1,0) [0|255] "ascii" PARK_DISTANCE_CONTROL
 SG_ RouteInfoChar_43 : 504|8@1+ (1,0) [0|255] "ascii" PARK_DISTANCE_CONTROL

CM_ BO_ 390 "Cycle=40ms; Channel=CAN0; CAN-FD; NominalBitrate=500kbit/s; DataBitrate=2000kbit/s;  Data request; receiver answers with response frame; PayloadRouteInfo='BODY_CONTROL_MODULE -> PARK_DISTANCE_CONTROL' in bytes 20-63; Gateway to CAN4";

BO_ 1542 RESP_006_PARK_DISTANCE_CONTROL_TO_BODY_CONTROL_MODULE: 16 PARK_DISTANCE_CONTROL
 SG_ CRC8 : 0|8@1+ (1,0) [0|255] "" BODY_CONTROL_MODULE
 SG_ ResponseCounter : 8|4@1+ (1,0) [0|15] "" BODY_CONTROL_MODULE
 SG_ AckState : 12|4@1+ (1,0) [0|15] "" BODY_CONTROL_MODULE
 SG_ ReceivedFrameId : 16|11@1+ (1,0) [0|2047] "" BODY_CONTROL_MODULE
 SG_ ReceivedCounter : 27|4@1+ (1,0) [0|15] "" BODY_CONTROL_MODULE
 SG_ ChecksumOk : 31|1@1+ (1,0) [0|1] "" BODY_CONTROL_MODULE
 SG_ PayloadLength : 32|8@1+ (1,0) [0|64] "byte" BODY_CONTROL_MODULE
 SG_ ErrorCode : 40|8@1+ (1,0) [0|255] "" BODY_CONTROL_MODULE
 SG_ ProcessingTimeUs : 48|16@1+ (1,0) [0|65535] "us" BODY_CONTROL_MODULE
 SG_ ResponseSequence : 64|16@1+ (1,0) [0|65535] "" BODY_CONTROL_MODULE
 SG_ ReceivedCrc : 80|8@1+ (1,0) [0|255] "" BODY_CONTROL_MODULE
 SG_ CalculatedCrc : 88|8@1+ (1,0) [0|255] "" BODY_CONTROL_MODULE

CM_ BO_ 1542 "Cycle=40ms; Channel=CAN0; CAN-FD; NominalBitrate=500kbit/s; DataBitrate=2000kbit/s;  ResponseFor=0x186; ACK/NACK with CRC, DLC and counter check;";

BO_ 391 DATA_007_BODY_CONTROL_MODULE_BODY_STATE_TO_REAR_VIEW_CAMERA: 64 BODY_CONTROL_MODULE
 SG_ CRC8 : 0|8@1+ (1,0) [0|255] "" REAR_VIEW_CAMERA
 SG_ AliveCounter : 8|4@1+ (1,0) [0|15] "" REAR_VIEW_CAMERA
 SG_ MuxState : 12|4@1+ (1,0) [0|15] "" REAR_VIEW_CAMERA
 SG_ SIG_187_00 : 16|12@1+ (0.1,0.0) [0|4095] "Nm" REAR_VIEW_CAMERA
 SG_ SIG_187_01 : 28|12@1+ (0.1,0.0) [0|4095] "km/h" REAR_VIEW_CAMERA
 SG_ SIG_187_02 : 40|12@1+ (0.1,0.0) [0|4095] "A" REAR_VIEW_CAMERA
 SG_ SIG_187_03 : 52|12@1+ (0.1,0.0) [0|4095] "%" REAR_VIEW_CAMERA
 SG_ SIG_187_04 : 64|12@1+ (0.1,0.0) [0|4095] "V" REAR_VIEW_CAMERA
 SG_ SIG_187_05 : 76|12@1+ (0.1,0.0) [0|4095] "rpm" REAR_VIEW_CAMERA
 SG_ SIG_187_06 : 88|12@1+ (0.1,0.0) [0|4095] "Nm" REAR_VIEW_CAMERA
 SG_ SIG_187_07 : 100|12@1+ (0.1,0.0) [0|4095] "obj" REAR_VIEW_CAMERA
 SG_ SIG_187_08 : 112|12@1+ (0.1,0.0) [0|4095] "A" REAR_VIEW_CAMERA
 SG_ SIG_187_09 : 124|12@1+ (0.1,0.0) [0|4095] "Nm" REAR_VIEW_CAMERA
 SG_ SIG_187_10 : 136|12@1+ (0.1,0.0) [0|4095] "C" REAR_VIEW_CAMERA
 SG_ SIG_187_11 : 148|12@1+ (0.1,0.0) [0|4095] "%" REAR_VIEW_CAMERA
 SG_ RouteInfoChar_00 : 160|8@1+ (1,0) [0|255] "ascii" REAR_VIEW_CAMERA
 SG_ RouteInfoChar_01 : 168|8@1+ (1,0) [0|255] "ascii" REAR_VIEW_CAMERA
 SG_ RouteInfoChar_02 : 176|8@1+ (1,0) [0|255] "ascii" REAR_VIEW_CAMERA
 SG_ RouteInfoChar_03 : 184|8@1+ (1,0) [0|255] "ascii" REAR_VIEW_CAMERA
 SG_ RouteInfoChar_04 : 192|8@1+ (1,0) [0|255] "ascii" REAR_VIEW_CAMERA
 SG_ RouteInfoChar_05 : 200|8@1+ (1,0) [0|255] "ascii" REAR_VIEW_CAMERA
 SG_ RouteInfoChar_06 : 208|8@1+ (1,0) [0|255] "ascii" REAR_VIEW_CAMERA
 SG_ RouteInfoChar_07 : 216|8@1+ (1,0) [0|255] "ascii" REAR_VIEW_CAMERA
 SG_ RouteInfoChar_08 : 224|8@1+ (1,0) [0|255] "ascii" REAR_VIEW_CAMERA
 SG_ RouteInfoChar_09 : 232|8@1+ (1,0) [0|255] "ascii" REAR_VIEW_CAMERA
 SG_ RouteInfoChar_10 : 240|8@1+ (1,0) [0|255] "ascii" REAR_VIEW_CAMERA
 SG_ RouteInfoChar_11 : 248|8@1+ (1,0) [0|255] "ascii" REAR_VIEW_CAMERA
 SG_ RouteInfoChar_12 : 256|8@1+ (1,0) [0|255] "ascii" REAR_VIEW_CAMERA
 SG_ RouteInfoChar_13 : 264|8@1+ (1,0) [0|255] "ascii" REAR_VIEW_CAMERA
 SG_ RouteInfoChar_14 : 272|8@1+ (1,0) [0|255] "ascii" REAR_VIEW_CAMERA
 SG_ RouteInfoChar_15 : 280|8@1+ (1,0) [0|255] "ascii" REAR_VIEW_CAMERA
 SG_ RouteInfoChar_16 : 288|8@1+ (1,0) [0|255] "ascii" REAR_VIEW_CAMERA
 SG_ RouteInfoChar_17 : 296|8@1+ (1,0) [0|255] "ascii" REAR_VIEW_CAMERA
 SG_ RouteInfoChar_18 : 304|8@1+ (1,0) [0|255] "ascii" REAR_VIEW_CAMERA
 SG_ RouteInfoChar_19 : 312|8@1+ (1,0) [0|255] "ascii" REAR_VIEW_CAMERA
 SG_ RouteInfoChar_20 : 320|8@1+ (1,0) [0|255] "ascii" REAR_VIEW_CAMERA
 SG_ RouteInfoChar_21 : 328|8@1+ (1,0) [0|255] "ascii" REAR_VIEW_CAMERA
 SG_ RouteInfoChar_22 : 336|8@1+ (1,0) [0|255] "ascii" REAR_VIEW_CAMERA
 SG_ RouteInfoChar_23 : 344|8@1+ (1,0) [0|255] "ascii" REAR_VIEW_CAMERA
 SG_ RouteInfoChar_24 : 352|8@1+ (1,0) [0|255] "ascii" REAR_VIEW_CAMERA
 SG_ RouteInfoChar_25 : 360|8@1+ (1,0) [0|255] "ascii" REAR_VIEW_CAMERA
 SG_ RouteInfoChar_26 : 368|8@1+ (1,0) [0|255] "ascii" REAR_VIEW_CAMERA
 SG_ RouteInfoChar_27 : 376|8@1+ (1,0) [0|255] "ascii" REAR_VIEW_CAMERA
 SG_ RouteInfoChar_28 : 384|8@1+ (1,0) [0|255] "ascii" REAR_VIEW_CAMERA
 SG_ RouteInfoChar_29 : 392|8@1+ (1,0) [0|255] "ascii" REAR_VIEW_CAMERA
 SG_ RouteInfoChar_30 : 400|8@1+ (1,0) [0|255] "ascii" REAR_VIEW_CAMERA
 SG_ RouteInfoChar_31 : 408|8@1+ (1,0) [0|255] "ascii" REAR_VIEW_CAMERA
 SG_ RouteInfoChar_32 : 416|8@1+ (1,0) [0|255] "ascii" REAR_VIEW_CAMERA
 SG_ RouteInfoChar_33 : 424|8@1+ (1,0) [0|255] "ascii" REAR_VIEW_CAMERA
 SG_ RouteInfoChar_34 : 432|8@1+ (1,0) [0|255] "ascii" REAR_VIEW_CAMERA
 SG_ RouteInfoChar_35 : 440|8@1+ (1,0) [0|255] "ascii" REAR_VIEW_CAMERA
 SG_ RouteInfoChar_36 : 448|8@1+ (1,0) [0|255] "ascii" REAR_VIEW_CAMERA
 SG_ RouteInfoChar_37 : 456|8@1+ (1,0) [0|255] "ascii" REAR_VIEW_CAMERA
 SG_ RouteInfoChar_38 : 464|8@1+ (1,0) [0|255] "ascii" REAR_VIEW_CAMERA
 SG_ RouteInfoChar_39 : 472|8@1+ (1,0) [0|255] "ascii" REAR_VIEW_CAMERA
 SG_ RouteInfoChar_40 : 480|8@1+ (1,0) [0|255] "ascii" REAR_VIEW_CAMERA
 SG_ RouteInfoChar_41 : 488|8@1+ (1,0) [0|255] "ascii" REAR_VIEW_CAMERA
 SG_ RouteInfoChar_42 : 496|8@1+ (1,0) [0|255] "ascii" REAR_VIEW_CAMERA
 SG_ RouteInfoChar_43 : 504|8@1+ (1,0) [0|255] "ascii" REAR_VIEW_CAMERA

CM_ BO_ 391 "Cycle=33ms; Channel=CAN0; CAN-FD; NominalBitrate=500kbit/s; DataBitrate=2000kbit/s;  Data request; receiver answers with response frame; PayloadRouteInfo='BODY_CONTROL_MODULE -> REAR_VIEW_CAMERA' in bytes 20-63; Gateway to CAN4";

BO_ 1543 RESP_007_REAR_VIEW_CAMERA_TO_BODY_CONTROL_MODULE: 16 REAR_VIEW_CAMERA
 SG_ CRC8 : 0|8@1+ (1,0) [0|255] "" BODY_CONTROL_MODULE
 SG_ ResponseCounter : 8|4@1+ (1,0) [0|15] "" BODY_CONTROL_MODULE
 SG_ AckState : 12|4@1+ (1,0) [0|15] "" BODY_CONTROL_MODULE
 SG_ ReceivedFrameId : 16|11@1+ (1,0) [0|2047] "" BODY_CONTROL_MODULE
 SG_ ReceivedCounter : 27|4@1+ (1,0) [0|15] "" BODY_CONTROL_MODULE
 SG_ ChecksumOk : 31|1@1+ (1,0) [0|1] "" BODY_CONTROL_MODULE
 SG_ PayloadLength : 32|8@1+ (1,0) [0|64] "byte" BODY_CONTROL_MODULE
 SG_ ErrorCode : 40|8@1+ (1,0) [0|255] "" BODY_CONTROL_MODULE
 SG_ ProcessingTimeUs : 48|16@1+ (1,0) [0|65535] "us" BODY_CONTROL_MODULE
 SG_ ResponseSequence : 64|16@1+ (1,0) [0|65535] "" BODY_CONTROL_MODULE
 SG_ ReceivedCrc : 80|8@1+ (1,0) [0|255] "" BODY_CONTROL_MODULE
 SG_ CalculatedCrc : 88|8@1+ (1,0) [0|255] "" BODY_CONTROL_MODULE

CM_ BO_ 1543 "Cycle=33ms; Channel=CAN0; CAN-FD; NominalBitrate=500kbit/s; DataBitrate=2000kbit/s;  ResponseFor=0x187; ACK/NACK with CRC, DLC and counter check;";

BO_ 392 DATA_008_BODY_CONTROL_MODULE_BODY_STATE_TO_INSTRUMENT_CLUSTER_KOMBI: 64 BODY_CONTROL_MODULE
 SG_ CRC8 : 0|8@1+ (1,0) [0|255] "" INSTRUMENT_CLUSTER_KOMBI
 SG_ AliveCounter : 8|4@1+ (1,0) [0|15] "" INSTRUMENT_CLUSTER_KOMBI
 SG_ MuxState : 12|4@1+ (1,0) [0|15] "" INSTRUMENT_CLUSTER_KOMBI
 SG_ SIG_188_00 : 16|12@1+ (0.1,0.0) [0|4095] "C" INSTRUMENT_CLUSTER_KOMBI
 SG_ SIG_188_01 : 28|12@1+ (0.1,0.0) [0|4095] "deg" INSTRUMENT_CLUSTER_KOMBI
 SG_ SIG_188_02 : 40|12@1+ (0.1,0.0) [0|4095] "V" INSTRUMENT_CLUSTER_KOMBI
 SG_ SIG_188_03 : 52|12@1+ (0.1,0.0) [0|4095] "deg" INSTRUMENT_CLUSTER_KOMBI
 SG_ SIG_188_04 : 64|12@1+ (0.1,0.0) [0|4095] "Nm" INSTRUMENT_CLUSTER_KOMBI
 SG_ SIG_188_05 : 76|12@1+ (0.1,0.0) [0|4095] "m" INSTRUMENT_CLUSTER_KOMBI
 SG_ SIG_188_06 : 88|12@1+ (0.1,0.0) [0|4095] "m" INSTRUMENT_CLUSTER_KOMBI
 SG_ SIG_188_07 : 100|12@1+ (0.1,0.0) [0|4095] "V" INSTRUMENT_CLUSTER_KOMBI
 SG_ SIG_188_08 : 112|12@1+ (0.1,0.0) [0|4095] "obj" INSTRUMENT_CLUSTER_KOMBI
 SG_ SIG_188_09 : 124|12@1+ (0.1,0.0) [0|4095] "%" INSTRUMENT_CLUSTER_KOMBI
 SG_ SIG_188_10 : 136|12@1+ (0.1,0.0) [0|4095] "obj" INSTRUMENT_CLUSTER_KOMBI
 SG_ SIG_188_11 : 148|12@1+ (0.1,0.0) [0|4095] "%" INSTRUMENT_CLUSTER_KOMBI
 SG_ RouteInfoChar_00 : 160|8@1+ (1,0) [0|255] "ascii" INSTRUMENT_CLUSTER_KOMBI
 SG_ RouteInfoChar_01 : 168|8@1+ (1,0) [0|255] "ascii" INSTRUMENT_CLUSTER_KOMBI
 SG_ RouteInfoChar_02 : 176|8@1+ (1,0) [0|255] "ascii" INSTRUMENT_CLUSTER_KOMBI
 SG_ RouteInfoChar_03 : 184|8@1+ (1,0) [0|255] "ascii" INSTRUMENT_CLUSTER_KOMBI
 SG_ RouteInfoChar_04 : 192|8@1+ (1,0) [0|255] "ascii" INSTRUMENT_CLUSTER_KOMBI
 SG_ RouteInfoChar_05 : 200|8@1+ (1,0) [0|255] "ascii" INSTRUMENT_CLUSTER_KOMBI
 SG_ RouteInfoChar_06 : 208|8@1+ (1,0) [0|255] "ascii" INSTRUMENT_CLUSTER_KOMBI
 SG_ RouteInfoChar_07 : 216|8@1+ (1,0) [0|255] "ascii" INSTRUMENT_CLUSTER_KOMBI
 SG_ RouteInfoChar_08 : 224|8@1+ (1,0) [0|255] "ascii" INSTRUMENT_CLUSTER_KOMBI
 SG_ RouteInfoChar_09 : 232|8@1+ (1,0) [0|255] "ascii" INSTRUMENT_CLUSTER_KOMBI
 SG_ RouteInfoChar_10 : 240|8@1+ (1,0) [0|255] "ascii" INSTRUMENT_CLUSTER_KOMBI
 SG_ RouteInfoChar_11 : 248|8@1+ (1,0) [0|255] "ascii" INSTRUMENT_CLUSTER_KOMBI
 SG_ RouteInfoChar_12 : 256|8@1+ (1,0) [0|255] "ascii" INSTRUMENT_CLUSTER_KOMBI
 SG_ RouteInfoChar_13 : 264|8@1+ (1,0) [0|255] "ascii" INSTRUMENT_CLUSTER_KOMBI
 SG_ RouteInfoChar_14 : 272|8@1+ (1,0) [0|255] "ascii" INSTRUMENT_CLUSTER_KOMBI
 SG_ RouteInfoChar_15 : 280|8@1+ (1,0) [0|255] "ascii" INSTRUMENT_CLUSTER_KOMBI
 SG_ RouteInfoChar_16 : 288|8@1+ (1,0) [0|255] "ascii" INSTRUMENT_CLUSTER_KOMBI
 SG_ RouteInfoChar_17 : 296|8@1+ (1,0) [0|255] "ascii" INSTRUMENT_CLUSTER_KOMBI
 SG_ RouteInfoChar_18 : 304|8@1+ (1,0) [0|255] "ascii" INSTRUMENT_CLUSTER_KOMBI
 SG_ RouteInfoChar_19 : 312|8@1+ (1,0) [0|255] "ascii" INSTRUMENT_CLUSTER_KOMBI
 SG_ RouteInfoChar_20 : 320|8@1+ (1,0) [0|255] "ascii" INSTRUMENT_CLUSTER_KOMBI
 SG_ RouteInfoChar_21 : 328|8@1+ (1,0) [0|255] "ascii" INSTRUMENT_CLUSTER_KOMBI
 SG_ RouteInfoChar_22 : 336|8@1+ (1,0) [0|255] "ascii" INSTRUMENT_CLUSTER_KOMBI
 SG_ RouteInfoChar_23 : 344|8@1+ (1,0) [0|255] "ascii" INSTRUMENT_CLUSTER_KOMBI
 SG_ RouteInfoChar_24 : 352|8@1+ (1,0) [0|255] "ascii" INSTRUMENT_CLUSTER_KOMBI
 SG_ RouteInfoChar_25 : 360|8@1+ (1,0) [0|255] "ascii" INSTRUMENT_CLUSTER_KOMBI
 SG_ RouteInfoChar_26 : 368|8@1+ (1,0) [0|255] "ascii" INSTRUMENT_CLUSTER_KOMBI
 SG_ RouteInfoChar_27 : 376|8@1+ (1,0) [0|255] "ascii" INSTRUMENT_CLUSTER_KOMBI
 SG_ RouteInfoChar_28 : 384|8@1+ (1,0) [0|255] "ascii" INSTRUMENT_CLUSTER_KOMBI
 SG_ RouteInfoChar_29 : 392|8@1+ (1,0) [0|255] "ascii" INSTRUMENT_CLUSTER_KOMBI
 SG_ RouteInfoChar_30 : 400|8@1+ (1,0) [0|255] "ascii" INSTRUMENT_CLUSTER_KOMBI
 SG_ RouteInfoChar_31 : 408|8@1+ (1,0) [0|255] "ascii" INSTRUMENT_CLUSTER_KOMBI
 SG_ RouteInfoChar_32 : 416|8@1+ (1,0) [0|255] "ascii" INSTRUMENT_CLUSTER_KOMBI
 SG_ RouteInfoChar_33 : 424|8@1+ (1,0) [0|255] "ascii" INSTRUMENT_CLUSTER_KOMBI
 SG_ RouteInfoChar_34 : 432|8@1+ (1,0) [0|255] "ascii" INSTRUMENT_CLUSTER_KOMBI
 SG_ RouteInfoChar_35 : 440|8@1+ (1,0) [0|255] "ascii" INSTRUMENT_CLUSTER_KOMBI
 SG_ RouteInfoChar_36 : 448|8@1+ (1,0) [0|255] "ascii" INSTRUMENT_CLUSTER_KOMBI
 SG_ RouteInfoChar_37 : 456|8@1+ (1,0) [0|255] "ascii" INSTRUMENT_CLUSTER_KOMBI
 SG_ RouteInfoChar_38 : 464|8@1+ (1,0) [0|255] "ascii" INSTRUMENT_CLUSTER_KOMBI
 SG_ RouteInfoChar_39 : 472|8@1+ (1,0) [0|255] "ascii" INSTRUMENT_CLUSTER_KOMBI
 SG_ RouteInfoChar_40 : 480|8@1+ (1,0) [0|255] "ascii" INSTRUMENT_CLUSTER_KOMBI
 SG_ RouteInfoChar_41 : 488|8@1+ (1,0) [0|255] "ascii" INSTRUMENT_CLUSTER_KOMBI
 SG_ RouteInfoChar_42 : 496|8@1+ (1,0) [0|255] "ascii" INSTRUMENT_CLUSTER_KOMBI
 SG_ RouteInfoChar_43 : 504|8@1+ (1,0) [0|255] "ascii" INSTRUMENT_CLUSTER_KOMBI

CM_ BO_ 392 "Cycle=20ms; Channel=CAN0; CAN-FD; NominalBitrate=500kbit/s; DataBitrate=2000kbit/s;  Data request; receiver answers with response frame; PayloadRouteInfo='BODY_CONTROL_MODULE -> INSTRUMENT_CLUSTER_KOMBI' in bytes 20-63; Gateway to CAN4";

BO_ 1544 RESP_008_INSTRUMENT_CLUSTER_KOMBI_TO_BODY_CONTROL_MODULE: 16 INSTRUMENT_CLUSTER_KOMBI
 SG_ CRC8 : 0|8@1+ (1,0) [0|255] "" BODY_CONTROL_MODULE
 SG_ ResponseCounter : 8|4@1+ (1,0) [0|15] "" BODY_CONTROL_MODULE
 SG_ AckState : 12|4@1+ (1,0) [0|15] "" BODY_CONTROL_MODULE
 SG_ ReceivedFrameId : 16|11@1+ (1,0) [0|2047] "" BODY_CONTROL_MODULE
 SG_ ReceivedCounter : 27|4@1+ (1,0) [0|15] "" BODY_CONTROL_MODULE
 SG_ ChecksumOk : 31|1@1+ (1,0) [0|1] "" BODY_CONTROL_MODULE
 SG_ PayloadLength : 32|8@1+ (1,0) [0|64] "byte" BODY_CONTROL_MODULE
 SG_ ErrorCode : 40|8@1+ (1,0) [0|255] "" BODY_CONTROL_MODULE
 SG_ ProcessingTimeUs : 48|16@1+ (1,0) [0|65535] "us" BODY_CONTROL_MODULE
 SG_ ResponseSequence : 64|16@1+ (1,0) [0|65535] "" BODY_CONTROL_MODULE
 SG_ ReceivedCrc : 80|8@1+ (1,0) [0|255] "" BODY_CONTROL_MODULE
 SG_ CalculatedCrc : 88|8@1+ (1,0) [0|255] "" BODY_CONTROL_MODULE

CM_ BO_ 1544 "Cycle=20ms; Channel=CAN0; CAN-FD; NominalBitrate=500kbit/s; DataBitrate=2000kbit/s;  ResponseFor=0x188; ACK/NACK with CRC, DLC and counter check;";

BO_ 393 DATA_009_BODY_CONTROL_MODULE_BODY_STATE_TO_CENTRAL_GATEWAY: 64 BODY_CONTROL_MODULE
 SG_ CRC8 : 0|8@1+ (1,0) [0|255] "" CENTRAL_GATEWAY
 SG_ AliveCounter : 8|4@1+ (1,0) [0|15] "" CENTRAL_GATEWAY
 SG_ MuxState : 12|4@1+ (1,0) [0|15] "" CENTRAL_GATEWAY
 SG_ SIG_189_00 : 16|12@1+ (0.1,0.0) [0|4095] "A" CENTRAL_GATEWAY
 SG_ SIG_189_01 : 28|12@1+ (0.1,0.0) [0|4095] "Nm" CENTRAL_GATEWAY
 SG_ SIG_189_02 : 40|12@1+ (0.1,0.0) [0|4095] "deg" CENTRAL_GATEWAY
 SG_ SIG_189_03 : 52|12@1+ (0.1,0.0) [0|4095] "m" CENTRAL_GATEWAY
 SG_ SIG_189_04 : 64|12@1+ (0.1,0.0) [0|4095] "C" CENTRAL_GATEWAY
 SG_ SIG_189_05 : 76|12@1+ (0.1,0.0) [0|4095] "rpm" CENTRAL_GATEWAY
 SG_ SIG_189_06 : 88|12@1+ (0.1,0.0) [0|4095] "km/h" CENTRAL_GATEWAY
 SG_ SIG_189_07 : 100|12@1+ (0.1,0.0) [0|4095] "rpm" CENTRAL_GATEWAY
 SG_ SIG_189_08 : 112|12@1+ (0.1,0.0) [0|4095] "deg" CENTRAL_GATEWAY
 SG_ SIG_189_09 : 124|12@1+ (0.1,0.0) [0|4095] "deg" CENTRAL_GATEWAY
 SG_ SIG_189_10 : 136|12@1+ (0.1,0.0) [0|4095] "%" CENTRAL_GATEWAY
 SG_ SIG_189_11 : 148|12@1+ (0.1,0.0) [0|4095] "obj" CENTRAL_GATEWAY
 SG_ RouteInfoChar_00 : 160|8@1+ (1,0) [0|255] "ascii" CENTRAL_GATEWAY
 SG_ RouteInfoChar_01 : 168|8@1+ (1,0) [0|255] "ascii" CENTRAL_GATEWAY
 SG_ RouteInfoChar_02 : 176|8@1+ (1,0) [0|255] "ascii" CENTRAL_GATEWAY
 SG_ RouteInfoChar_03 : 184|8@1+ (1,0) [0|255] "ascii" CENTRAL_GATEWAY
 SG_ RouteInfoChar_04 : 192|8@1+ (1,0) [0|255] "ascii" CENTRAL_GATEWAY
 SG_ RouteInfoChar_05 : 200|8@1+ (1,0) [0|255] "ascii" CENTRAL_GATEWAY
 SG_ RouteInfoChar_06 : 208|8@1+ (1,0) [0|255] "ascii" CENTRAL_GATEWAY
 SG_ RouteInfoChar_07 : 216|8@1+ (1,0) [0|255] "ascii" CENTRAL_GATEWAY
 SG_ RouteInfoChar_08 : 224|8@1+ (1,0) [0|255] "ascii" CENTRAL_GATEWAY
 SG_ RouteInfoChar_09 : 232|8@1+ (1,0) [0|255] "ascii" CENTRAL_GATEWAY
 SG_ RouteInfoChar_10 : 240|8@1+ (1,0) [0|255] "ascii" CENTRAL_GATEWAY
 SG_ RouteInfoChar_11 : 248|8@1+ (1,0) [0|255] "ascii" CENTRAL_GATEWAY
 SG_ RouteInfoChar_12 : 256|8@1+ (1,0) [0|255] "ascii" CENTRAL_GATEWAY
 SG_ RouteInfoChar_13 : 264|8@1+ (1,0) [0|255] "ascii" CENTRAL_GATEWAY
 SG_ RouteInfoChar_14 : 272|8@1+ (1,0) [0|255] "ascii" CENTRAL_GATEWAY
 SG_ RouteInfoChar_15 : 280|8@1+ (1,0) [0|255] "ascii" CENTRAL_GATEWAY
 SG_ RouteInfoChar_16 : 288|8@1+ (1,0) [0|255] "ascii" CENTRAL_GATEWAY
 SG_ RouteInfoChar_17 : 296|8@1+ (1,0) [0|255] "ascii" CENTRAL_GATEWAY
 SG_ RouteInfoChar_18 : 304|8@1+ (1,0) [0|255] "ascii" CENTRAL_GATEWAY
 SG_ RouteInfoChar_19 : 312|8@1+ (1,0) [0|255] "ascii" CENTRAL_GATEWAY
 SG_ RouteInfoChar_20 : 320|8@1+ (1,0) [0|255] "ascii" CENTRAL_GATEWAY
 SG_ RouteInfoChar_21 : 328|8@1+ (1,0) [0|255] "ascii" CENTRAL_GATEWAY
 SG_ RouteInfoChar_22 : 336|8@1+ (1,0) [0|255] "ascii" CENTRAL_GATEWAY
 SG_ RouteInfoChar_23 : 344|8@1+ (1,0) [0|255] "ascii" CENTRAL_GATEWAY
 SG_ RouteInfoChar_24 : 352|8@1+ (1,0) [0|255] "ascii" CENTRAL_GATEWAY
 SG_ RouteInfoChar_25 : 360|8@1+ (1,0) [0|255] "ascii" CENTRAL_GATEWAY
 SG_ RouteInfoChar_26 : 368|8@1+ (1,0) [0|255] "ascii" CENTRAL_GATEWAY
 SG_ RouteInfoChar_27 : 376|8@1+ (1,0) [0|255] "ascii" CENTRAL_GATEWAY
 SG_ RouteInfoChar_28 : 384|8@1+ (1,0) [0|255] "ascii" CENTRAL_GATEWAY
 SG_ RouteInfoChar_29 : 392|8@1+ (1,0) [0|255] "ascii" CENTRAL_GATEWAY
 SG_ RouteInfoChar_30 : 400|8@1+ (1,0) [0|255] "ascii" CENTRAL_GATEWAY
 SG_ RouteInfoChar_31 : 408|8@1+ (1,0) [0|255] "ascii" CENTRAL_GATEWAY
 SG_ RouteInfoChar_32 : 416|8@1+ (1,0) [0|255] "ascii" CENTRAL_GATEWAY
 SG_ RouteInfoChar_33 : 424|8@1+ (1,0) [0|255] "ascii" CENTRAL_GATEWAY
 SG_ RouteInfoChar_34 : 432|8@1+ (1,0) [0|255] "ascii" CENTRAL_GATEWAY
 SG_ RouteInfoChar_35 : 440|8@1+ (1,0) [0|255] "ascii" CENTRAL_GATEWAY
 SG_ RouteInfoChar_36 : 448|8@1+ (1,0) [0|255] "ascii" CENTRAL_GATEWAY
 SG_ RouteInfoChar_37 : 456|8@1+ (1,0) [0|255] "ascii" CENTRAL_GATEWAY
 SG_ RouteInfoChar_38 : 464|8@1+ (1,0) [0|255] "ascii" CENTRAL_GATEWAY
 SG_ RouteInfoChar_39 : 472|8@1+ (1,0) [0|255] "ascii" CENTRAL_GATEWAY
 SG_ RouteInfoChar_40 : 480|8@1+ (1,0) [0|255] "ascii" CENTRAL_GATEWAY
 SG_ RouteInfoChar_41 : 488|8@1+ (1,0) [0|255] "ascii" CENTRAL_GATEWAY
 SG_ RouteInfoChar_42 : 496|8@1+ (1,0) [0|255] "ascii" CENTRAL_GATEWAY
 SG_ RouteInfoChar_43 : 504|8@1+ (1,0) [0|255] "ascii" CENTRAL_GATEWAY

CM_ BO_ 393 "Cycle=50ms; Channel=CAN0; CAN-FD; NominalBitrate=500kbit/s; DataBitrate=2000kbit/s;  Data request; receiver answers with response frame; PayloadRouteInfo='BODY_CONTROL_MODULE -> CENTRAL_GATEWAY' in bytes 20-63; Gateway to CAN4";

BO_ 1545 RESP_009_CENTRAL_GATEWAY_TO_BODY_CONTROL_MODULE: 16 CENTRAL_GATEWAY
 SG_ CRC8 : 0|8@1+ (1,0) [0|255] "" BODY_CONTROL_MODULE
 SG_ ResponseCounter : 8|4@1+ (1,0) [0|15] "" BODY_CONTROL_MODULE
 SG_ AckState : 12|4@1+ (1,0) [0|15] "" BODY_CONTROL_MODULE
 SG_ ReceivedFrameId : 16|11@1+ (1,0) [0|2047] "" BODY_CONTROL_MODULE
 SG_ ReceivedCounter : 27|4@1+ (1,0) [0|15] "" BODY_CONTROL_MODULE
 SG_ ChecksumOk : 31|1@1+ (1,0) [0|1] "" BODY_CONTROL_MODULE
 SG_ PayloadLength : 32|8@1+ (1,0) [0|64] "byte" BODY_CONTROL_MODULE
 SG_ ErrorCode : 40|8@1+ (1,0) [0|255] "" BODY_CONTROL_MODULE
 SG_ ProcessingTimeUs : 48|16@1+ (1,0) [0|65535] "us" BODY_CONTROL_MODULE
 SG_ ResponseSequence : 64|16@1+ (1,0) [0|65535] "" BODY_CONTROL_MODULE
 SG_ ReceivedCrc : 80|8@1+ (1,0) [0|255] "" BODY_CONTROL_MODULE
 SG_ CalculatedCrc : 88|8@1+ (1,0) [0|255] "" BODY_CONTROL_MODULE

CM_ BO_ 1545 "Cycle=50ms; Channel=CAN0; CAN-FD; NominalBitrate=500kbit/s; DataBitrate=2000kbit/s;  ResponseFor=0x189; ACK/NACK with CRC, DLC and counter check;";

BO_ 394 DATA_010_BODY_CONTROL_MODULE_BODY_STATE_TO_DIAG_TESTER: 64 BODY_CONTROL_MODULE
 SG_ CRC8 : 0|8@1+ (1,0) [0|255] "" DIAG_TESTER
 SG_ AliveCounter : 8|4@1+ (1,0) [0|15] "" DIAG_TESTER
 SG_ MuxState : 12|4@1+ (1,0) [0|15] "" DIAG_TESTER
 SG_ SIG_18A_00 : 16|12@1+ (0.1,0.0) [0|4095] "rpm" DIAG_TESTER
 SG_ SIG_18A_01 : 28|12@1+ (0.1,0.0) [0|4095] "%" DIAG_TESTER
 SG_ SIG_18A_02 : 40|12@1+ (0.1,0.0) [0|4095] "%" DIAG_TESTER
 SG_ SIG_18A_03 : 52|12@1+ (0.1,0.0) [0|4095] "obj" DIAG_TESTER
 SG_ SIG_18A_04 : 64|12@1+ (0.1,0.0) [0|4095] "C" DIAG_TESTER
 SG_ SIG_18A_05 : 76|12@1+ (0.1,0.0) [0|4095] "m" DIAG_TESTER
 SG_ SIG_18A_06 : 88|12@1+ (0.1,0.0) [0|4095] "V" DIAG_TESTER
 SG_ SIG_18A_07 : 100|12@1+ (0.1,0.0) [0|4095] "m" DIAG_TESTER
 SG_ SIG_18A_08 : 112|12@1+ (0.1,0.0) [0|4095] "km/h" DIAG_TESTER
 SG_ SIG_18A_09 : 124|12@1+ (0.1,0.0) [0|4095] "rpm" DIAG_TESTER
 SG_ SIG_18A_10 : 136|12@1+ (0.1,0.0) [0|4095] "m" DIAG_TESTER
 SG_ SIG_18A_11 : 148|12@1+ (0.1,0.0) [0|4095] "V" DIAG_TESTER
 SG_ RouteInfoChar_00 : 160|8@1+ (1,0) [0|255] "ascii" DIAG_TESTER
 SG_ RouteInfoChar_01 : 168|8@1+ (1,0) [0|255] "ascii" DIAG_TESTER
 SG_ RouteInfoChar_02 : 176|8@1+ (1,0) [0|255] "ascii" DIAG_TESTER
 SG_ RouteInfoChar_03 : 184|8@1+ (1,0) [0|255] "ascii" DIAG_TESTER
 SG_ RouteInfoChar_04 : 192|8@1+ (1,0) [0|255] "ascii" DIAG_TESTER
 SG_ RouteInfoChar_05 : 200|8@1+ (1,0) [0|255] "ascii" DIAG_TESTER
 SG_ RouteInfoChar_06 : 208|8@1+ (1,0) [0|255] "ascii" DIAG_TESTER
 SG_ RouteInfoChar_07 : 216|8@1+ (1,0) [0|255] "ascii" DIAG_TESTER
 SG_ RouteInfoChar_08 : 224|8@1+ (1,0) [0|255] "ascii" DIAG_TESTER
 SG_ RouteInfoChar_09 : 232|8@1+ (1,0) [0|255] "ascii" DIAG_TESTER
 SG_ RouteInfoChar_10 : 240|8@1+ (1,0) [0|255] "ascii" DIAG_TESTER
 SG_ RouteInfoChar_11 : 248|8@1+ (1,0) [0|255] "ascii" DIAG_TESTER
 SG_ RouteInfoChar_12 : 256|8@1+ (1,0) [0|255] "ascii" DIAG_TESTER
 SG_ RouteInfoChar_13 : 264|8@1+ (1,0) [0|255] "ascii" DIAG_TESTER
 SG_ RouteInfoChar_14 : 272|8@1+ (1,0) [0|255] "ascii" DIAG_TESTER
 SG_ RouteInfoChar_15 : 280|8@1+ (1,0) [0|255] "ascii" DIAG_TESTER
 SG_ RouteInfoChar_16 : 288|8@1+ (1,0) [0|255] "ascii" DIAG_TESTER
 SG_ RouteInfoChar_17 : 296|8@1+ (1,0) [0|255] "ascii" DIAG_TESTER
 SG_ RouteInfoChar_18 : 304|8@1+ (1,0) [0|255] "ascii" DIAG_TESTER
 SG_ RouteInfoChar_19 : 312|8@1+ (1,0) [0|255] "ascii" DIAG_TESTER
 SG_ RouteInfoChar_20 : 320|8@1+ (1,0) [0|255] "ascii" DIAG_TESTER
 SG_ RouteInfoChar_21 : 328|8@1+ (1,0) [0|255] "ascii" DIAG_TESTER
 SG_ RouteInfoChar_22 : 336|8@1+ (1,0) [0|255] "ascii" DIAG_TESTER
 SG_ RouteInfoChar_23 : 344|8@1+ (1,0) [0|255] "ascii" DIAG_TESTER
 SG_ RouteInfoChar_24 : 352|8@1+ (1,0) [0|255] "ascii" DIAG_TESTER
 SG_ RouteInfoChar_25 : 360|8@1+ (1,0) [0|255] "ascii" DIAG_TESTER
 SG_ RouteInfoChar_26 : 368|8@1+ (1,0) [0|255] "ascii" DIAG_TESTER
 SG_ RouteInfoChar_27 : 376|8@1+ (1,0) [0|255] "ascii" DIAG_TESTER
 SG_ RouteInfoChar_28 : 384|8@1+ (1,0) [0|255] "ascii" DIAG_TESTER
 SG_ RouteInfoChar_29 : 392|8@1+ (1,0) [0|255] "ascii" DIAG_TESTER
 SG_ RouteInfoChar_30 : 400|8@1+ (1,0) [0|255] "ascii" DIAG_TESTER
 SG_ RouteInfoChar_31 : 408|8@1+ (1,0) [0|255] "ascii" DIAG_TESTER
 SG_ RouteInfoChar_32 : 416|8@1+ (1,0) [0|255] "ascii" DIAG_TESTER
 SG_ RouteInfoChar_33 : 424|8@1+ (1,0) [0|255] "ascii" DIAG_TESTER
 SG_ RouteInfoChar_34 : 432|8@1+ (1,0) [0|255] "ascii" DIAG_TESTER
 SG_ RouteInfoChar_35 : 440|8@1+ (1,0) [0|255] "ascii" DIAG_TESTER
 SG_ RouteInfoChar_36 : 448|8@1+ (1,0) [0|255] "ascii" DIAG_TESTER
 SG_ RouteInfoChar_37 : 456|8@1+ (1,0) [0|255] "ascii" DIAG_TESTER
 SG_ RouteInfoChar_38 : 464|8@1+ (1,0) [0|255] "ascii" DIAG_TESTER
 SG_ RouteInfoChar_39 : 472|8@1+ (1,0) [0|255] "ascii" DIAG_TESTER
 SG_ RouteInfoChar_40 : 480|8@1+ (1,0) [0|255] "ascii" DIAG_TESTER
 SG_ RouteInfoChar_41 : 488|8@1+ (1,0) [0|255] "ascii" DIAG_TESTER
 SG_ RouteInfoChar_42 : 496|8@1+ (1,0) [0|255] "ascii" DIAG_TESTER
 SG_ RouteInfoChar_43 : 504|8@1+ (1,0) [0|255] "ascii" DIAG_TESTER

CM_ BO_ 394 "Cycle=50ms; Channel=CAN0; CAN-FD; NominalBitrate=500kbit/s; DataBitrate=2000kbit/s;  Data request; receiver answers with response frame; PayloadRouteInfo='BODY_CONTROL_MODULE -> DIAG_TESTER' in bytes 20-63; Gateway to CAN4";

BO_ 1546 RESP_010_DIAG_TESTER_TO_BODY_CONTROL_MODULE: 16 DIAG_TESTER
 SG_ CRC8 : 0|8@1+ (1,0) [0|255] "" BODY_CONTROL_MODULE
 SG_ ResponseCounter : 8|4@1+ (1,0) [0|15] "" BODY_CONTROL_MODULE
 SG_ AckState : 12|4@1+ (1,0) [0|15] "" BODY_CONTROL_MODULE
 SG_ ReceivedFrameId : 16|11@1+ (1,0) [0|2047] "" BODY_CONTROL_MODULE
 SG_ ReceivedCounter : 27|4@1+ (1,0) [0|15] "" BODY_CONTROL_MODULE
 SG_ ChecksumOk : 31|1@1+ (1,0) [0|1] "" BODY_CONTROL_MODULE
 SG_ PayloadLength : 32|8@1+ (1,0) [0|64] "byte" BODY_CONTROL_MODULE
 SG_ ErrorCode : 40|8@1+ (1,0) [0|255] "" BODY_CONTROL_MODULE
 SG_ ProcessingTimeUs : 48|16@1+ (1,0) [0|65535] "us" BODY_CONTROL_MODULE
 SG_ ResponseSequence : 64|16@1+ (1,0) [0|65535] "" BODY_CONTROL_MODULE
 SG_ ReceivedCrc : 80|8@1+ (1,0) [0|255] "" BODY_CONTROL_MODULE
 SG_ CalculatedCrc : 88|8@1+ (1,0) [0|255] "" BODY_CONTROL_MODULE

CM_ BO_ 1546 "Cycle=50ms; Channel=CAN0; CAN-FD; NominalBitrate=500kbit/s; DataBitrate=2000kbit/s;  ResponseFor=0x18A; ACK/NACK with CRC, DLC and counter check;";

BO_ 395 DATA_011_BODY_CONTROL_MODULE_LIGHT_COMMAND_TO_LIGHT_CONTROL_MODULE: 64 BODY_CONTROL_MODULE
 SG_ CRC8 : 0|8@1+ (1,0) [0|255] "" LIGHT_CONTROL_MODULE
 SG_ AliveCounter : 8|4@1+ (1,0) [0|15] "" LIGHT_CONTROL_MODULE
 SG_ MuxState : 12|4@1+ (1,0) [0|15] "" LIGHT_CONTROL_MODULE
 SG_ SIG_18B_00 : 16|12@1+ (0.1,0.0) [0|4095] "A" LIGHT_CONTROL_MODULE
 SG_ SIG_18B_01 : 28|12@1+ (0.1,0.0) [0|4095] "rpm" LIGHT_CONTROL_MODULE
 SG_ SIG_18B_02 : 40|12@1+ (0.1,0.0) [0|4095] "V" LIGHT_CONTROL_MODULE
 SG_ SIG_18B_03 : 52|12@1+ (0.1,0.0) [0|4095] "%" LIGHT_CONTROL_MODULE
 SG_ SIG_18B_04 : 64|12@1+ (0.1,0.0) [0|4095] "deg" LIGHT_CONTROL_MODULE
 SG_ SIG_18B_05 : 76|12@1+ (0.1,0.0) [0|4095] "C" LIGHT_CONTROL_MODULE
 SG_ SIG_18B_06 : 88|12@1+ (0.1,0.0) [0|4095] "km/h" LIGHT_CONTROL_MODULE
 SG_ SIG_18B_07 : 100|12@1+ (0.1,0.0) [0|4095] "V" LIGHT_CONTROL_MODULE
 SG_ SIG_18B_08 : 112|12@1+ (0.1,0.0) [0|4095] "m" LIGHT_CONTROL_MODULE
 SG_ SIG_18B_09 : 124|12@1+ (0.1,0.0) [0|4095] "deg" LIGHT_CONTROL_MODULE
 SG_ SIG_18B_10 : 136|12@1+ (0.1,0.0) [0|4095] "m" LIGHT_CONTROL_MODULE
 SG_ SIG_18B_11 : 148|12@1+ (0.1,0.0) [0|4095] "rpm" LIGHT_CONTROL_MODULE
 SG_ RouteInfoChar_00 : 160|8@1+ (1,0) [0|255] "ascii" LIGHT_CONTROL_MODULE
 SG_ RouteInfoChar_01 : 168|8@1+ (1,0) [0|255] "ascii" LIGHT_CONTROL_MODULE
 SG_ RouteInfoChar_02 : 176|8@1+ (1,0) [0|255] "ascii" LIGHT_CONTROL_MODULE
 SG_ RouteInfoChar_03 : 184|8@1+ (1,0) [0|255] "ascii" LIGHT_CONTROL_MODULE
 SG_ RouteInfoChar_04 : 192|8@1+ (1,0) [0|255] "ascii" LIGHT_CONTROL_MODULE
 SG_ RouteInfoChar_05 : 200|8@1+ (1,0) [0|255] "ascii" LIGHT_CONTROL_MODULE
 SG_ RouteInfoChar_06 : 208|8@1+ (1,0) [0|255] "ascii" LIGHT_CONTROL_MODULE
 SG_ RouteInfoChar_07 : 216|8@1+ (1,0) [0|255] "ascii" LIGHT_CONTROL_MODULE
 SG_ RouteInfoChar_08 : 224|8@1+ (1,0) [0|255] "ascii" LIGHT_CONTROL_MODULE
 SG_ RouteInfoChar_09 : 232|8@1+ (1,0) [0|255] "ascii" LIGHT_CONTROL_MODULE
 SG_ RouteInfoChar_10 : 240|8@1+ (1,0) [0|255] "ascii" LIGHT_CONTROL_MODULE
 SG_ RouteInfoChar_11 : 248|8@1+ (1,0) [0|255] "ascii" LIGHT_CONTROL_MODULE
 SG_ RouteInfoChar_12 : 256|8@1+ (1,0) [0|255] "ascii" LIGHT_CONTROL_MODULE
 SG_ RouteInfoChar_13 : 264|8@1+ (1,0) [0|255] "ascii" LIGHT_CONTROL_MODULE
 SG_ RouteInfoChar_14 : 272|8@1+ (1,0) [0|255] "ascii" LIGHT_CONTROL_MODULE
 SG_ RouteInfoChar_15 : 280|8@1+ (1,0) [0|255] "ascii" LIGHT_CONTROL_MODULE
 SG_ RouteInfoChar_16 : 288|8@1+ (1,0) [0|255] "ascii" LIGHT_CONTROL_MODULE
 SG_ RouteInfoChar_17 : 296|8@1+ (1,0) [0|255] "ascii" LIGHT_CONTROL_MODULE
 SG_ RouteInfoChar_18 : 304|8@1+ (1,0) [0|255] "ascii" LIGHT_CONTROL_MODULE
 SG_ RouteInfoChar_19 : 312|8@1+ (1,0) [0|255] "ascii" LIGHT_CONTROL_MODULE
 SG_ RouteInfoChar_20 : 320|8@1+ (1,0) [0|255] "ascii" LIGHT_CONTROL_MODULE
 SG_ RouteInfoChar_21 : 328|8@1+ (1,0) [0|255] "ascii" LIGHT_CONTROL_MODULE
 SG_ RouteInfoChar_22 : 336|8@1+ (1,0) [0|255] "ascii" LIGHT_CONTROL_MODULE
 SG_ RouteInfoChar_23 : 344|8@1+ (1,0) [0|255] "ascii" LIGHT_CONTROL_MODULE
 SG_ RouteInfoChar_24 : 352|8@1+ (1,0) [0|255] "ascii" LIGHT_CONTROL_MODULE
 SG_ RouteInfoChar_25 : 360|8@1+ (1,0) [0|255] "ascii" LIGHT_CONTROL_MODULE
 SG_ RouteInfoChar_26 : 368|8@1+ (1,0) [0|255] "ascii" LIGHT_CONTROL_MODULE
 SG_ RouteInfoChar_27 : 376|8@1+ (1,0) [0|255] "ascii" LIGHT_CONTROL_MODULE
 SG_ RouteInfoChar_28 : 384|8@1+ (1,0) [0|255] "ascii" LIGHT_CONTROL_MODULE
 SG_ RouteInfoChar_29 : 392|8@1+ (1,0) [0|255] "ascii" LIGHT_CONTROL_MODULE
 SG_ RouteInfoChar_30 : 400|8@1+ (1,0) [0|255] "ascii" LIGHT_CONTROL_MODULE
 SG_ RouteInfoChar_31 : 408|8@1+ (1,0) [0|255] "ascii" LIGHT_CONTROL_MODULE
 SG_ RouteInfoChar_32 : 416|8@1+ (1,0) [0|255] "ascii" LIGHT_CONTROL_MODULE
 SG_ RouteInfoChar_33 : 424|8@1+ (1,0) [0|255] "ascii" LIGHT_CONTROL_MODULE
 SG_ RouteInfoChar_34 : 432|8@1+ (1,0) [0|255] "ascii" LIGHT_CONTROL_MODULE
 SG_ RouteInfoChar_35 : 440|8@1+ (1,0) [0|255] "ascii" LIGHT_CONTROL_MODULE
 SG_ RouteInfoChar_36 : 448|8@1+ (1,0) [0|255] "ascii" LIGHT_CONTROL_MODULE
 SG_ RouteInfoChar_37 : 456|8@1+ (1,0) [0|255] "ascii" LIGHT_CONTROL_MODULE
 SG_ RouteInfoChar_38 : 464|8@1+ (1,0) [0|255] "ascii" LIGHT_CONTROL_MODULE
 SG_ RouteInfoChar_39 : 472|8@1+ (1,0) [0|255] "ascii" LIGHT_CONTROL_MODULE
 SG_ RouteInfoChar_40 : 480|8@1+ (1,0) [0|255] "ascii" LIGHT_CONTROL_MODULE
 SG_ RouteInfoChar_41 : 488|8@1+ (1,0) [0|255] "ascii" LIGHT_CONTROL_MODULE
 SG_ RouteInfoChar_42 : 496|8@1+ (1,0) [0|255] "ascii" LIGHT_CONTROL_MODULE
 SG_ RouteInfoChar_43 : 504|8@1+ (1,0) [0|255] "ascii" LIGHT_CONTROL_MODULE

CM_ BO_ 395 "Cycle=50ms; Channel=CAN0; CAN-FD; NominalBitrate=500kbit/s; DataBitrate=2000kbit/s;  Data request; receiver answers with response frame; PayloadRouteInfo='BODY_CONTROL_MODULE -> LIGHT_CONTROL_MODULE' in bytes 20-63; Gateway to CAN4";

BO_ 1547 RESP_011_LIGHT_CONTROL_MODULE_TO_BODY_CONTROL_MODULE: 16 LIGHT_CONTROL_MODULE
 SG_ CRC8 : 0|8@1+ (1,0) [0|255] "" BODY_CONTROL_MODULE
 SG_ ResponseCounter : 8|4@1+ (1,0) [0|15] "" BODY_CONTROL_MODULE
 SG_ AckState : 12|4@1+ (1,0) [0|15] "" BODY_CONTROL_MODULE
 SG_ ReceivedFrameId : 16|11@1+ (1,0) [0|2047] "" BODY_CONTROL_MODULE
 SG_ ReceivedCounter : 27|4@1+ (1,0) [0|15] "" BODY_CONTROL_MODULE
 SG_ ChecksumOk : 31|1@1+ (1,0) [0|1] "" BODY_CONTROL_MODULE
 SG_ PayloadLength : 32|8@1+ (1,0) [0|64] "byte" BODY_CONTROL_MODULE
 SG_ ErrorCode : 40|8@1+ (1,0) [0|255] "" BODY_CONTROL_MODULE
 SG_ ProcessingTimeUs : 48|16@1+ (1,0) [0|65535] "us" BODY_CONTROL_MODULE
 SG_ ResponseSequence : 64|16@1+ (1,0) [0|65535] "" BODY_CONTROL_MODULE
 SG_ ReceivedCrc : 80|8@1+ (1,0) [0|255] "" BODY_CONTROL_MODULE
 SG_ CalculatedCrc : 88|8@1+ (1,0) [0|255] "" BODY_CONTROL_MODULE

CM_ BO_ 1547 "Cycle=50ms; Channel=CAN0; CAN-FD; NominalBitrate=500kbit/s; DataBitrate=2000kbit/s;  ResponseFor=0x18B; ACK/NACK with CRC, DLC and counter check;";

BO_ 396 DATA_012_BODY_CONTROL_MODULE_LOCK_COMMAND_TO_KESSY_KEYLESS_ACCESS: 64 BODY_CONTROL_MODULE
 SG_ CRC8 : 0|8@1+ (1,0) [0|255] "" KESSY_KEYLESS_ACCESS
 SG_ AliveCounter : 8|4@1+ (1,0) [0|15] "" KESSY_KEYLESS_ACCESS
 SG_ MuxState : 12|4@1+ (1,0) [0|15] "" KESSY_KEYLESS_ACCESS
 SG_ SIG_18C_00 : 16|12@1+ (0.1,0.0) [0|4095] "V" KESSY_KEYLESS_ACCESS
 SG_ SIG_18C_01 : 28|12@1+ (0.1,0.0) [0|4095] "m" KESSY_KEYLESS_ACCESS
 SG_ SIG_18C_02 : 40|12@1+ (0.1,0.0) [0|4095] "obj" KESSY_KEYLESS_ACCESS
 SG_ SIG_18C_03 : 52|12@1+ (0.1,0.0) [0|4095] "Nm" KESSY_KEYLESS_ACCESS
 SG_ SIG_18C_04 : 64|12@1+ (0.1,0.0) [0|4095] "deg" KESSY_KEYLESS_ACCESS
 SG_ SIG_18C_05 : 76|12@1+ (0.1,0.0) [0|4095] "A" KESSY_KEYLESS_ACCESS
 SG_ SIG_18C_06 : 88|12@1+ (0.1,0.0) [0|4095] "deg" KESSY_KEYLESS_ACCESS
 SG_ SIG_18C_07 : 100|12@1+ (0.1,0.0) [0|4095] "m" KESSY_KEYLESS_ACCESS
 SG_ SIG_18C_08 : 112|12@1+ (0.1,0.0) [0|4095] "m" KESSY_KEYLESS_ACCESS
 SG_ SIG_18C_09 : 124|12@1+ (0.1,0.0) [0|4095] "km/h" KESSY_KEYLESS_ACCESS
 SG_ SIG_18C_10 : 136|12@1+ (0.1,0.0) [0|4095] "obj" KESSY_KEYLESS_ACCESS
 SG_ SIG_18C_11 : 148|12@1+ (0.1,0.0) [0|4095] "A" KESSY_KEYLESS_ACCESS
 SG_ RouteInfoChar_00 : 160|8@1+ (1,0) [0|255] "ascii" KESSY_KEYLESS_ACCESS
 SG_ RouteInfoChar_01 : 168|8@1+ (1,0) [0|255] "ascii" KESSY_KEYLESS_ACCESS
 SG_ RouteInfoChar_02 : 176|8@1+ (1,0) [0|255] "ascii" KESSY_KEYLESS_ACCESS
 SG_ RouteInfoChar_03 : 184|8@1+ (1,0) [0|255] "ascii" KESSY_KEYLESS_ACCESS
 SG_ RouteInfoChar_04 : 192|8@1+ (1,0) [0|255] "ascii" KESSY_KEYLESS_ACCESS
 SG_ RouteInfoChar_05 : 200|8@1+ (1,0) [0|255] "ascii" KESSY_KEYLESS_ACCESS
 SG_ RouteInfoChar_06 : 208|8@1+ (1,0) [0|255] "ascii" KESSY_KEYLESS_ACCESS
 SG_ RouteInfoChar_07 : 216|8@1+ (1,0) [0|255] "ascii" KESSY_KEYLESS_ACCESS
 SG_ RouteInfoChar_08 : 224|8@1+ (1,0) [0|255] "ascii" KESSY_KEYLESS_ACCESS
 SG_ RouteInfoChar_09 : 232|8@1+ (1,0) [0|255] "ascii" KESSY_KEYLESS_ACCESS
 SG_ RouteInfoChar_10 : 240|8@1+ (1,0) [0|255] "ascii" KESSY_KEYLESS_ACCESS
 SG_ RouteInfoChar_11 : 248|8@1+ (1,0) [0|255] "ascii" KESSY_KEYLESS_ACCESS
 SG_ RouteInfoChar_12 : 256|8@1+ (1,0) [0|255] "ascii" KESSY_KEYLESS_ACCESS
 SG_ RouteInfoChar_13 : 264|8@1+ (1,0) [0|255] "ascii" KESSY_KEYLESS_ACCESS
 SG_ RouteInfoChar_14 : 272|8@1+ (1,0) [0|255] "ascii" KESSY_KEYLESS_ACCESS
 SG_ RouteInfoChar_15 : 280|8@1+ (1,0) [0|255] "ascii" KESSY_KEYLESS_ACCESS
 SG_ RouteInfoChar_16 : 288|8@1+ (1,0) [0|255] "ascii" KESSY_KEYLESS_ACCESS
 SG_ RouteInfoChar_17 : 296|8@1+ (1,0) [0|255] "ascii" KESSY_KEYLESS_ACCESS
 SG_ RouteInfoChar_18 : 304|8@1+ (1,0) [0|255] "ascii" KESSY_KEYLESS_ACCESS
 SG_ RouteInfoChar_19 : 312|8@1+ (1,0) [0|255] "ascii" KESSY_KEYLESS_ACCESS
 SG_ RouteInfoChar_20 : 320|8@1+ (1,0) [0|255] "ascii" KESSY_KEYLESS_ACCESS
 SG_ RouteInfoChar_21 : 328|8@1+ (1,0) [0|255] "ascii" KESSY_KEYLESS_ACCESS
 SG_ RouteInfoChar_22 : 336|8@1+ (1,0) [0|255] "ascii" KESSY_KEYLESS_ACCESS
 SG_ RouteInfoChar_23 : 344|8@1+ (1,0) [0|255] "ascii" KESSY_KEYLESS_ACCESS
 SG_ RouteInfoChar_24 : 352|8@1+ (1,0) [0|255] "ascii" KESSY_KEYLESS_ACCESS
 SG_ RouteInfoChar_25 : 360|8@1+ (1,0) [0|255] "ascii" KESSY_KEYLESS_ACCESS
 SG_ RouteInfoChar_26 : 368|8@1+ (1,0) [0|255] "ascii" KESSY_KEYLESS_ACCESS
 SG_ RouteInfoChar_27 : 376|8@1+ (1,0) [0|255] "ascii" KESSY_KEYLESS_ACCESS
 SG_ RouteInfoChar_28 : 384|8@1+ (1,0) [0|255] "ascii" KESSY_KEYLESS_ACCESS
 SG_ RouteInfoChar_29 : 392|8@1+ (1,0) [0|255] "ascii" KESSY_KEYLESS_ACCESS
 SG_ RouteInfoChar_30 : 400|8@1+ (1,0) [0|255] "ascii" KESSY_KEYLESS_ACCESS
 SG_ RouteInfoChar_31 : 408|8@1+ (1,0) [0|255] "ascii" KESSY_KEYLESS_ACCESS
 SG_ RouteInfoChar_32 : 416|8@1+ (1,0) [0|255] "ascii" KESSY_KEYLESS_ACCESS
 SG_ RouteInfoChar_33 : 424|8@1+ (1,0) [0|255] "ascii" KESSY_KEYLESS_ACCESS
 SG_ RouteInfoChar_34 : 432|8@1+ (1,0) [0|255] "ascii" KESSY_KEYLESS_ACCESS
 SG_ RouteInfoChar_35 : 440|8@1+ (1,0) [0|255] "ascii" KESSY_KEYLESS_ACCESS
 SG_ RouteInfoChar_36 : 448|8@1+ (1,0) [0|255] "ascii" KESSY_KEYLESS_ACCESS
 SG_ RouteInfoChar_37 : 456|8@1+ (1,0) [0|255] "ascii" KESSY_KEYLESS_ACCESS
 SG_ RouteInfoChar_38 : 464|8@1+ (1,0) [0|255] "ascii" KESSY_KEYLESS_ACCESS
 SG_ RouteInfoChar_39 : 472|8@1+ (1,0) [0|255] "ascii" KESSY_KEYLESS_ACCESS
 SG_ RouteInfoChar_40 : 480|8@1+ (1,0) [0|255] "ascii" KESSY_KEYLESS_ACCESS
 SG_ RouteInfoChar_41 : 488|8@1+ (1,0) [0|255] "ascii" KESSY_KEYLESS_ACCESS
 SG_ RouteInfoChar_42 : 496|8@1+ (1,0) [0|255] "ascii" KESSY_KEYLESS_ACCESS
 SG_ RouteInfoChar_43 : 504|8@1+ (1,0) [0|255] "ascii" KESSY_KEYLESS_ACCESS

CM_ BO_ 396 "Cycle=50ms; Channel=CAN0; CAN-FD; NominalBitrate=500kbit/s; DataBitrate=2000kbit/s;  Data request; receiver answers with response frame; PayloadRouteInfo='BODY_CONTROL_MODULE -> KESSY_KEYLESS_ACCESS' in bytes 20-63; Gateway to CAN4";

BO_ 1548 RESP_012_KESSY_KEYLESS_ACCESS_TO_BODY_CONTROL_MODULE: 16 KESSY_KEYLESS_ACCESS
 SG_ CRC8 : 0|8@1+ (1,0) [0|255] "" BODY_CONTROL_MODULE
 SG_ ResponseCounter : 8|4@1+ (1,0) [0|15] "" BODY_CONTROL_MODULE
 SG_ AckState : 12|4@1+ (1,0) [0|15] "" BODY_CONTROL_MODULE
 SG_ ReceivedFrameId : 16|11@1+ (1,0) [0|2047] "" BODY_CONTROL_MODULE
 SG_ ReceivedCounter : 27|4@1+ (1,0) [0|15] "" BODY_CONTROL_MODULE
 SG_ ChecksumOk : 31|1@1+ (1,0) [0|1] "" BODY_CONTROL_MODULE
 SG_ PayloadLength : 32|8@1+ (1,0) [0|64] "byte" BODY_CONTROL_MODULE
 SG_ ErrorCode : 40|8@1+ (1,0) [0|255] "" BODY_CONTROL_MODULE
 SG_ ProcessingTimeUs : 48|16@1+ (1,0) [0|65535] "us" BODY_CONTROL_MODULE
 SG_ ResponseSequence : 64|16@1+ (1,0) [0|65535] "" BODY_CONTROL_MODULE
 SG_ ReceivedCrc : 80|8@1+ (1,0) [0|255] "" BODY_CONTROL_MODULE
 SG_ CalculatedCrc : 88|8@1+ (1,0) [0|255] "" BODY_CONTROL_MODULE

CM_ BO_ 1548 "Cycle=50ms; Channel=CAN0; CAN-FD; NominalBitrate=500kbit/s; DataBitrate=2000kbit/s;  ResponseFor=0x18C; ACK/NACK with CRC, DLC and counter check;";

BO_ 397 DATA_013_BODY_CONTROL_MODULE_LOCK_COMMAND_TO_DOOR_MODULE_FL: 64 BODY_CONTROL_MODULE
 SG_ CRC8 : 0|8@1+ (1,0) [0|255] "" DOOR_MODULE_FL
 SG_ AliveCounter : 8|4@1+ (1,0) [0|15] "" DOOR_MODULE_FL
 SG_ MuxState : 12|4@1+ (1,0) [0|15] "" DOOR_MODULE_FL
 SG_ SIG_18D_00 : 16|12@1+ (0.1,0.0) [0|4095] "C" DOOR_MODULE_FL
 SG_ SIG_18D_01 : 28|12@1+ (0.1,0.0) [0|4095] "km/h" DOOR_MODULE_FL
 SG_ SIG_18D_02 : 40|12@1+ (0.1,0.0) [0|4095] "rpm" DOOR_MODULE_FL
 SG_ SIG_18D_03 : 52|12@1+ (0.1,0.0) [0|4095] "A" DOOR_MODULE_FL
 SG_ SIG_18D_04 : 64|12@1+ (0.1,0.0) [0|4095] "V" DOOR_MODULE_FL
 SG_ SIG_18D_05 : 76|12@1+ (0.1,0.0) [0|4095] "Nm" DOOR_MODULE_FL
 SG_ SIG_18D_06 : 88|12@1+ (0.1,0.0) [0|4095] "km/h" DOOR_MODULE_FL
 SG_ SIG_18D_07 : 100|12@1+ (0.1,0.0) [0|4095] "Nm" DOOR_MODULE_FL
 SG_ SIG_18D_08 : 112|12@1+ (0.1,0.0) [0|4095] "obj" DOOR_MODULE_FL
 SG_ SIG_18D_09 : 124|12@1+ (0.1,0.0) [0|4095] "rpm" DOOR_MODULE_FL
 SG_ SIG_18D_10 : 136|12@1+ (0.1,0.0) [0|4095] "rpm" DOOR_MODULE_FL
 SG_ SIG_18D_11 : 148|12@1+ (0.1,0.0) [0|4095] "C" DOOR_MODULE_FL
 SG_ RouteInfoChar_00 : 160|8@1+ (1,0) [0|255] "ascii" DOOR_MODULE_FL
 SG_ RouteInfoChar_01 : 168|8@1+ (1,0) [0|255] "ascii" DOOR_MODULE_FL
 SG_ RouteInfoChar_02 : 176|8@1+ (1,0) [0|255] "ascii" DOOR_MODULE_FL
 SG_ RouteInfoChar_03 : 184|8@1+ (1,0) [0|255] "ascii" DOOR_MODULE_FL
 SG_ RouteInfoChar_04 : 192|8@1+ (1,0) [0|255] "ascii" DOOR_MODULE_FL
 SG_ RouteInfoChar_05 : 200|8@1+ (1,0) [0|255] "ascii" DOOR_MODULE_FL
 SG_ RouteInfoChar_06 : 208|8@1+ (1,0) [0|255] "ascii" DOOR_MODULE_FL
 SG_ RouteInfoChar_07 : 216|8@1+ (1,0) [0|255] "ascii" DOOR_MODULE_FL
 SG_ RouteInfoChar_08 : 224|8@1+ (1,0) [0|255] "ascii" DOOR_MODULE_FL
 SG_ RouteInfoChar_09 : 232|8@1+ (1,0) [0|255] "ascii" DOOR_MODULE_FL
 SG_ RouteInfoChar_10 : 240|8@1+ (1,0) [0|255] "ascii" DOOR_MODULE_FL
 SG_ RouteInfoChar_11 : 248|8@1+ (1,0) [0|255] "ascii" DOOR_MODULE_FL
 SG_ RouteInfoChar_12 : 256|8@1+ (1,0) [0|255] "ascii" DOOR_MODULE_FL
 SG_ RouteInfoChar_13 : 264|8@1+ (1,0) [0|255] "ascii" DOOR_MODULE_FL
 SG_ RouteInfoChar_14 : 272|8@1+ (1,0) [0|255] "ascii" DOOR_MODULE_FL
 SG_ RouteInfoChar_15 : 280|8@1+ (1,0) [0|255] "ascii" DOOR_MODULE_FL
 SG_ RouteInfoChar_16 : 288|8@1+ (1,0) [0|255] "ascii" DOOR_MODULE_FL
 SG_ RouteInfoChar_17 : 296|8@1+ (1,0) [0|255] "ascii" DOOR_MODULE_FL
 SG_ RouteInfoChar_18 : 304|8@1+ (1,0) [0|255] "ascii" DOOR_MODULE_FL
 SG_ RouteInfoChar_19 : 312|8@1+ (1,0) [0|255] "ascii" DOOR_MODULE_FL
 SG_ RouteInfoChar_20 : 320|8@1+ (1,0) [0|255] "ascii" DOOR_MODULE_FL
 SG_ RouteInfoChar_21 : 328|8@1+ (1,0) [0|255] "ascii" DOOR_MODULE_FL
 SG_ RouteInfoChar_22 : 336|8@1+ (1,0) [0|255] "ascii" DOOR_MODULE_FL
 SG_ RouteInfoChar_23 : 344|8@1+ (1,0) [0|255] "ascii" DOOR_MODULE_FL
 SG_ RouteInfoChar_24 : 352|8@1+ (1,0) [0|255] "ascii" DOOR_MODULE_FL
 SG_ RouteInfoChar_25 : 360|8@1+ (1,0) [0|255] "ascii" DOOR_MODULE_FL
 SG_ RouteInfoChar_26 : 368|8@1+ (1,0) [0|255] "ascii" DOOR_MODULE_FL
 SG_ RouteInfoChar_27 : 376|8@1+ (1,0) [0|255] "ascii" DOOR_MODULE_FL
 SG_ RouteInfoChar_28 : 384|8@1+ (1,0) [0|255] "ascii" DOOR_MODULE_FL
 SG_ RouteInfoChar_29 : 392|8@1+ (1,0) [0|255] "ascii" DOOR_MODULE_FL
 SG_ RouteInfoChar_30 : 400|8@1+ (1,0) [0|255] "ascii" DOOR_MODULE_FL
 SG_ RouteInfoChar_31 : 408|8@1+ (1,0) [0|255] "ascii" DOOR_MODULE_FL
 SG_ RouteInfoChar_32 : 416|8@1+ (1,0) [0|255] "ascii" DOOR_MODULE_FL
 SG_ RouteInfoChar_33 : 424|8@1+ (1,0) [0|255] "ascii" DOOR_MODULE_FL
 SG_ RouteInfoChar_34 : 432|8@1+ (1,0) [0|255] "ascii" DOOR_MODULE_FL
 SG_ RouteInfoChar_35 : 440|8@1+ (1,0) [0|255] "ascii" DOOR_MODULE_FL
 SG_ RouteInfoChar_36 : 448|8@1+ (1,0) [0|255] "ascii" DOOR_MODULE_FL
 SG_ RouteInfoChar_37 : 456|8@1+ (1,0) [0|255] "ascii" DOOR_MODULE_FL
 SG_ RouteInfoChar_38 : 464|8@1+ (1,0) [0|255] "ascii" DOOR_MODULE_FL
 SG_ RouteInfoChar_39 : 472|8@1+ (1,0) [0|255] "ascii" DOOR_MODULE_FL
 SG_ RouteInfoChar_40 : 480|8@1+ (1,0) [0|255] "ascii" DOOR_MODULE_FL
 SG_ RouteInfoChar_41 : 488|8@1+ (1,0) [0|255] "ascii" DOOR_MODULE_FL
 SG_ RouteInfoChar_42 : 496|8@1+ (1,0) [0|255] "ascii" DOOR_MODULE_FL
 SG_ RouteInfoChar_43 : 504|8@1+ (1,0) [0|255] "ascii" DOOR_MODULE_FL

CM_ BO_ 397 "Cycle=50ms; Channel=CAN0; CAN-FD; NominalBitrate=500kbit/s; DataBitrate=2000kbit/s;  Data request; receiver answers with response frame; PayloadRouteInfo='BODY_CONTROL_MODULE -> DOOR_MODULE_FL' in bytes 20-63; Gateway to CAN4";

BO_ 1549 RESP_013_DOOR_MODULE_FL_TO_BODY_CONTROL_MODULE: 16 DOOR_MODULE_FL
 SG_ CRC8 : 0|8@1+ (1,0) [0|255] "" BODY_CONTROL_MODULE
 SG_ ResponseCounter : 8|4@1+ (1,0) [0|15] "" BODY_CONTROL_MODULE
 SG_ AckState : 12|4@1+ (1,0) [0|15] "" BODY_CONTROL_MODULE
 SG_ ReceivedFrameId : 16|11@1+ (1,0) [0|2047] "" BODY_CONTROL_MODULE
 SG_ ReceivedCounter : 27|4@1+ (1,0) [0|15] "" BODY_CONTROL_MODULE
 SG_ ChecksumOk : 31|1@1+ (1,0) [0|1] "" BODY_CONTROL_MODULE
 SG_ PayloadLength : 32|8@1+ (1,0) [0|64] "byte" BODY_CONTROL_MODULE
 SG_ ErrorCode : 40|8@1+ (1,0) [0|255] "" BODY_CONTROL_MODULE
 SG_ ProcessingTimeUs : 48|16@1+ (1,0) [0|65535] "us" BODY_CONTROL_MODULE
 SG_ ResponseSequence : 64|16@1+ (1,0) [0|65535] "" BODY_CONTROL_MODULE
 SG_ ReceivedCrc : 80|8@1+ (1,0) [0|255] "" BODY_CONTROL_MODULE
 SG_ CalculatedCrc : 88|8@1+ (1,0) [0|255] "" BODY_CONTROL_MODULE

CM_ BO_ 1549 "Cycle=50ms; Channel=CAN0; CAN-FD; NominalBitrate=500kbit/s; DataBitrate=2000kbit/s;  ResponseFor=0x18D; ACK/NACK with CRC, DLC and counter check;";

BO_ 398 DATA_014_BODY_CONTROL_MODULE_LOCK_COMMAND_TO_DOOR_MODULE_FR: 64 BODY_CONTROL_MODULE
 SG_ CRC8 : 0|8@1+ (1,0) [0|255] "" DOOR_MODULE_FR
 SG_ AliveCounter : 8|4@1+ (1,0) [0|15] "" DOOR_MODULE_FR
 SG_ MuxState : 12|4@1+ (1,0) [0|15] "" DOOR_MODULE_FR
 SG_ SIG_18E_00 : 16|12@1+ (0.1,0.0) [0|4095] "rpm" DOOR_MODULE_FR
 SG_ SIG_18E_01 : 28|12@1+ (0.1,0.0) [0|4095] "m" DOOR_MODULE_FR
 SG_ SIG_18E_02 : 40|12@1+ (0.1,0.0) [0|4095] "deg" DOOR_MODULE_FR
 SG_ SIG_18E_03 : 52|12@1+ (0.1,0.0) [0|4095] "deg" DOOR_MODULE_FR
 SG_ SIG_18E_04 : 64|12@1+ (0.1,0.0) [0|4095] "C" DOOR_MODULE_FR
 SG_ SIG_18E_05 : 76|12@1+ (0.1,0.0) [0|4095] "m" DOOR_MODULE_FR
 SG_ SIG_18E_06 : 88|12@1+ (0.1,0.0) [0|4095] "deg" DOOR_MODULE_FR
 SG_ SIG_18E_07 : 100|12@1+ (0.1,0.0) [0|4095] "V" DOOR_MODULE_FR
 SG_ SIG_18E_08 : 112|12@1+ (0.1,0.0) [0|4095] "m" DOOR_MODULE_FR
 SG_ SIG_18E_09 : 124|12@1+ (0.1,0.0) [0|4095] "obj" DOOR_MODULE_FR
 SG_ SIG_18E_10 : 136|12@1+ (0.1,0.0) [0|4095] "%" DOOR_MODULE_FR
 SG_ SIG_18E_11 : 148|12@1+ (0.1,0.0) [0|4095] "Nm" DOOR_MODULE_FR
 SG_ RouteInfoChar_00 : 160|8@1+ (1,0) [0|255] "ascii" DOOR_MODULE_FR
 SG_ RouteInfoChar_01 : 168|8@1+ (1,0) [0|255] "ascii" DOOR_MODULE_FR
 SG_ RouteInfoChar_02 : 176|8@1+ (1,0) [0|255] "ascii" DOOR_MODULE_FR
 SG_ RouteInfoChar_03 : 184|8@1+ (1,0) [0|255] "ascii" DOOR_MODULE_FR
 SG_ RouteInfoChar_04 : 192|8@1+ (1,0) [0|255] "ascii" DOOR_MODULE_FR
 SG_ RouteInfoChar_05 : 200|8@1+ (1,0) [0|255] "ascii" DOOR_MODULE_FR
 SG_ RouteInfoChar_06 : 208|8@1+ (1,0) [0|255] "ascii" DOOR_MODULE_FR
 SG_ RouteInfoChar_07 : 216|8@1+ (1,0) [0|255] "ascii" DOOR_MODULE_FR
 SG_ RouteInfoChar_08 : 224|8@1+ (1,0) [0|255] "ascii" DOOR_MODULE_FR
 SG_ RouteInfoChar_09 : 232|8@1+ (1,0) [0|255] "ascii" DOOR_MODULE_FR
 SG_ RouteInfoChar_10 : 240|8@1+ (1,0) [0|255] "ascii" DOOR_MODULE_FR
 SG_ RouteInfoChar_11 : 248|8@1+ (1,0) [0|255] "ascii" DOOR_MODULE_FR
 SG_ RouteInfoChar_12 : 256|8@1+ (1,0) [0|255] "ascii" DOOR_MODULE_FR
 SG_ RouteInfoChar_13 : 264|8@1+ (1,0) [0|255] "ascii" DOOR_MODULE_FR
 SG_ RouteInfoChar_14 : 272|8@1+ (1,0) [0|255] "ascii" DOOR_MODULE_FR
 SG_ RouteInfoChar_15 : 280|8@1+ (1,0) [0|255] "ascii" DOOR_MODULE_FR
 SG_ RouteInfoChar_16 : 288|8@1+ (1,0) [0|255] "ascii" DOOR_MODULE_FR
 SG_ RouteInfoChar_17 : 296|8@1+ (1,0) [0|255] "ascii" DOOR_MODULE_FR
 SG_ RouteInfoChar_18 : 304|8@1+ (1,0) [0|255] "ascii" DOOR_MODULE_FR
 SG_ RouteInfoChar_19 : 312|8@1+ (1,0) [0|255] "ascii" DOOR_MODULE_FR
 SG_ RouteInfoChar_20 : 320|8@1+ (1,0) [0|255] "ascii" DOOR_MODULE_FR
 SG_ RouteInfoChar_21 : 328|8@1+ (1,0) [0|255] "ascii" DOOR_MODULE_FR
 SG_ RouteInfoChar_22 : 336|8@1+ (1,0) [0|255] "ascii" DOOR_MODULE_FR
 SG_ RouteInfoChar_23 : 344|8@1+ (1,0) [0|255] "ascii" DOOR_MODULE_FR
 SG_ RouteInfoChar_24 : 352|8@1+ (1,0) [0|255] "ascii" DOOR_MODULE_FR
 SG_ RouteInfoChar_25 : 360|8@1+ (1,0) [0|255] "ascii" DOOR_MODULE_FR
 SG_ RouteInfoChar_26 : 368|8@1+ (1,0) [0|255] "ascii" DOOR_MODULE_FR
 SG_ RouteInfoChar_27 : 376|8@1+ (1,0) [0|255] "ascii" DOOR_MODULE_FR
 SG_ RouteInfoChar_28 : 384|8@1+ (1,0) [0|255] "ascii" DOOR_MODULE_FR
 SG_ RouteInfoChar_29 : 392|8@1+ (1,0) [0|255] "ascii" DOOR_MODULE_FR
 SG_ RouteInfoChar_30 : 400|8@1+ (1,0) [0|255] "ascii" DOOR_MODULE_FR
 SG_ RouteInfoChar_31 : 408|8@1+ (1,0) [0|255] "ascii" DOOR_MODULE_FR
 SG_ RouteInfoChar_32 : 416|8@1+ (1,0) [0|255] "ascii" DOOR_MODULE_FR
 SG_ RouteInfoChar_33 : 424|8@1+ (1,0) [0|255] "ascii" DOOR_MODULE_FR
 SG_ RouteInfoChar_34 : 432|8@1+ (1,0) [0|255] "ascii" DOOR_MODULE_FR
 SG_ RouteInfoChar_35 : 440|8@1+ (1,0) [0|255] "ascii" DOOR_MODULE_FR
 SG_ RouteInfoChar_36 : 448|8@1+ (1,0) [0|255] "ascii" DOOR_MODULE_FR
 SG_ RouteInfoChar_37 : 456|8@1+ (1,0) [0|255] "ascii" DOOR_MODULE_FR
 SG_ RouteInfoChar_38 : 464|8@1+ (1,0) [0|255] "ascii" DOOR_MODULE_FR
 SG_ RouteInfoChar_39 : 472|8@1+ (1,0) [0|255] "ascii" DOOR_MODULE_FR
 SG_ RouteInfoChar_40 : 480|8@1+ (1,0) [0|255] "ascii" DOOR_MODULE_FR
 SG_ RouteInfoChar_41 : 488|8@1+ (1,0) [0|255] "ascii" DOOR_MODULE_FR
 SG_ RouteInfoChar_42 : 496|8@1+ (1,0) [0|255] "ascii" DOOR_MODULE_FR
 SG_ RouteInfoChar_43 : 504|8@1+ (1,0) [0|255] "ascii" DOOR_MODULE_FR

CM_ BO_ 398 "Cycle=50ms; Channel=CAN0; CAN-FD; NominalBitrate=500kbit/s; DataBitrate=2000kbit/s;  Data request; receiver answers with response frame; PayloadRouteInfo='BODY_CONTROL_MODULE -> DOOR_MODULE_FR' in bytes 20-63; Gateway to CAN4";

BO_ 1550 RESP_014_DOOR_MODULE_FR_TO_BODY_CONTROL_MODULE: 16 DOOR_MODULE_FR
 SG_ CRC8 : 0|8@1+ (1,0) [0|255] "" BODY_CONTROL_MODULE
 SG_ ResponseCounter : 8|4@1+ (1,0) [0|15] "" BODY_CONTROL_MODULE
 SG_ AckState : 12|4@1+ (1,0) [0|15] "" BODY_CONTROL_MODULE
 SG_ ReceivedFrameId : 16|11@1+ (1,0) [0|2047] "" BODY_CONTROL_MODULE
 SG_ ReceivedCounter : 27|4@1+ (1,0) [0|15] "" BODY_CONTROL_MODULE
 SG_ ChecksumOk : 31|1@1+ (1,0) [0|1] "" BODY_CONTROL_MODULE
 SG_ PayloadLength : 32|8@1+ (1,0) [0|64] "byte" BODY_CONTROL_MODULE
 SG_ ErrorCode : 40|8@1+ (1,0) [0|255] "" BODY_CONTROL_MODULE
 SG_ ProcessingTimeUs : 48|16@1+ (1,0) [0|65535] "us" BODY_CONTROL_MODULE
 SG_ ResponseSequence : 64|16@1+ (1,0) [0|65535] "" BODY_CONTROL_MODULE
 SG_ ReceivedCrc : 80|8@1+ (1,0) [0|255] "" BODY_CONTROL_MODULE
 SG_ CalculatedCrc : 88|8@1+ (1,0) [0|255] "" BODY_CONTROL_MODULE

CM_ BO_ 1550 "Cycle=50ms; Channel=CAN0; CAN-FD; NominalBitrate=500kbit/s; DataBitrate=2000kbit/s;  ResponseFor=0x18E; ACK/NACK with CRC, DLC and counter check;";

BO_ 399 DATA_015_BODY_CONTROL_MODULE_LOCK_COMMAND_TO_DOOR_MODULE_RL: 64 BODY_CONTROL_MODULE
 SG_ CRC8 : 0|8@1+ (1,0) [0|255] "" DOOR_MODULE_RL
 SG_ AliveCounter : 8|4@1+ (1,0) [0|15] "" DOOR_MODULE_RL
 SG_ MuxState : 12|4@1+ (1,0) [0|15] "" DOOR_MODULE_RL
 SG_ SIG_18F_00 : 16|12@1+ (0.1,0.0) [0|4095] "m" DOOR_MODULE_RL
 SG_ SIG_18F_01 : 28|12@1+ (0.1,0.0) [0|4095] "Nm" DOOR_MODULE_RL
 SG_ SIG_18F_02 : 40|12@1+ (0.1,0.0) [0|4095] "V" DOOR_MODULE_RL
 SG_ SIG_18F_03 : 52|12@1+ (0.1,0.0) [0|4095] "%" DOOR_MODULE_RL
 SG_ SIG_18F_04 : 64|12@1+ (0.1,0.0) [0|4095] "A" DOOR_MODULE_RL
 SG_ SIG_18F_05 : 76|12@1+ (0.1,0.0) [0|4095] "C" DOOR_MODULE_RL
 SG_ SIG_18F_06 : 88|12@1+ (0.1,0.0) [0|4095] "m" DOOR_MODULE_RL
 SG_ SIG_18F_07 : 100|12@1+ (0.1,0.0) [0|4095] "C" DOOR_MODULE_RL
 SG_ SIG_18F_08 : 112|12@1+ (0.1,0.0) [0|4095] "rpm" DOOR_MODULE_RL
 SG_ SIG_18F_09 : 124|12@1+ (0.1,0.0) [0|4095] "Nm" DOOR_MODULE_RL
 SG_ SIG_18F_10 : 136|12@1+ (0.1,0.0) [0|4095] "Nm" DOOR_MODULE_RL
 SG_ SIG_18F_11 : 148|12@1+ (0.1,0.0) [0|4095] "rpm" DOOR_MODULE_RL
 SG_ RouteInfoChar_00 : 160|8@1+ (1,0) [0|255] "ascii" DOOR_MODULE_RL
 SG_ RouteInfoChar_01 : 168|8@1+ (1,0) [0|255] "ascii" DOOR_MODULE_RL
 SG_ RouteInfoChar_02 : 176|8@1+ (1,0) [0|255] "ascii" DOOR_MODULE_RL
 SG_ RouteInfoChar_03 : 184|8@1+ (1,0) [0|255] "ascii" DOOR_MODULE_RL
 SG_ RouteInfoChar_04 : 192|8@1+ (1,0) [0|255] "ascii" DOOR_MODULE_RL
 SG_ RouteInfoChar_05 : 200|8@1+ (1,0) [0|255] "ascii" DOOR_MODULE_RL
 SG_ RouteInfoChar_06 : 208|8@1+ (1,0) [0|255] "ascii" DOOR_MODULE_RL
 SG_ RouteInfoChar_07 : 216|8@1+ (1,0) [0|255] "ascii" DOOR_MODULE_RL
 SG_ RouteInfoChar_08 : 224|8@1+ (1,0) [0|255] "ascii" DOOR_MODULE_RL
 SG_ RouteInfoChar_09 : 232|8@1+ (1,0) [0|255] "ascii" DOOR_MODULE_RL
 SG_ RouteInfoChar_10 : 240|8@1+ (1,0) [0|255] "ascii" DOOR_MODULE_RL
 SG_ RouteInfoChar_11 : 248|8@1+ (1,0) [0|255] "ascii" DOOR_MODULE_RL
 SG_ RouteInfoChar_12 : 256|8@1+ (1,0) [0|255] "ascii" DOOR_MODULE_RL
 SG_ RouteInfoChar_13 : 264|8@1+ (1,0) [0|255] "ascii" DOOR_MODULE_RL
 SG_ RouteInfoChar_14 : 272|8@1+ (1,0) [0|255] "ascii" DOOR_MODULE_RL
 SG_ RouteInfoChar_15 : 280|8@1+ (1,0) [0|255] "ascii" DOOR_MODULE_RL
 SG_ RouteInfoChar_16 : 288|8@1+ (1,0) [0|255] "ascii" DOOR_MODULE_RL
 SG_ RouteInfoChar_17 : 296|8@1+ (1,0) [0|255] "ascii" DOOR_MODULE_RL
 SG_ RouteInfoChar_18 : 304|8@1+ (1,0) [0|255] "ascii" DOOR_MODULE_RL
 SG_ RouteInfoChar_19 : 312|8@1+ (1,0) [0|255] "ascii" DOOR_MODULE_RL
 SG_ RouteInfoChar_20 : 320|8@1+ (1,0) [0|255] "ascii" DOOR_MODULE_RL
 SG_ RouteInfoChar_21 : 328|8@1+ (1,0) [0|255] "ascii" DOOR_MODULE_RL
 SG_ RouteInfoChar_22 : 336|8@1+ (1,0) [0|255] "ascii" DOOR_MODULE_RL
 SG_ RouteInfoChar_23 : 344|8@1+ (1,0) [0|255] "ascii" DOOR_MODULE_RL
 SG_ RouteInfoChar_24 : 352|8@1+ (1,0) [0|255] "ascii" DOOR_MODULE_RL
 SG_ RouteInfoChar_25 : 360|8@1+ (1,0) [0|255] "ascii" DOOR_MODULE_RL
 SG_ RouteInfoChar_26 : 368|8@1+ (1,0) [0|255] "ascii" DOOR_MODULE_RL
 SG_ RouteInfoChar_27 : 376|8@1+ (1,0) [0|255] "ascii" DOOR_MODULE_RL
 SG_ RouteInfoChar_28 : 384|8@1+ (1,0) [0|255] "ascii" DOOR_MODULE_RL
 SG_ RouteInfoChar_29 : 392|8@1+ (1,0) [0|255] "ascii" DOOR_MODULE_RL
 SG_ RouteInfoChar_30 : 400|8@1+ (1,0) [0|255] "ascii" DOOR_MODULE_RL
 SG_ RouteInfoChar_31 : 408|8@1+ (1,0) [0|255] "ascii" DOOR_MODULE_RL
 SG_ RouteInfoChar_32 : 416|8@1+ (1,0) [0|255] "ascii" DOOR_MODULE_RL
 SG_ RouteInfoChar_33 : 424|8@1+ (1,0) [0|255] "ascii" DOOR_MODULE_RL
 SG_ RouteInfoChar_34 : 432|8@1+ (1,0) [0|255] "ascii" DOOR_MODULE_RL
 SG_ RouteInfoChar_35 : 440|8@1+ (1,0) [0|255] "ascii" DOOR_MODULE_RL
 SG_ RouteInfoChar_36 : 448|8@1+ (1,0) [0|255] "ascii" DOOR_MODULE_RL
 SG_ RouteInfoChar_37 : 456|8@1+ (1,0) [0|255] "ascii" DOOR_MODULE_RL
 SG_ RouteInfoChar_38 : 464|8@1+ (1,0) [0|255] "ascii" DOOR_MODULE_RL
 SG_ RouteInfoChar_39 : 472|8@1+ (1,0) [0|255] "ascii" DOOR_MODULE_RL
 SG_ RouteInfoChar_40 : 480|8@1+ (1,0) [0|255] "ascii" DOOR_MODULE_RL
 SG_ RouteInfoChar_41 : 488|8@1+ (1,0) [0|255] "ascii" DOOR_MODULE_RL
 SG_ RouteInfoChar_42 : 496|8@1+ (1,0) [0|255] "ascii" DOOR_MODULE_RL
 SG_ RouteInfoChar_43 : 504|8@1+ (1,0) [0|255] "ascii" DOOR_MODULE_RL

CM_ BO_ 399 "Cycle=50ms; Channel=CAN0; CAN-FD; NominalBitrate=500kbit/s; DataBitrate=2000kbit/s;  Data request; receiver answers with response frame; PayloadRouteInfo='BODY_CONTROL_MODULE -> DOOR_MODULE_RL' in bytes 20-63; Gateway to CAN4";

BO_ 1551 RESP_015_DOOR_MODULE_RL_TO_BODY_CONTROL_MODULE: 16 DOOR_MODULE_RL
 SG_ CRC8 : 0|8@1+ (1,0) [0|255] "" BODY_CONTROL_MODULE
 SG_ ResponseCounter : 8|4@1+ (1,0) [0|15] "" BODY_CONTROL_MODULE
 SG_ AckState : 12|4@1+ (1,0) [0|15] "" BODY_CONTROL_MODULE
 SG_ ReceivedFrameId : 16|11@1+ (1,0) [0|2047] "" BODY_CONTROL_MODULE
 SG_ ReceivedCounter : 27|4@1+ (1,0) [0|15] "" BODY_CONTROL_MODULE
 SG_ ChecksumOk : 31|1@1+ (1,0) [0|1] "" BODY_CONTROL_MODULE
 SG_ PayloadLength : 32|8@1+ (1,0) [0|64] "byte" BODY_CONTROL_MODULE
 SG_ ErrorCode : 40|8@1+ (1,0) [0|255] "" BODY_CONTROL_MODULE
 SG_ ProcessingTimeUs : 48|16@1+ (1,0) [0|65535] "us" BODY_CONTROL_MODULE
 SG_ ResponseSequence : 64|16@1+ (1,0) [0|65535] "" BODY_CONTROL_MODULE
 SG_ ReceivedCrc : 80|8@1+ (1,0) [0|255] "" BODY_CONTROL_MODULE
 SG_ CalculatedCrc : 88|8@1+ (1,0) [0|255] "" BODY_CONTROL_MODULE

CM_ BO_ 1551 "Cycle=50ms; Channel=CAN0; CAN-FD; NominalBitrate=500kbit/s; DataBitrate=2000kbit/s;  ResponseFor=0x18F; ACK/NACK with CRC, DLC and counter check;";

BO_ 400 DATA_016_BODY_CONTROL_MODULE_LOCK_COMMAND_TO_DOOR_MODULE_RR: 64 BODY_CONTROL_MODULE
 SG_ CRC8 : 0|8@1+ (1,0) [0|255] "" DOOR_MODULE_RR
 SG_ AliveCounter : 8|4@1+ (1,0) [0|15] "" DOOR_MODULE_RR
 SG_ MuxState : 12|4@1+ (1,0) [0|15] "" DOOR_MODULE_RR
 SG_ SIG_190_00 : 16|12@1+ (0.1,0.0) [0|4095] "A" DOOR_MODULE_RR
 SG_ SIG_190_01 : 28|12@1+ (0.1,0.0) [0|4095] "km/h" DOOR_MODULE_RR
 SG_ SIG_190_02 : 40|12@1+ (0.1,0.0) [0|4095] "obj" DOOR_MODULE_RR
 SG_ SIG_190_03 : 52|12@1+ (0.1,0.0) [0|4095] "m" DOOR_MODULE_RR
 SG_ SIG_190_04 : 64|12@1+ (0.1,0.0) [0|4095] "Nm" DOOR_MODULE_RR
 SG_ SIG_190_05 : 76|12@1+ (0.1,0.0) [0|4095] "obj" DOOR_MODULE_RR
 SG_ SIG_190_06 : 88|12@1+ (0.1,0.0) [0|4095] "Nm" DOOR_MODULE_RR
 SG_ SIG_190_07 : 100|12@1+ (0.1,0.0) [0|4095] "km/h" DOOR_MODULE_RR
 SG_ SIG_190_08 : 112|12@1+ (0.1,0.0) [0|4095] "rpm" DOOR_MODULE_RR
 SG_ SIG_190_09 : 124|12@1+ (0.1,0.0) [0|4095] "km/h" DOOR_MODULE_RR
 SG_ SIG_190_10 : 136|12@1+ (0.1,0.0) [0|4095] "Nm" DOOR_MODULE_RR
 SG_ SIG_190_11 : 148|12@1+ (0.1,0.0) [0|4095] "rpm" DOOR_MODULE_RR
 SG_ RouteInfoChar_00 : 160|8@1+ (1,0) [0|255] "ascii" DOOR_MODULE_RR
 SG_ RouteInfoChar_01 : 168|8@1+ (1,0) [0|255] "ascii" DOOR_MODULE_RR
 SG_ RouteInfoChar_02 : 176|8@1+ (1,0) [0|255] "ascii" DOOR_MODULE_RR
 SG_ RouteInfoChar_03 : 184|8@1+ (1,0) [0|255] "ascii" DOOR_MODULE_RR
 SG_ RouteInfoChar_04 : 192|8@1+ (1,0) [0|255] "ascii" DOOR_MODULE_RR
 SG_ RouteInfoChar_05 : 200|8@1+ (1,0) [0|255] "ascii" DOOR_MODULE_RR
 SG_ RouteInfoChar_06 : 208|8@1+ (1,0) [0|255] "ascii" DOOR_MODULE_RR
 SG_ RouteInfoChar_07 : 216|8@1+ (1,0) [0|255] "ascii" DOOR_MODULE_RR
 SG_ RouteInfoChar_08 : 224|8@1+ (1,0) [0|255] "ascii" DOOR_MODULE_RR
 SG_ RouteInfoChar_09 : 232|8@1+ (1,0) [0|255] "ascii" DOOR_MODULE_RR
 SG_ RouteInfoChar_10 : 240|8@1+ (1,0) [0|255] "ascii" DOOR_MODULE_RR
 SG_ RouteInfoChar_11 : 248|8@1+ (1,0) [0|255] "ascii" DOOR_MODULE_RR
 SG_ RouteInfoChar_12 : 256|8@1+ (1,0) [0|255] "ascii" DOOR_MODULE_RR
 SG_ RouteInfoChar_13 : 264|8@1+ (1,0) [0|255] "ascii" DOOR_MODULE_RR
 SG_ RouteInfoChar_14 : 272|8@1+ (1,0) [0|255] "ascii" DOOR_MODULE_RR
 SG_ RouteInfoChar_15 : 280|8@1+ (1,0) [0|255] "ascii" DOOR_MODULE_RR
 SG_ RouteInfoChar_16 : 288|8@1+ (1,0) [0|255] "ascii" DOOR_MODULE_RR
 SG_ RouteInfoChar_17 : 296|8@1+ (1,0) [0|255] "ascii" DOOR_MODULE_RR
 SG_ RouteInfoChar_18 : 304|8@1+ (1,0) [0|255] "ascii" DOOR_MODULE_RR
 SG_ RouteInfoChar_19 : 312|8@1+ (1,0) [0|255] "ascii" DOOR_MODULE_RR
 SG_ RouteInfoChar_20 : 320|8@1+ (1,0) [0|255] "ascii" DOOR_MODULE_RR
 SG_ RouteInfoChar_21 : 328|8@1+ (1,0) [0|255] "ascii" DOOR_MODULE_RR
 SG_ RouteInfoChar_22 : 336|8@1+ (1,0) [0|255] "ascii" DOOR_MODULE_RR
 SG_ RouteInfoChar_23 : 344|8@1+ (1,0) [0|255] "ascii" DOOR_MODULE_RR
 SG_ RouteInfoChar_24 : 352|8@1+ (1,0) [0|255] "ascii" DOOR_MODULE_RR
 SG_ RouteInfoChar_25 : 360|8@1+ (1,0) [0|255] "ascii" DOOR_MODULE_RR
 SG_ RouteInfoChar_26 : 368|8@1+ (1,0) [0|255] "ascii" DOOR_MODULE_RR
 SG_ RouteInfoChar_27 : 376|8@1+ (1,0) [0|255] "ascii" DOOR_MODULE_RR
 SG_ RouteInfoChar_28 : 384|8@1+ (1,0) [0|255] "ascii" DOOR_MODULE_RR
 SG_ RouteInfoChar_29 : 392|8@1+ (1,0) [0|255] "ascii" DOOR_MODULE_RR
 SG_ RouteInfoChar_30 : 400|8@1+ (1,0) [0|255] "ascii" DOOR_MODULE_RR
 SG_ RouteInfoChar_31 : 408|8@1+ (1,0) [0|255] "ascii" DOOR_MODULE_RR
 SG_ RouteInfoChar_32 : 416|8@1+ (1,0) [0|255] "ascii" DOOR_MODULE_RR
 SG_ RouteInfoChar_33 : 424|8@1+ (1,0) [0|255] "ascii" DOOR_MODULE_RR
 SG_ RouteInfoChar_34 : 432|8@1+ (1,0) [0|255] "ascii" DOOR_MODULE_RR
 SG_ RouteInfoChar_35 : 440|8@1+ (1,0) [0|255] "ascii" DOOR_MODULE_RR
 SG_ RouteInfoChar_36 : 448|8@1+ (1,0) [0|255] "ascii" DOOR_MODULE_RR
 SG_ RouteInfoChar_37 : 456|8@1+ (1,0) [0|255] "ascii" DOOR_MODULE_RR
 SG_ RouteInfoChar_38 : 464|8@1+ (1,0) [0|255] "ascii" DOOR_MODULE_RR
 SG_ RouteInfoChar_39 : 472|8@1+ (1,0) [0|255] "ascii" DOOR_MODULE_RR
 SG_ RouteInfoChar_40 : 480|8@1+ (1,0) [0|255] "ascii" DOOR_MODULE_RR
 SG_ RouteInfoChar_41 : 488|8@1+ (1,0) [0|255] "ascii" DOOR_MODULE_RR
 SG_ RouteInfoChar_42 : 496|8@1+ (1,0) [0|255] "ascii" DOOR_MODULE_RR
 SG_ RouteInfoChar_43 : 504|8@1+ (1,0) [0|255] "ascii" DOOR_MODULE_RR

CM_ BO_ 400 "Cycle=50ms; Channel=CAN0; CAN-FD; NominalBitrate=500kbit/s; DataBitrate=2000kbit/s;  Data request; receiver answers with response frame; PayloadRouteInfo='BODY_CONTROL_MODULE -> DOOR_MODULE_RR' in bytes 20-63; Gateway to CAN4";

BO_ 1552 RESP_016_DOOR_MODULE_RR_TO_BODY_CONTROL_MODULE: 16 DOOR_MODULE_RR
 SG_ CRC8 : 0|8@1+ (1,0) [0|255] "" BODY_CONTROL_MODULE
 SG_ ResponseCounter : 8|4@1+ (1,0) [0|15] "" BODY_CONTROL_MODULE
 SG_ AckState : 12|4@1+ (1,0) [0|15] "" BODY_CONTROL_MODULE
 SG_ ReceivedFrameId : 16|11@1+ (1,0) [0|2047] "" BODY_CONTROL_MODULE
 SG_ ReceivedCounter : 27|4@1+ (1,0) [0|15] "" BODY_CONTROL_MODULE
 SG_ ChecksumOk : 31|1@1+ (1,0) [0|1] "" BODY_CONTROL_MODULE
 SG_ PayloadLength : 32|8@1+ (1,0) [0|64] "byte" BODY_CONTROL_MODULE
 SG_ ErrorCode : 40|8@1+ (1,0) [0|255] "" BODY_CONTROL_MODULE
 SG_ ProcessingTimeUs : 48|16@1+ (1,0) [0|65535] "us" BODY_CONTROL_MODULE
 SG_ ResponseSequence : 64|16@1+ (1,0) [0|65535] "" BODY_CONTROL_MODULE
 SG_ ReceivedCrc : 80|8@1+ (1,0) [0|255] "" BODY_CONTROL_MODULE
 SG_ CalculatedCrc : 88|8@1+ (1,0) [0|255] "" BODY_CONTROL_MODULE

CM_ BO_ 1552 "Cycle=50ms; Channel=CAN0; CAN-FD; NominalBitrate=500kbit/s; DataBitrate=2000kbit/s;  ResponseFor=0x190; ACK/NACK with CRC, DLC and counter check;";

BO_ 401 DATA_017_BODY_CONTROL_MODULE_LOCK_COMMAND_TO_TAILGATE_MODULE: 64 BODY_CONTROL_MODULE
 SG_ CRC8 : 0|8@1+ (1,0) [0|255] "" TAILGATE_MODULE
 SG_ AliveCounter : 8|4@1+ (1,0) [0|15] "" TAILGATE_MODULE
 SG_ MuxState : 12|4@1+ (1,0) [0|15] "" TAILGATE_MODULE
 SG_ SIG_191_00 : 16|12@1+ (0.1,0.0) [0|4095] "km/h" TAILGATE_MODULE
 SG_ SIG_191_01 : 28|12@1+ (0.1,0.0) [0|4095] "A" TAILGATE_MODULE
 SG_ SIG_191_02 : 40|12@1+ (0.1,0.0) [0|4095] "rpm" TAILGATE_MODULE
 SG_ SIG_191_03 : 52|12@1+ (0.1,0.0) [0|4095] "m" TAILGATE_MODULE
 SG_ SIG_191_04 : 64|12@1+ (0.1,0.0) [0|4095] "Nm" TAILGATE_MODULE
 SG_ SIG_191_05 : 76|12@1+ (0.1,0.0) [0|4095] "V" TAILGATE_MODULE
 SG_ SIG_191_06 : 88|12@1+ (0.1,0.0) [0|4095] "C" TAILGATE_MODULE
 SG_ SIG_191_07 : 100|12@1+ (0.1,0.0) [0|4095] "Nm" TAILGATE_MODULE
 SG_ SIG_191_08 : 112|12@1+ (0.1,0.0) [0|4095] "m" TAILGATE_MODULE
 SG_ SIG_191_09 : 124|12@1+ (0.1,0.0) [0|4095] "deg" TAILGATE_MODULE
 SG_ SIG_191_10 : 136|12@1+ (0.1,0.0) [0|4095] "obj" TAILGATE_MODULE
 SG_ SIG_191_11 : 148|12@1+ (0.1,0.0) [0|4095] "obj" TAILGATE_MODULE
 SG_ RouteInfoChar_00 : 160|8@1+ (1,0) [0|255] "ascii" TAILGATE_MODULE
 SG_ RouteInfoChar_01 : 168|8@1+ (1,0) [0|255] "ascii" TAILGATE_MODULE
 SG_ RouteInfoChar_02 : 176|8@1+ (1,0) [0|255] "ascii" TAILGATE_MODULE
 SG_ RouteInfoChar_03 : 184|8@1+ (1,0) [0|255] "ascii" TAILGATE_MODULE
 SG_ RouteInfoChar_04 : 192|8@1+ (1,0) [0|255] "ascii" TAILGATE_MODULE
 SG_ RouteInfoChar_05 : 200|8@1+ (1,0) [0|255] "ascii" TAILGATE_MODULE
 SG_ RouteInfoChar_06 : 208|8@1+ (1,0) [0|255] "ascii" TAILGATE_MODULE
 SG_ RouteInfoChar_07 : 216|8@1+ (1,0) [0|255] "ascii" TAILGATE_MODULE
 SG_ RouteInfoChar_08 : 224|8@1+ (1,0) [0|255] "ascii" TAILGATE_MODULE
 SG_ RouteInfoChar_09 : 232|8@1+ (1,0) [0|255] "ascii" TAILGATE_MODULE
 SG_ RouteInfoChar_10 : 240|8@1+ (1,0) [0|255] "ascii" TAILGATE_MODULE
 SG_ RouteInfoChar_11 : 248|8@1+ (1,0) [0|255] "ascii" TAILGATE_MODULE
 SG_ RouteInfoChar_12 : 256|8@1+ (1,0) [0|255] "ascii" TAILGATE_MODULE
 SG_ RouteInfoChar_13 : 264|8@1+ (1,0) [0|255] "ascii" TAILGATE_MODULE
 SG_ RouteInfoChar_14 : 272|8@1+ (1,0) [0|255] "ascii" TAILGATE_MODULE
 SG_ RouteInfoChar_15 : 280|8@1+ (1,0) [0|255] "ascii" TAILGATE_MODULE
 SG_ RouteInfoChar_16 : 288|8@1+ (1,0) [0|255] "ascii" TAILGATE_MODULE
 SG_ RouteInfoChar_17 : 296|8@1+ (1,0) [0|255] "ascii" TAILGATE_MODULE
 SG_ RouteInfoChar_18 : 304|8@1+ (1,0) [0|255] "ascii" TAILGATE_MODULE
 SG_ RouteInfoChar_19 : 312|8@1+ (1,0) [0|255] "ascii" TAILGATE_MODULE
 SG_ RouteInfoChar_20 : 320|8@1+ (1,0) [0|255] "ascii" TAILGATE_MODULE
 SG_ RouteInfoChar_21 : 328|8@1+ (1,0) [0|255] "ascii" TAILGATE_MODULE
 SG_ RouteInfoChar_22 : 336|8@1+ (1,0) [0|255] "ascii" TAILGATE_MODULE
 SG_ RouteInfoChar_23 : 344|8@1+ (1,0) [0|255] "ascii" TAILGATE_MODULE
 SG_ RouteInfoChar_24 : 352|8@1+ (1,0) [0|255] "ascii" TAILGATE_MODULE
 SG_ RouteInfoChar_25 : 360|8@1+ (1,0) [0|255] "ascii" TAILGATE_MODULE
 SG_ RouteInfoChar_26 : 368|8@1+ (1,0) [0|255] "ascii" TAILGATE_MODULE
 SG_ RouteInfoChar_27 : 376|8@1+ (1,0) [0|255] "ascii" TAILGATE_MODULE
 SG_ RouteInfoChar_28 : 384|8@1+ (1,0) [0|255] "ascii" TAILGATE_MODULE
 SG_ RouteInfoChar_29 : 392|8@1+ (1,0) [0|255] "ascii" TAILGATE_MODULE
 SG_ RouteInfoChar_30 : 400|8@1+ (1,0) [0|255] "ascii" TAILGATE_MODULE
 SG_ RouteInfoChar_31 : 408|8@1+ (1,0) [0|255] "ascii" TAILGATE_MODULE
 SG_ RouteInfoChar_32 : 416|8@1+ (1,0) [0|255] "ascii" TAILGATE_MODULE
 SG_ RouteInfoChar_33 : 424|8@1+ (1,0) [0|255] "ascii" TAILGATE_MODULE
 SG_ RouteInfoChar_34 : 432|8@1+ (1,0) [0|255] "ascii" TAILGATE_MODULE
 SG_ RouteInfoChar_35 : 440|8@1+ (1,0) [0|255] "ascii" TAILGATE_MODULE
 SG_ RouteInfoChar_36 : 448|8@1+ (1,0) [0|255] "ascii" TAILGATE_MODULE
 SG_ RouteInfoChar_37 : 456|8@1+ (1,0) [0|255] "ascii" TAILGATE_MODULE
 SG_ RouteInfoChar_38 : 464|8@1+ (1,0) [0|255] "ascii" TAILGATE_MODULE
 SG_ RouteInfoChar_39 : 472|8@1+ (1,0) [0|255] "ascii" TAILGATE_MODULE
 SG_ RouteInfoChar_40 : 480|8@1+ (1,0) [0|255] "ascii" TAILGATE_MODULE
 SG_ RouteInfoChar_41 : 488|8@1+ (1,0) [0|255] "ascii" TAILGATE_MODULE
 SG_ RouteInfoChar_42 : 496|8@1+ (1,0) [0|255] "ascii" TAILGATE_MODULE
 SG_ RouteInfoChar_43 : 504|8@1+ (1,0) [0|255] "ascii" TAILGATE_MODULE

CM_ BO_ 401 "Cycle=50ms; Channel=CAN0; CAN-FD; NominalBitrate=500kbit/s; DataBitrate=2000kbit/s;  Data request; receiver answers with response frame; PayloadRouteInfo='BODY_CONTROL_MODULE -> TAILGATE_MODULE' in bytes 20-63; Gateway to CAN4";

BO_ 1553 RESP_017_TAILGATE_MODULE_TO_BODY_CONTROL_MODULE: 16 TAILGATE_MODULE
 SG_ CRC8 : 0|8@1+ (1,0) [0|255] "" BODY_CONTROL_MODULE
 SG_ ResponseCounter : 8|4@1+ (1,0) [0|15] "" BODY_CONTROL_MODULE
 SG_ AckState : 12|4@1+ (1,0) [0|15] "" BODY_CONTROL_MODULE
 SG_ ReceivedFrameId : 16|11@1+ (1,0) [0|2047] "" BODY_CONTROL_MODULE
 SG_ ReceivedCounter : 27|4@1+ (1,0) [0|15] "" BODY_CONTROL_MODULE
 SG_ ChecksumOk : 31|1@1+ (1,0) [0|1] "" BODY_CONTROL_MODULE
 SG_ PayloadLength : 32|8@1+ (1,0) [0|64] "byte" BODY_CONTROL_MODULE
 SG_ ErrorCode : 40|8@1+ (1,0) [0|255] "" BODY_CONTROL_MODULE
 SG_ ProcessingTimeUs : 48|16@1+ (1,0) [0|65535] "us" BODY_CONTROL_MODULE
 SG_ ResponseSequence : 64|16@1+ (1,0) [0|65535] "" BODY_CONTROL_MODULE
 SG_ ReceivedCrc : 80|8@1+ (1,0) [0|255] "" BODY_CONTROL_MODULE
 SG_ CalculatedCrc : 88|8@1+ (1,0) [0|255] "" BODY_CONTROL_MODULE

CM_ BO_ 1553 "Cycle=50ms; Channel=CAN0; CAN-FD; NominalBitrate=500kbit/s; DataBitrate=2000kbit/s;  ResponseFor=0x191; ACK/NACK with CRC, DLC and counter check;";

BO_ 402 DATA_018_BODY_CONTROL_MODULE_WINDOW_COMMAND_TO_DOOR_MODULE_FL: 64 BODY_CONTROL_MODULE
 SG_ CRC8 : 0|8@1+ (1,0) [0|255] "" DOOR_MODULE_FL
 SG_ AliveCounter : 8|4@1+ (1,0) [0|15] "" DOOR_MODULE_FL
 SG_ MuxState : 12|4@1+ (1,0) [0|15] "" DOOR_MODULE_FL
 SG_ SIG_192_00 : 16|12@1+ (0.1,0.0) [0|4095] "C" DOOR_MODULE_FL
 SG_ SIG_192_01 : 28|12@1+ (0.1,0.0) [0|4095] "Nm" DOOR_MODULE_FL
 SG_ SIG_192_02 : 40|12@1+ (0.1,0.0) [0|4095] "C" DOOR_MODULE_FL
 SG_ SIG_192_03 : 52|12@1+ (0.1,0.0) [0|4095] "%" DOOR_MODULE_FL
 SG_ SIG_192_04 : 64|12@1+ (0.1,0.0) [0|4095] "Nm" DOOR_MODULE_FL
 SG_ SIG_192_05 : 76|12@1+ (0.1,0.0) [0|4095] "rpm" DOOR_MODULE_FL
 SG_ SIG_192_06 : 88|12@1+ (0.1,0.0) [0|4095] "rpm" DOOR_MODULE_FL
 SG_ SIG_192_07 : 100|12@1+ (0.1,0.0) [0|4095] "%" DOOR_MODULE_FL
 SG_ SIG_192_08 : 112|12@1+ (0.1,0.0) [0|4095] "A" DOOR_MODULE_FL
 SG_ SIG_192_09 : 124|12@1+ (0.1,0.0) [0|4095] "%" DOOR_MODULE_FL
 SG_ SIG_192_10 : 136|12@1+ (0.1,0.0) [0|4095] "%" DOOR_MODULE_FL
 SG_ SIG_192_11 : 148|12@1+ (0.1,0.0) [0|4095] "C" DOOR_MODULE_FL
 SG_ RouteInfoChar_00 : 160|8@1+ (1,0) [0|255] "ascii" DOOR_MODULE_FL
 SG_ RouteInfoChar_01 : 168|8@1+ (1,0) [0|255] "ascii" DOOR_MODULE_FL
 SG_ RouteInfoChar_02 : 176|8@1+ (1,0) [0|255] "ascii" DOOR_MODULE_FL
 SG_ RouteInfoChar_03 : 184|8@1+ (1,0) [0|255] "ascii" DOOR_MODULE_FL
 SG_ RouteInfoChar_04 : 192|8@1+ (1,0) [0|255] "ascii" DOOR_MODULE_FL
 SG_ RouteInfoChar_05 : 200|8@1+ (1,0) [0|255] "ascii" DOOR_MODULE_FL
 SG_ RouteInfoChar_06 : 208|8@1+ (1,0) [0|255] "ascii" DOOR_MODULE_FL
 SG_ RouteInfoChar_07 : 216|8@1+ (1,0) [0|255] "ascii" DOOR_MODULE_FL
 SG_ RouteInfoChar_08 : 224|8@1+ (1,0) [0|255] "ascii" DOOR_MODULE_FL
 SG_ RouteInfoChar_09 : 232|8@1+ (1,0) [0|255] "ascii" DOOR_MODULE_FL
 SG_ RouteInfoChar_10 : 240|8@1+ (1,0) [0|255] "ascii" DOOR_MODULE_FL
 SG_ RouteInfoChar_11 : 248|8@1+ (1,0) [0|255] "ascii" DOOR_MODULE_FL
 SG_ RouteInfoChar_12 : 256|8@1+ (1,0) [0|255] "ascii" DOOR_MODULE_FL
 SG_ RouteInfoChar_13 : 264|8@1+ (1,0) [0|255] "ascii" DOOR_MODULE_FL
 SG_ RouteInfoChar_14 : 272|8@1+ (1,0) [0|255] "ascii" DOOR_MODULE_FL
 SG_ RouteInfoChar_15 : 280|8@1+ (1,0) [0|255] "ascii" DOOR_MODULE_FL
 SG_ RouteInfoChar_16 : 288|8@1+ (1,0) [0|255] "ascii" DOOR_MODULE_FL
 SG_ RouteInfoChar_17 : 296|8@1+ (1,0) [0|255] "ascii" DOOR_MODULE_FL
 SG_ RouteInfoChar_18 : 304|8@1+ (1,0) [0|255] "ascii" DOOR_MODULE_FL
 SG_ RouteInfoChar_19 : 312|8@1+ (1,0) [0|255] "ascii" DOOR_MODULE_FL
 SG_ RouteInfoChar_20 : 320|8@1+ (1,0) [0|255] "ascii" DOOR_MODULE_FL
 SG_ RouteInfoChar_21 : 328|8@1+ (1,0) [0|255] "ascii" DOOR_MODULE_FL
 SG_ RouteInfoChar_22 : 336|8@1+ (1,0) [0|255] "ascii" DOOR_MODULE_FL
 SG_ RouteInfoChar_23 : 344|8@1+ (1,0) [0|255] "ascii" DOOR_MODULE_FL
 SG_ RouteInfoChar_24 : 352|8@1+ (1,0) [0|255] "ascii" DOOR_MODULE_FL
 SG_ RouteInfoChar_25 : 360|8@1+ (1,0) [0|255] "ascii" DOOR_MODULE_FL
 SG_ RouteInfoChar_26 : 368|8@1+ (1,0) [0|255] "ascii" DOOR_MODULE_FL
 SG_ RouteInfoChar_27 : 376|8@1+ (1,0) [0|255] "ascii" DOOR_MODULE_FL
 SG_ RouteInfoChar_28 : 384|8@1+ (1,0) [0|255] "ascii" DOOR_MODULE_FL
 SG_ RouteInfoChar_29 : 392|8@1+ (1,0) [0|255] "ascii" DOOR_MODULE_FL
 SG_ RouteInfoChar_30 : 400|8@1+ (1,0) [0|255] "ascii" DOOR_MODULE_FL
 SG_ RouteInfoChar_31 : 408|8@1+ (1,0) [0|255] "ascii" DOOR_MODULE_FL
 SG_ RouteInfoChar_32 : 416|8@1+ (1,0) [0|255] "ascii" DOOR_MODULE_FL
 SG_ RouteInfoChar_33 : 424|8@1+ (1,0) [0|255] "ascii" DOOR_MODULE_FL
 SG_ RouteInfoChar_34 : 432|8@1+ (1,0) [0|255] "ascii" DOOR_MODULE_FL
 SG_ RouteInfoChar_35 : 440|8@1+ (1,0) [0|255] "ascii" DOOR_MODULE_FL
 SG_ RouteInfoChar_36 : 448|8@1+ (1,0) [0|255] "ascii" DOOR_MODULE_FL
 SG_ RouteInfoChar_37 : 456|8@1+ (1,0) [0|255] "ascii" DOOR_MODULE_FL
 SG_ RouteInfoChar_38 : 464|8@1+ (1,0) [0|255] "ascii" DOOR_MODULE_FL
 SG_ RouteInfoChar_39 : 472|8@1+ (1,0) [0|255] "ascii" DOOR_MODULE_FL
 SG_ RouteInfoChar_40 : 480|8@1+ (1,0) [0|255] "ascii" DOOR_MODULE_FL
 SG_ RouteInfoChar_41 : 488|8@1+ (1,0) [0|255] "ascii" DOOR_MODULE_FL
 SG_ RouteInfoChar_42 : 496|8@1+ (1,0) [0|255] "ascii" DOOR_MODULE_FL
 SG_ RouteInfoChar_43 : 504|8@1+ (1,0) [0|255] "ascii" DOOR_MODULE_FL

CM_ BO_ 402 "Cycle=50ms; Channel=CAN0; CAN-FD; NominalBitrate=500kbit/s; DataBitrate=2000kbit/s;  Data request; receiver answers with response frame; PayloadRouteInfo='BODY_CONTROL_MODULE -> DOOR_MODULE_FL' in bytes 20-63; Gateway to CAN4";

BO_ 1554 RESP_018_DOOR_MODULE_FL_TO_BODY_CONTROL_MODULE: 16 DOOR_MODULE_FL
 SG_ CRC8 : 0|8@1+ (1,0) [0|255] "" BODY_CONTROL_MODULE
 SG_ ResponseCounter : 8|4@1+ (1,0) [0|15] "" BODY_CONTROL_MODULE
 SG_ AckState : 12|4@1+ (1,0) [0|15] "" BODY_CONTROL_MODULE
 SG_ ReceivedFrameId : 16|11@1+ (1,0) [0|2047] "" BODY_CONTROL_MODULE
 SG_ ReceivedCounter : 27|4@1+ (1,0) [0|15] "" BODY_CONTROL_MODULE
 SG_ ChecksumOk : 31|1@1+ (1,0) [0|1] "" BODY_CONTROL_MODULE
 SG_ PayloadLength : 32|8@1+ (1,0) [0|64] "byte" BODY_CONTROL_MODULE
 SG_ ErrorCode : 40|8@1+ (1,0) [0|255] "" BODY_CONTROL_MODULE
 SG_ ProcessingTimeUs : 48|16@1+ (1,0) [0|65535] "us" BODY_CONTROL_MODULE
 SG_ ResponseSequence : 64|16@1+ (1,0) [0|65535] "" BODY_CONTROL_MODULE
 SG_ ReceivedCrc : 80|8@1+ (1,0) [0|255] "" BODY_CONTROL_MODULE
 SG_ CalculatedCrc : 88|8@1+ (1,0) [0|255] "" BODY_CONTROL_MODULE

CM_ BO_ 1554 "Cycle=50ms; Channel=CAN0; CAN-FD; NominalBitrate=500kbit/s; DataBitrate=2000kbit/s;  ResponseFor=0x192; ACK/NACK with CRC, DLC and counter check;";

BO_ 403 DATA_019_BODY_CONTROL_MODULE_WINDOW_COMMAND_TO_DOOR_MODULE_FR: 64 BODY_CONTROL_MODULE
 SG_ CRC8 : 0|8@1+ (1,0) [0|255] "" DOOR_MODULE_FR
 SG_ AliveCounter : 8|4@1+ (1,0) [0|15] "" DOOR_MODULE_FR
 SG_ MuxState : 12|4@1+ (1,0) [0|15] "" DOOR_MODULE_FR
 SG_ SIG_193_00 : 16|12@1+ (0.1,0.0) [0|4095] "km/h" DOOR_MODULE_FR
 SG_ SIG_193_01 : 28|12@1+ (0.1,0.0) [0|4095] "rpm" DOOR_MODULE_FR
 SG_ SIG_193_02 : 40|12@1+ (0.1,0.0) [0|4095] "km/h" DOOR_MODULE_FR
 SG_ SIG_193_03 : 52|12@1+ (0.1,0.0) [0|4095] "%" DOOR_MODULE_FR
 SG_ SIG_193_04 : 64|12@1+ (0.1,0.0) [0|4095] "A" DOOR_MODULE_FR
 SG_ SIG_193_05 : 76|12@1+ (0.1,0.0) [0|4095] "rpm" DOOR_MODULE_FR
 SG_ SIG_193_06 : 88|12@1+ (0.1,0.0) [0|4095] "Nm" DOOR_MODULE_FR
 SG_ SIG_193_07 : 100|12@1+ (0.1,0.0) [0|4095] "Nm" DOOR_MODULE_FR
 SG_ SIG_193_08 : 112|12@1+ (0.1,0.0) [0|4095] "Nm" DOOR_MODULE_FR
 SG_ SIG_193_09 : 124|12@1+ (0.1,0.0) [0|4095] "m" DOOR_MODULE_FR
 SG_ SIG_193_10 : 136|12@1+ (0.1,0.0) [0|4095] "C" DOOR_MODULE_FR
 SG_ SIG_193_11 : 148|12@1+ (0.1,0.0) [0|4095] "deg" DOOR_MODULE_FR
 SG_ RouteInfoChar_00 : 160|8@1+ (1,0) [0|255] "ascii" DOOR_MODULE_FR
 SG_ RouteInfoChar_01 : 168|8@1+ (1,0) [0|255] "ascii" DOOR_MODULE_FR
 SG_ RouteInfoChar_02 : 176|8@1+ (1,0) [0|255] "ascii" DOOR_MODULE_FR
 SG_ RouteInfoChar_03 : 184|8@1+ (1,0) [0|255] "ascii" DOOR_MODULE_FR
 SG_ RouteInfoChar_04 : 192|8@1+ (1,0) [0|255] "ascii" DOOR_MODULE_FR
 SG_ RouteInfoChar_05 : 200|8@1+ (1,0) [0|255] "ascii" DOOR_MODULE_FR
 SG_ RouteInfoChar_06 : 208|8@1+ (1,0) [0|255] "ascii" DOOR_MODULE_FR
 SG_ RouteInfoChar_07 : 216|8@1+ (1,0) [0|255] "ascii" DOOR_MODULE_FR
 SG_ RouteInfoChar_08 : 224|8@1+ (1,0) [0|255] "ascii" DOOR_MODULE_FR
 SG_ RouteInfoChar_09 : 232|8@1+ (1,0) [0|255] "ascii" DOOR_MODULE_FR
 SG_ RouteInfoChar_10 : 240|8@1+ (1,0) [0|255] "ascii" DOOR_MODULE_FR
 SG_ RouteInfoChar_11 : 248|8@1+ (1,0) [0|255] "ascii" DOOR_MODULE_FR
 SG_ RouteInfoChar_12 : 256|8@1+ (1,0) [0|255] "ascii" DOOR_MODULE_FR
 SG_ RouteInfoChar_13 : 264|8@1+ (1,0) [0|255] "ascii" DOOR_MODULE_FR
 SG_ RouteInfoChar_14 : 272|8@1+ (1,0) [0|255] "ascii" DOOR_MODULE_FR
 SG_ RouteInfoChar_15 : 280|8@1+ (1,0) [0|255] "ascii" DOOR_MODULE_FR
 SG_ RouteInfoChar_16 : 288|8@1+ (1,0) [0|255] "ascii" DOOR_MODULE_FR
 SG_ RouteInfoChar_17 : 296|8@1+ (1,0) [0|255] "ascii" DOOR_MODULE_FR
 SG_ RouteInfoChar_18 : 304|8@1+ (1,0) [0|255] "ascii" DOOR_MODULE_FR
 SG_ RouteInfoChar_19 : 312|8@1+ (1,0) [0|255] "ascii" DOOR_MODULE_FR
 SG_ RouteInfoChar_20 : 320|8@1+ (1,0) [0|255] "ascii" DOOR_MODULE_FR
 SG_ RouteInfoChar_21 : 328|8@1+ (1,0) [0|255] "ascii" DOOR_MODULE_FR
 SG_ RouteInfoChar_22 : 336|8@1+ (1,0) [0|255] "ascii" DOOR_MODULE_FR
 SG_ RouteInfoChar_23 : 344|8@1+ (1,0) [0|255] "ascii" DOOR_MODULE_FR
 SG_ RouteInfoChar_24 : 352|8@1+ (1,0) [0|255] "ascii" DOOR_MODULE_FR
 SG_ RouteInfoChar_25 : 360|8@1+ (1,0) [0|255] "ascii" DOOR_MODULE_FR
 SG_ RouteInfoChar_26 : 368|8@1+ (1,0) [0|255] "ascii" DOOR_MODULE_FR
 SG_ RouteInfoChar_27 : 376|8@1+ (1,0) [0|255] "ascii" DOOR_MODULE_FR
 SG_ RouteInfoChar_28 : 384|8@1+ (1,0) [0|255] "ascii" DOOR_MODULE_FR
 SG_ RouteInfoChar_29 : 392|8@1+ (1,0) [0|255] "ascii" DOOR_MODULE_FR
 SG_ RouteInfoChar_30 : 400|8@1+ (1,0) [0|255] "ascii" DOOR_MODULE_FR
 SG_ RouteInfoChar_31 : 408|8@1+ (1,0) [0|255] "ascii" DOOR_MODULE_FR
 SG_ RouteInfoChar_32 : 416|8@1+ (1,0) [0|255] "ascii" DOOR_MODULE_FR
 SG_ RouteInfoChar_33 : 424|8@1+ (1,0) [0|255] "ascii" DOOR_MODULE_FR
 SG_ RouteInfoChar_34 : 432|8@1+ (1,0) [0|255] "ascii" DOOR_MODULE_FR
 SG_ RouteInfoChar_35 : 440|8@1+ (1,0) [0|255] "ascii" DOOR_MODULE_FR
 SG_ RouteInfoChar_36 : 448|8@1+ (1,0) [0|255] "ascii" DOOR_MODULE_FR
 SG_ RouteInfoChar_37 : 456|8@1+ (1,0) [0|255] "ascii" DOOR_MODULE_FR
 SG_ RouteInfoChar_38 : 464|8@1+ (1,0) [0|255] "ascii" DOOR_MODULE_FR
 SG_ RouteInfoChar_39 : 472|8@1+ (1,0) [0|255] "ascii" DOOR_MODULE_FR
 SG_ RouteInfoChar_40 : 480|8@1+ (1,0) [0|255] "ascii" DOOR_MODULE_FR
 SG_ RouteInfoChar_41 : 488|8@1+ (1,0) [0|255] "ascii" DOOR_MODULE_FR
 SG_ RouteInfoChar_42 : 496|8@1+ (1,0) [0|255] "ascii" DOOR_MODULE_FR
 SG_ RouteInfoChar_43 : 504|8@1+ (1,0) [0|255] "ascii" DOOR_MODULE_FR

CM_ BO_ 403 "Cycle=50ms; Channel=CAN0; CAN-FD; NominalBitrate=500kbit/s; DataBitrate=2000kbit/s;  Data request; receiver answers with response frame; PayloadRouteInfo='BODY_CONTROL_MODULE -> DOOR_MODULE_FR' in bytes 20-63; Gateway to CAN4";

BO_ 1555 RESP_019_DOOR_MODULE_FR_TO_BODY_CONTROL_MODULE: 16 DOOR_MODULE_FR
 SG_ CRC8 : 0|8@1+ (1,0) [0|255] "" BODY_CONTROL_MODULE
 SG_ ResponseCounter : 8|4@1+ (1,0) [0|15] "" BODY_CONTROL_MODULE
 SG_ AckState : 12|4@1+ (1,0) [0|15] "" BODY_CONTROL_MODULE
 SG_ ReceivedFrameId : 16|11@1+ (1,0) [0|2047] "" BODY_CONTROL_MODULE
 SG_ ReceivedCounter : 27|4@1+ (1,0) [0|15] "" BODY_CONTROL_MODULE
 SG_ ChecksumOk : 31|1@1+ (1,0) [0|1] "" BODY_CONTROL_MODULE
 SG_ PayloadLength : 32|8@1+ (1,0) [0|64] "byte" BODY_CONTROL_MODULE
 SG_ ErrorCode : 40|8@1+ (1,0) [0|255] "" BODY_CONTROL_MODULE
 SG_ ProcessingTimeUs : 48|16@1+ (1,0) [0|65535] "us" BODY_CONTROL_MODULE
 SG_ ResponseSequence : 64|16@1+ (1,0) [0|65535] "" BODY_CONTROL_MODULE
 SG_ ReceivedCrc : 80|8@1+ (1,0) [0|255] "" BODY_CONTROL_MODULE
 SG_ CalculatedCrc : 88|8@1+ (1,0) [0|255] "" BODY_CONTROL_MODULE

CM_ BO_ 1555 "Cycle=50ms; Channel=CAN0; CAN-FD; NominalBitrate=500kbit/s; DataBitrate=2000kbit/s;  ResponseFor=0x193; ACK/NACK with CRC, DLC and counter check;";

BO_ 404 DATA_020_BODY_CONTROL_MODULE_WINDOW_COMMAND_TO_DOOR_MODULE_RL: 64 BODY_CONTROL_MODULE
 SG_ CRC8 : 0|8@1+ (1,0) [0|255] "" DOOR_MODULE_RL
 SG_ AliveCounter : 8|4@1+ (1,0) [0|15] "" DOOR_MODULE_RL
 SG_ MuxState : 12|4@1+ (1,0) [0|15] "" DOOR_MODULE_RL
 SG_ SIG_194_00 : 16|12@1+ (0.1,0.0) [0|4095] "%" DOOR_MODULE_RL
 SG_ SIG_194_01 : 28|12@1+ (0.1,0.0) [0|4095] "deg" DOOR_MODULE_RL
 SG_ SIG_194_02 : 40|12@1+ (0.1,0.0) [0|4095] "V" DOOR_MODULE_RL
 SG_ SIG_194_03 : 52|12@1+ (0.1,0.0) [0|4095] "C" DOOR_MODULE_RL
 SG_ SIG_194_04 : 64|12@1+ (0.1,0.0) [0|4095] "Nm" DOOR_MODULE_RL
 SG_ SIG_194_05 : 76|12@1+ (0.1,0.0) [0|4095] "rpm" DOOR_MODULE_RL
 SG_ SIG_194_06 : 88|12@1+ (0.1,0.0) [0|4095] "C" DOOR_MODULE_RL
 SG_ SIG_194_07 : 100|12@1+ (0.1,0.0) [0|4095] "m" DOOR_MODULE_RL
 SG_ SIG_194_08 : 112|12@1+ (0.1,0.0) [0|4095] "rpm" DOOR_MODULE_RL
 SG_ SIG_194_09 : 124|12@1+ (0.1,0.0) [0|4095] "km/h" DOOR_MODULE_RL
 SG_ SIG_194_10 : 136|12@1+ (0.1,0.0) [0|4095] "m" DOOR_MODULE_RL
 SG_ SIG_194_11 : 148|12@1+ (0.1,0.0) [0|4095] "km/h" DOOR_MODULE_RL
 SG_ RouteInfoChar_00 : 160|8@1+ (1,0) [0|255] "ascii" DOOR_MODULE_RL
 SG_ RouteInfoChar_01 : 168|8@1+ (1,0) [0|255] "ascii" DOOR_MODULE_RL
 SG_ RouteInfoChar_02 : 176|8@1+ (1,0) [0|255] "ascii" DOOR_MODULE_RL
 SG_ RouteInfoChar_03 : 184|8@1+ (1,0) [0|255] "ascii" DOOR_MODULE_RL
 SG_ RouteInfoChar_04 : 192|8@1+ (1,0) [0|255] "ascii" DOOR_MODULE_RL
 SG_ RouteInfoChar_05 : 200|8@1+ (1,0) [0|255] "ascii" DOOR_MODULE_RL
 SG_ RouteInfoChar_06 : 208|8@1+ (1,0) [0|255] "ascii" DOOR_MODULE_RL
 SG_ RouteInfoChar_07 : 216|8@1+ (1,0) [0|255] "ascii" DOOR_MODULE_RL
 SG_ RouteInfoChar_08 : 224|8@1+ (1,0) [0|255] "ascii" DOOR_MODULE_RL
 SG_ RouteInfoChar_09 : 232|8@1+ (1,0) [0|255] "ascii" DOOR_MODULE_RL
 SG_ RouteInfoChar_10 : 240|8@1+ (1,0) [0|255] "ascii" DOOR_MODULE_RL
 SG_ RouteInfoChar_11 : 248|8@1+ (1,0) [0|255] "ascii" DOOR_MODULE_RL
 SG_ RouteInfoChar_12 : 256|8@1+ (1,0) [0|255] "ascii" DOOR_MODULE_RL
 SG_ RouteInfoChar_13 : 264|8@1+ (1,0) [0|255] "ascii" DOOR_MODULE_RL
 SG_ RouteInfoChar_14 : 272|8@1+ (1,0) [0|255] "ascii" DOOR_MODULE_RL
 SG_ RouteInfoChar_15 : 280|8@1+ (1,0) [0|255] "ascii" DOOR_MODULE_RL
 SG_ RouteInfoChar_16 : 288|8@1+ (1,0) [0|255] "ascii" DOOR_MODULE_RL
 SG_ RouteInfoChar_17 : 296|8@1+ (1,0) [0|255] "ascii" DOOR_MODULE_RL
 SG_ RouteInfoChar_18 : 304|8@1+ (1,0) [0|255] "ascii" DOOR_MODULE_RL
 SG_ RouteInfoChar_19 : 312|8@1+ (1,0) [0|255] "ascii" DOOR_MODULE_RL
 SG_ RouteInfoChar_20 : 320|8@1+ (1,0) [0|255] "ascii" DOOR_MODULE_RL
 SG_ RouteInfoChar_21 : 328|8@1+ (1,0) [0|255] "ascii" DOOR_MODULE_RL
 SG_ RouteInfoChar_22 : 336|8@1+ (1,0) [0|255] "ascii" DOOR_MODULE_RL
 SG_ RouteInfoChar_23 : 344|8@1+ (1,0) [0|255] "ascii" DOOR_MODULE_RL
 SG_ RouteInfoChar_24 : 352|8@1+ (1,0) [0|255] "ascii" DOOR_MODULE_RL
 SG_ RouteInfoChar_25 : 360|8@1+ (1,0) [0|255] "ascii" DOOR_MODULE_RL
 SG_ RouteInfoChar_26 : 368|8@1+ (1,0) [0|255] "ascii" DOOR_MODULE_RL
 SG_ RouteInfoChar_27 : 376|8@1+ (1,0) [0|255] "ascii" DOOR_MODULE_RL
 SG_ RouteInfoChar_28 : 384|8@1+ (1,0) [0|255] "ascii" DOOR_MODULE_RL
 SG_ RouteInfoChar_29 : 392|8@1+ (1,0) [0|255] "ascii" DOOR_MODULE_RL
 SG_ RouteInfoChar_30 : 400|8@1+ (1,0) [0|255] "ascii" DOOR_MODULE_RL
 SG_ RouteInfoChar_31 : 408|8@1+ (1,0) [0|255] "ascii" DOOR_MODULE_RL
 SG_ RouteInfoChar_32 : 416|8@1+ (1,0) [0|255] "ascii" DOOR_MODULE_RL
 SG_ RouteInfoChar_33 : 424|8@1+ (1,0) [0|255] "ascii" DOOR_MODULE_RL
 SG_ RouteInfoChar_34 : 432|8@1+ (1,0) [0|255] "ascii" DOOR_MODULE_RL
 SG_ RouteInfoChar_35 : 440|8@1+ (1,0) [0|255] "ascii" DOOR_MODULE_RL
 SG_ RouteInfoChar_36 : 448|8@1+ (1,0) [0|255] "ascii" DOOR_MODULE_RL
 SG_ RouteInfoChar_37 : 456|8@1+ (1,0) [0|255] "ascii" DOOR_MODULE_RL
 SG_ RouteInfoChar_38 : 464|8@1+ (1,0) [0|255] "ascii" DOOR_MODULE_RL
 SG_ RouteInfoChar_39 : 472|8@1+ (1,0) [0|255] "ascii" DOOR_MODULE_RL
 SG_ RouteInfoChar_40 : 480|8@1+ (1,0) [0|255] "ascii" DOOR_MODULE_RL
 SG_ RouteInfoChar_41 : 488|8@1+ (1,0) [0|255] "ascii" DOOR_MODULE_RL
 SG_ RouteInfoChar_42 : 496|8@1+ (1,0) [0|255] "ascii" DOOR_MODULE_RL
 SG_ RouteInfoChar_43 : 504|8@1+ (1,0) [0|255] "ascii" DOOR_MODULE_RL

CM_ BO_ 404 "Cycle=50ms; Channel=CAN0; CAN-FD; NominalBitrate=500kbit/s; DataBitrate=2000kbit/s;  Data request; receiver answers with response frame; PayloadRouteInfo='BODY_CONTROL_MODULE -> DOOR_MODULE_RL' in bytes 20-63; Gateway to CAN4";

BO_ 1556 RESP_020_DOOR_MODULE_RL_TO_BODY_CONTROL_MODULE: 16 DOOR_MODULE_RL
 SG_ CRC8 : 0|8@1+ (1,0) [0|255] "" BODY_CONTROL_MODULE
 SG_ ResponseCounter : 8|4@1+ (1,0) [0|15] "" BODY_CONTROL_MODULE
 SG_ AckState : 12|4@1+ (1,0) [0|15] "" BODY_CONTROL_MODULE
 SG_ ReceivedFrameId : 16|11@1+ (1,0) [0|2047] "" BODY_CONTROL_MODULE
 SG_ ReceivedCounter : 27|4@1+ (1,0) [0|15] "" BODY_CONTROL_MODULE
 SG_ ChecksumOk : 31|1@1+ (1,0) [0|1] "" BODY_CONTROL_MODULE
 SG_ PayloadLength : 32|8@1+ (1,0) [0|64] "byte" BODY_CONTROL_MODULE
 SG_ ErrorCode : 40|8@1+ (1,0) [0|255] "" BODY_CONTROL_MODULE
 SG_ ProcessingTimeUs : 48|16@1+ (1,0) [0|65535] "us" BODY_CONTROL_MODULE
 SG_ ResponseSequence : 64|16@1+ (1,0) [0|65535] "" BODY_CONTROL_MODULE
 SG_ ReceivedCrc : 80|8@1+ (1,0) [0|255] "" BODY_CONTROL_MODULE
 SG_ CalculatedCrc : 88|8@1+ (1,0) [0|255] "" BODY_CONTROL_MODULE

CM_ BO_ 1556 "Cycle=50ms; Channel=CAN0; CAN-FD; NominalBitrate=500kbit/s; DataBitrate=2000kbit/s;  ResponseFor=0x194; ACK/NACK with CRC, DLC and counter check;";

BO_ 405 DATA_021_BODY_CONTROL_MODULE_WINDOW_COMMAND_TO_DOOR_MODULE_RR: 64 BODY_CONTROL_MODULE
 SG_ CRC8 : 0|8@1+ (1,0) [0|255] "" DOOR_MODULE_RR
 SG_ AliveCounter : 8|4@1+ (1,0) [0|15] "" DOOR_MODULE_RR
 SG_ MuxState : 12|4@1+ (1,0) [0|15] "" DOOR_MODULE_RR
 SG_ SIG_195_00 : 16|12@1+ (0.1,0.0) [0|4095] "rpm" DOOR_MODULE_RR
 SG_ SIG_195_01 : 28|12@1+ (0.1,0.0) [0|4095] "Nm" DOOR_MODULE_RR
 SG_ SIG_195_02 : 40|12@1+ (0.1,0.0) [0|4095] "deg" DOOR_MODULE_RR
 SG_ SIG_195_03 : 52|12@1+ (0.1,0.0) [0|4095] "%" DOOR_MODULE_RR
 SG_ SIG_195_04 : 64|12@1+ (0.1,0.0) [0|4095] "C" DOOR_MODULE_RR
 SG_ SIG_195_05 : 76|12@1+ (0.1,0.0) [0|4095] "C" DOOR_MODULE_RR
 SG_ SIG_195_06 : 88|12@1+ (0.1,0.0) [0|4095] "Nm" DOOR_MODULE_RR
 SG_ SIG_195_07 : 100|12@1+ (0.1,0.0) [0|4095] "%" DOOR_MODULE_RR
 SG_ SIG_195_08 : 112|12@1+ (0.1,0.0) [0|4095] "km/h" DOOR_MODULE_RR
 SG_ SIG_195_09 : 124|12@1+ (0.1,0.0) [0|4095] "deg" DOOR_MODULE_RR
 SG_ SIG_195_10 : 136|12@1+ (0.1,0.0) [0|4095] "%" DOOR_MODULE_RR
 SG_ SIG_195_11 : 148|12@1+ (0.1,0.0) [0|4095] "km/h" DOOR_MODULE_RR
 SG_ RouteInfoChar_00 : 160|8@1+ (1,0) [0|255] "ascii" DOOR_MODULE_RR
 SG_ RouteInfoChar_01 : 168|8@1+ (1,0) [0|255] "ascii" DOOR_MODULE_RR
 SG_ RouteInfoChar_02 : 176|8@1+ (1,0) [0|255] "ascii" DOOR_MODULE_RR
 SG_ RouteInfoChar_03 : 184|8@1+ (1,0) [0|255] "ascii" DOOR_MODULE_RR
 SG_ RouteInfoChar_04 : 192|8@1+ (1,0) [0|255] "ascii" DOOR_MODULE_RR
 SG_ RouteInfoChar_05 : 200|8@1+ (1,0) [0|255] "ascii" DOOR_MODULE_RR
 SG_ RouteInfoChar_06 : 208|8@1+ (1,0) [0|255] "ascii" DOOR_MODULE_RR
 SG_ RouteInfoChar_07 : 216|8@1+ (1,0) [0|255] "ascii" DOOR_MODULE_RR
 SG_ RouteInfoChar_08 : 224|8@1+ (1,0) [0|255] "ascii" DOOR_MODULE_RR
 SG_ RouteInfoChar_09 : 232|8@1+ (1,0) [0|255] "ascii" DOOR_MODULE_RR
 SG_ RouteInfoChar_10 : 240|8@1+ (1,0) [0|255] "ascii" DOOR_MODULE_RR
 SG_ RouteInfoChar_11 : 248|8@1+ (1,0) [0|255] "ascii" DOOR_MODULE_RR
 SG_ RouteInfoChar_12 : 256|8@1+ (1,0) [0|255] "ascii" DOOR_MODULE_RR
 SG_ RouteInfoChar_13 : 264|8@1+ (1,0) [0|255] "ascii" DOOR_MODULE_RR
 SG_ RouteInfoChar_14 : 272|8@1+ (1,0) [0|255] "ascii" DOOR_MODULE_RR
 SG_ RouteInfoChar_15 : 280|8@1+ (1,0) [0|255] "ascii" DOOR_MODULE_RR
 SG_ RouteInfoChar_16 : 288|8@1+ (1,0) [0|255] "ascii" DOOR_MODULE_RR
 SG_ RouteInfoChar_17 : 296|8@1+ (1,0) [0|255] "ascii" DOOR_MODULE_RR
 SG_ RouteInfoChar_18 : 304|8@1+ (1,0) [0|255] "ascii" DOOR_MODULE_RR
 SG_ RouteInfoChar_19 : 312|8@1+ (1,0) [0|255] "ascii" DOOR_MODULE_RR
 SG_ RouteInfoChar_20 : 320|8@1+ (1,0) [0|255] "ascii" DOOR_MODULE_RR
 SG_ RouteInfoChar_21 : 328|8@1+ (1,0) [0|255] "ascii" DOOR_MODULE_RR
 SG_ RouteInfoChar_22 : 336|8@1+ (1,0) [0|255] "ascii" DOOR_MODULE_RR
 SG_ RouteInfoChar_23 : 344|8@1+ (1,0) [0|255] "ascii" DOOR_MODULE_RR
 SG_ RouteInfoChar_24 : 352|8@1+ (1,0) [0|255] "ascii" DOOR_MODULE_RR
 SG_ RouteInfoChar_25 : 360|8@1+ (1,0) [0|255] "ascii" DOOR_MODULE_RR
 SG_ RouteInfoChar_26 : 368|8@1+ (1,0) [0|255] "ascii" DOOR_MODULE_RR
 SG_ RouteInfoChar_27 : 376|8@1+ (1,0) [0|255] "ascii" DOOR_MODULE_RR
 SG_ RouteInfoChar_28 : 384|8@1+ (1,0) [0|255] "ascii" DOOR_MODULE_RR
 SG_ RouteInfoChar_29 : 392|8@1+ (1,0) [0|255] "ascii" DOOR_MODULE_RR
 SG_ RouteInfoChar_30 : 400|8@1+ (1,0) [0|255] "ascii" DOOR_MODULE_RR
 SG_ RouteInfoChar_31 : 408|8@1+ (1,0) [0|255] "ascii" DOOR_MODULE_RR
 SG_ RouteInfoChar_32 : 416|8@1+ (1,0) [0|255] "ascii" DOOR_MODULE_RR
 SG_ RouteInfoChar_33 : 424|8@1+ (1,0) [0|255] "ascii" DOOR_MODULE_RR
 SG_ RouteInfoChar_34 : 432|8@1+ (1,0) [0|255] "ascii" DOOR_MODULE_RR
 SG_ RouteInfoChar_35 : 440|8@1+ (1,0) [0|255] "ascii" DOOR_MODULE_RR
 SG_ RouteInfoChar_36 : 448|8@1+ (1,0) [0|255] "ascii" DOOR_MODULE_RR
 SG_ RouteInfoChar_37 : 456|8@1+ (1,0) [0|255] "ascii" DOOR_MODULE_RR
 SG_ RouteInfoChar_38 : 464|8@1+ (1,0) [0|255] "ascii" DOOR_MODULE_RR
 SG_ RouteInfoChar_39 : 472|8@1+ (1,0) [0|255] "ascii" DOOR_MODULE_RR
 SG_ RouteInfoChar_40 : 480|8@1+ (1,0) [0|255] "ascii" DOOR_MODULE_RR
 SG_ RouteInfoChar_41 : 488|8@1+ (1,0) [0|255] "ascii" DOOR_MODULE_RR
 SG_ RouteInfoChar_42 : 496|8@1+ (1,0) [0|255] "ascii" DOOR_MODULE_RR
 SG_ RouteInfoChar_43 : 504|8@1+ (1,0) [0|255] "ascii" DOOR_MODULE_RR

CM_ BO_ 405 "Cycle=50ms; Channel=CAN0; CAN-FD; NominalBitrate=500kbit/s; DataBitrate=2000kbit/s;  Data request; receiver answers with response frame; PayloadRouteInfo='BODY_CONTROL_MODULE -> DOOR_MODULE_RR' in bytes 20-63; Gateway to CAN4";

BO_ 1557 RESP_021_DOOR_MODULE_RR_TO_BODY_CONTROL_MODULE: 16 DOOR_MODULE_RR
 SG_ CRC8 : 0|8@1+ (1,0) [0|255] "" BODY_CONTROL_MODULE
 SG_ ResponseCounter : 8|4@1+ (1,0) [0|15] "" BODY_CONTROL_MODULE
 SG_ AckState : 12|4@1+ (1,0) [0|15] "" BODY_CONTROL_MODULE
 SG_ ReceivedFrameId : 16|11@1+ (1,0) [0|2047] "" BODY_CONTROL_MODULE
 SG_ ReceivedCounter : 27|4@1+ (1,0) [0|15] "" BODY_CONTROL_MODULE
 SG_ ChecksumOk : 31|1@1+ (1,0) [0|1] "" BODY_CONTROL_MODULE
 SG_ PayloadLength : 32|8@1+ (1,0) [0|64] "byte" BODY_CONTROL_MODULE
 SG_ ErrorCode : 40|8@1+ (1,0) [0|255] "" BODY_CONTROL_MODULE
 SG_ ProcessingTimeUs : 48|16@1+ (1,0) [0|65535] "us" BODY_CONTROL_MODULE
 SG_ ResponseSequence : 64|16@1+ (1,0) [0|65535] "" BODY_CONTROL_MODULE
 SG_ ReceivedCrc : 80|8@1+ (1,0) [0|255] "" BODY_CONTROL_MODULE
 SG_ CalculatedCrc : 88|8@1+ (1,0) [0|255] "" BODY_CONTROL_MODULE

CM_ BO_ 1557 "Cycle=50ms; Channel=CAN0; CAN-FD; NominalBitrate=500kbit/s; DataBitrate=2000kbit/s;  ResponseFor=0x195; ACK/NACK with CRC, DLC and counter check;";

BO_ 406 DATA_022_BODY_CONTROL_MODULE_WINDOW_COMMAND_TO_SUNROOF_CONTROLLER: 64 BODY_CONTROL_MODULE
 SG_ CRC8 : 0|8@1+ (1,0) [0|255] "" SUNROOF_CONTROLLER
 SG_ AliveCounter : 8|4@1+ (1,0) [0|15] "" SUNROOF_CONTROLLER
 SG_ MuxState : 12|4@1+ (1,0) [0|15] "" SUNROOF_CONTROLLER
 SG_ SIG_196_00 : 16|12@1+ (0.1,0.0) [0|4095] "%" SUNROOF_CONTROLLER
 SG_ SIG_196_01 : 28|12@1+ (0.1,0.0) [0|4095] "V" SUNROOF_CONTROLLER
 SG_ SIG_196_02 : 40|12@1+ (0.1,0.0) [0|4095] "C" SUNROOF_CONTROLLER
 SG_ SIG_196_03 : 52|12@1+ (0.1,0.0) [0|4095] "V" SUNROOF_CONTROLLER
 SG_ SIG_196_04 : 64|12@1+ (0.1,0.0) [0|4095] "%" SUNROOF_CONTROLLER
 SG_ SIG_196_05 : 76|12@1+ (0.1,0.0) [0|4095] "m" SUNROOF_CONTROLLER
 SG_ SIG_196_06 : 88|12@1+ (0.1,0.0) [0|4095] "C" SUNROOF_CONTROLLER
 SG_ SIG_196_07 : 100|12@1+ (0.1,0.0) [0|4095] "deg" SUNROOF_CONTROLLER
 SG_ SIG_196_08 : 112|12@1+ (0.1,0.0) [0|4095] "Nm" SUNROOF_CONTROLLER
 SG_ SIG_196_09 : 124|12@1+ (0.1,0.0) [0|4095] "V" SUNROOF_CONTROLLER
 SG_ SIG_196_10 : 136|12@1+ (0.1,0.0) [0|4095] "Nm" SUNROOF_CONTROLLER
 SG_ SIG_196_11 : 148|12@1+ (0.1,0.0) [0|4095] "km/h" SUNROOF_CONTROLLER
 SG_ RouteInfoChar_00 : 160|8@1+ (1,0) [0|255] "ascii" SUNROOF_CONTROLLER
 SG_ RouteInfoChar_01 : 168|8@1+ (1,0) [0|255] "ascii" SUNROOF_CONTROLLER
 SG_ RouteInfoChar_02 : 176|8@1+ (1,0) [0|255] "ascii" SUNROOF_CONTROLLER
 SG_ RouteInfoChar_03 : 184|8@1+ (1,0) [0|255] "ascii" SUNROOF_CONTROLLER
 SG_ RouteInfoChar_04 : 192|8@1+ (1,0) [0|255] "ascii" SUNROOF_CONTROLLER
 SG_ RouteInfoChar_05 : 200|8@1+ (1,0) [0|255] "ascii" SUNROOF_CONTROLLER
 SG_ RouteInfoChar_06 : 208|8@1+ (1,0) [0|255] "ascii" SUNROOF_CONTROLLER
 SG_ RouteInfoChar_07 : 216|8@1+ (1,0) [0|255] "ascii" SUNROOF_CONTROLLER
 SG_ RouteInfoChar_08 : 224|8@1+ (1,0) [0|255] "ascii" SUNROOF_CONTROLLER
 SG_ RouteInfoChar_09 : 232|8@1+ (1,0) [0|255] "ascii" SUNROOF_CONTROLLER
 SG_ RouteInfoChar_10 : 240|8@1+ (1,0) [0|255] "ascii" SUNROOF_CONTROLLER
 SG_ RouteInfoChar_11 : 248|8@1+ (1,0) [0|255] "ascii" SUNROOF_CONTROLLER
 SG_ RouteInfoChar_12 : 256|8@1+ (1,0) [0|255] "ascii" SUNROOF_CONTROLLER
 SG_ RouteInfoChar_13 : 264|8@1+ (1,0) [0|255] "ascii" SUNROOF_CONTROLLER
 SG_ RouteInfoChar_14 : 272|8@1+ (1,0) [0|255] "ascii" SUNROOF_CONTROLLER
 SG_ RouteInfoChar_15 : 280|8@1+ (1,0) [0|255] "ascii" SUNROOF_CONTROLLER
 SG_ RouteInfoChar_16 : 288|8@1+ (1,0) [0|255] "ascii" SUNROOF_CONTROLLER
 SG_ RouteInfoChar_17 : 296|8@1+ (1,0) [0|255] "ascii" SUNROOF_CONTROLLER
 SG_ RouteInfoChar_18 : 304|8@1+ (1,0) [0|255] "ascii" SUNROOF_CONTROLLER
 SG_ RouteInfoChar_19 : 312|8@1+ (1,0) [0|255] "ascii" SUNROOF_CONTROLLER
 SG_ RouteInfoChar_20 : 320|8@1+ (1,0) [0|255] "ascii" SUNROOF_CONTROLLER
 SG_ RouteInfoChar_21 : 328|8@1+ (1,0) [0|255] "ascii" SUNROOF_CONTROLLER
 SG_ RouteInfoChar_22 : 336|8@1+ (1,0) [0|255] "ascii" SUNROOF_CONTROLLER
 SG_ RouteInfoChar_23 : 344|8@1+ (1,0) [0|255] "ascii" SUNROOF_CONTROLLER
 SG_ RouteInfoChar_24 : 352|8@1+ (1,0) [0|255] "ascii" SUNROOF_CONTROLLER
 SG_ RouteInfoChar_25 : 360|8@1+ (1,0) [0|255] "ascii" SUNROOF_CONTROLLER
 SG_ RouteInfoChar_26 : 368|8@1+ (1,0) [0|255] "ascii" SUNROOF_CONTROLLER
 SG_ RouteInfoChar_27 : 376|8@1+ (1,0) [0|255] "ascii" SUNROOF_CONTROLLER
 SG_ RouteInfoChar_28 : 384|8@1+ (1,0) [0|255] "ascii" SUNROOF_CONTROLLER
 SG_ RouteInfoChar_29 : 392|8@1+ (1,0) [0|255] "ascii" SUNROOF_CONTROLLER
 SG_ RouteInfoChar_30 : 400|8@1+ (1,0) [0|255] "ascii" SUNROOF_CONTROLLER
 SG_ RouteInfoChar_31 : 408|8@1+ (1,0) [0|255] "ascii" SUNROOF_CONTROLLER
 SG_ RouteInfoChar_32 : 416|8@1+ (1,0) [0|255] "ascii" SUNROOF_CONTROLLER
 SG_ RouteInfoChar_33 : 424|8@1+ (1,0) [0|255] "ascii" SUNROOF_CONTROLLER
 SG_ RouteInfoChar_34 : 432|8@1+ (1,0) [0|255] "ascii" SUNROOF_CONTROLLER
 SG_ RouteInfoChar_35 : 440|8@1+ (1,0) [0|255] "ascii" SUNROOF_CONTROLLER
 SG_ RouteInfoChar_36 : 448|8@1+ (1,0) [0|255] "ascii" SUNROOF_CONTROLLER
 SG_ RouteInfoChar_37 : 456|8@1+ (1,0) [0|255] "ascii" SUNROOF_CONTROLLER
 SG_ RouteInfoChar_38 : 464|8@1+ (1,0) [0|255] "ascii" SUNROOF_CONTROLLER
 SG_ RouteInfoChar_39 : 472|8@1+ (1,0) [0|255] "ascii" SUNROOF_CONTROLLER
 SG_ RouteInfoChar_40 : 480|8@1+ (1,0) [0|255] "ascii" SUNROOF_CONTROLLER
 SG_ RouteInfoChar_41 : 488|8@1+ (1,0) [0|255] "ascii" SUNROOF_CONTROLLER
 SG_ RouteInfoChar_42 : 496|8@1+ (1,0) [0|255] "ascii" SUNROOF_CONTROLLER
 SG_ RouteInfoChar_43 : 504|8@1+ (1,0) [0|255] "ascii" SUNROOF_CONTROLLER

CM_ BO_ 406 "Cycle=50ms; Channel=CAN0; CAN-FD; NominalBitrate=500kbit/s; DataBitrate=2000kbit/s;  Data request; receiver answers with response frame; PayloadRouteInfo='BODY_CONTROL_MODULE -> SUNROOF_CONTROLLER' in bytes 20-63; Gateway to CAN4";

BO_ 1558 RESP_022_SUNROOF_CONTROLLER_TO_BODY_CONTROL_MODULE: 16 SUNROOF_CONTROLLER
 SG_ CRC8 : 0|8@1+ (1,0) [0|255] "" BODY_CONTROL_MODULE
 SG_ ResponseCounter : 8|4@1+ (1,0) [0|15] "" BODY_CONTROL_MODULE
 SG_ AckState : 12|4@1+ (1,0) [0|15] "" BODY_CONTROL_MODULE
 SG_ ReceivedFrameId : 16|11@1+ (1,0) [0|2047] "" BODY_CONTROL_MODULE
 SG_ ReceivedCounter : 27|4@1+ (1,0) [0|15] "" BODY_CONTROL_MODULE
 SG_ ChecksumOk : 31|1@1+ (1,0) [0|1] "" BODY_CONTROL_MODULE
 SG_ PayloadLength : 32|8@1+ (1,0) [0|64] "byte" BODY_CONTROL_MODULE
 SG_ ErrorCode : 40|8@1+ (1,0) [0|255] "" BODY_CONTROL_MODULE
 SG_ ProcessingTimeUs : 48|16@1+ (1,0) [0|65535] "us" BODY_CONTROL_MODULE
 SG_ ResponseSequence : 64|16@1+ (1,0) [0|65535] "" BODY_CONTROL_MODULE
 SG_ ReceivedCrc : 80|8@1+ (1,0) [0|255] "" BODY_CONTROL_MODULE
 SG_ CalculatedCrc : 88|8@1+ (1,0) [0|255] "" BODY_CONTROL_MODULE

CM_ BO_ 1558 "Cycle=50ms; Channel=CAN0; CAN-FD; NominalBitrate=500kbit/s; DataBitrate=2000kbit/s;  ResponseFor=0x196; ACK/NACK with CRC, DLC and counter check;";

BO_ 407 DATA_023_BODY_CONTROL_MODULE_WIPER_COMMAND_TO_WIPER_CONTROLLER: 64 BODY_CONTROL_MODULE
 SG_ CRC8 : 0|8@1+ (1,0) [0|255] "" WIPER_CONTROLLER
 SG_ AliveCounter : 8|4@1+ (1,0) [0|15] "" WIPER_CONTROLLER
 SG_ MuxState : 12|4@1+ (1,0) [0|15] "" WIPER_CONTROLLER
 SG_ SIG_197_00 : 16|12@1+ (0.1,0.0) [0|4095] "obj" WIPER_CONTROLLER
 SG_ SIG_197_01 : 28|12@1+ (0.1,0.0) [0|4095] "m" WIPER_CONTROLLER
 SG_ SIG_197_02 : 40|12@1+ (0.1,0.0) [0|4095] "km/h" WIPER_CONTROLLER
 SG_ SIG_197_03 : 52|12@1+ (0.1,0.0) [0|4095] "A" WIPER_CONTROLLER
 SG_ SIG_197_04 : 64|12@1+ (0.1,0.0) [0|4095] "km/h" WIPER_CONTROLLER
 SG_ SIG_197_05 : 76|12@1+ (0.1,0.0) [0|4095] "km/h" WIPER_CONTROLLER
 SG_ SIG_197_06 : 88|12@1+ (0.1,0.0) [0|4095] "obj" WIPER_CONTROLLER
 SG_ SIG_197_07 : 100|12@1+ (0.1,0.0) [0|4095] "C" WIPER_CONTROLLER
 SG_ SIG_197_08 : 112|12@1+ (0.1,0.0) [0|4095] "m" WIPER_CONTROLLER
 SG_ SIG_197_09 : 124|12@1+ (0.1,0.0) [0|4095] "m" WIPER_CONTROLLER
 SG_ SIG_197_10 : 136|12@1+ (0.1,0.0) [0|4095] "deg" WIPER_CONTROLLER
 SG_ SIG_197_11 : 148|12@1+ (0.1,0.0) [0|4095] "km/h" WIPER_CONTROLLER
 SG_ RouteInfoChar_00 : 160|8@1+ (1,0) [0|255] "ascii" WIPER_CONTROLLER
 SG_ RouteInfoChar_01 : 168|8@1+ (1,0) [0|255] "ascii" WIPER_CONTROLLER
 SG_ RouteInfoChar_02 : 176|8@1+ (1,0) [0|255] "ascii" WIPER_CONTROLLER
 SG_ RouteInfoChar_03 : 184|8@1+ (1,0) [0|255] "ascii" WIPER_CONTROLLER
 SG_ RouteInfoChar_04 : 192|8@1+ (1,0) [0|255] "ascii" WIPER_CONTROLLER
 SG_ RouteInfoChar_05 : 200|8@1+ (1,0) [0|255] "ascii" WIPER_CONTROLLER
 SG_ RouteInfoChar_06 : 208|8@1+ (1,0) [0|255] "ascii" WIPER_CONTROLLER
 SG_ RouteInfoChar_07 : 216|8@1+ (1,0) [0|255] "ascii" WIPER_CONTROLLER
 SG_ RouteInfoChar_08 : 224|8@1+ (1,0) [0|255] "ascii" WIPER_CONTROLLER
 SG_ RouteInfoChar_09 : 232|8@1+ (1,0) [0|255] "ascii" WIPER_CONTROLLER
 SG_ RouteInfoChar_10 : 240|8@1+ (1,0) [0|255] "ascii" WIPER_CONTROLLER
 SG_ RouteInfoChar_11 : 248|8@1+ (1,0) [0|255] "ascii" WIPER_CONTROLLER
 SG_ RouteInfoChar_12 : 256|8@1+ (1,0) [0|255] "ascii" WIPER_CONTROLLER
 SG_ RouteInfoChar_13 : 264|8@1+ (1,0) [0|255] "ascii" WIPER_CONTROLLER
 SG_ RouteInfoChar_14 : 272|8@1+ (1,0) [0|255] "ascii" WIPER_CONTROLLER
 SG_ RouteInfoChar_15 : 280|8@1+ (1,0) [0|255] "ascii" WIPER_CONTROLLER
 SG_ RouteInfoChar_16 : 288|8@1+ (1,0) [0|255] "ascii" WIPER_CONTROLLER
 SG_ RouteInfoChar_17 : 296|8@1+ (1,0) [0|255] "ascii" WIPER_CONTROLLER
 SG_ RouteInfoChar_18 : 304|8@1+ (1,0) [0|255] "ascii" WIPER_CONTROLLER
 SG_ RouteInfoChar_19 : 312|8@1+ (1,0) [0|255] "ascii" WIPER_CONTROLLER
 SG_ RouteInfoChar_20 : 320|8@1+ (1,0) [0|255] "ascii" WIPER_CONTROLLER
 SG_ RouteInfoChar_21 : 328|8@1+ (1,0) [0|255] "ascii" WIPER_CONTROLLER
 SG_ RouteInfoChar_22 : 336|8@1+ (1,0) [0|255] "ascii" WIPER_CONTROLLER
 SG_ RouteInfoChar_23 : 344|8@1+ (1,0) [0|255] "ascii" WIPER_CONTROLLER
 SG_ RouteInfoChar_24 : 352|8@1+ (1,0) [0|255] "ascii" WIPER_CONTROLLER
 SG_ RouteInfoChar_25 : 360|8@1+ (1,0) [0|255] "ascii" WIPER_CONTROLLER
 SG_ RouteInfoChar_26 : 368|8@1+ (1,0) [0|255] "ascii" WIPER_CONTROLLER
 SG_ RouteInfoChar_27 : 376|8@1+ (1,0) [0|255] "ascii" WIPER_CONTROLLER
 SG_ RouteInfoChar_28 : 384|8@1+ (1,0) [0|255] "ascii" WIPER_CONTROLLER
 SG_ RouteInfoChar_29 : 392|8@1+ (1,0) [0|255] "ascii" WIPER_CONTROLLER
 SG_ RouteInfoChar_30 : 400|8@1+ (1,0) [0|255] "ascii" WIPER_CONTROLLER
 SG_ RouteInfoChar_31 : 408|8@1+ (1,0) [0|255] "ascii" WIPER_CONTROLLER
 SG_ RouteInfoChar_32 : 416|8@1+ (1,0) [0|255] "ascii" WIPER_CONTROLLER
 SG_ RouteInfoChar_33 : 424|8@1+ (1,0) [0|255] "ascii" WIPER_CONTROLLER
 SG_ RouteInfoChar_34 : 432|8@1+ (1,0) [0|255] "ascii" WIPER_CONTROLLER
 SG_ RouteInfoChar_35 : 440|8@1+ (1,0) [0|255] "ascii" WIPER_CONTROLLER
 SG_ RouteInfoChar_36 : 448|8@1+ (1,0) [0|255] "ascii" WIPER_CONTROLLER
 SG_ RouteInfoChar_37 : 456|8@1+ (1,0) [0|255] "ascii" WIPER_CONTROLLER
 SG_ RouteInfoChar_38 : 464|8@1+ (1,0) [0|255] "ascii" WIPER_CONTROLLER
 SG_ RouteInfoChar_39 : 472|8@1+ (1,0) [0|255] "ascii" WIPER_CONTROLLER
 SG_ RouteInfoChar_40 : 480|8@1+ (1,0) [0|255] "ascii" WIPER_CONTROLLER
 SG_ RouteInfoChar_41 : 488|8@1+ (1,0) [0|255] "ascii" WIPER_CONTROLLER
 SG_ RouteInfoChar_42 : 496|8@1+ (1,0) [0|255] "ascii" WIPER_CONTROLLER
 SG_ RouteInfoChar_43 : 504|8@1+ (1,0) [0|255] "ascii" WIPER_CONTROLLER

CM_ BO_ 407 "Cycle=50ms; Channel=CAN0; CAN-FD; NominalBitrate=500kbit/s; DataBitrate=2000kbit/s;  Data request; receiver answers with response frame; PayloadRouteInfo='BODY_CONTROL_MODULE -> WIPER_CONTROLLER' in bytes 20-63; Gateway to CAN4";

BO_ 1559 RESP_023_WIPER_CONTROLLER_TO_BODY_CONTROL_MODULE: 16 WIPER_CONTROLLER
 SG_ CRC8 : 0|8@1+ (1,0) [0|255] "" BODY_CONTROL_MODULE
 SG_ ResponseCounter : 8|4@1+ (1,0) [0|15] "" BODY_CONTROL_MODULE
 SG_ AckState : 12|4@1+ (1,0) [0|15] "" BODY_CONTROL_MODULE
 SG_ ReceivedFrameId : 16|11@1+ (1,0) [0|2047] "" BODY_CONTROL_MODULE
 SG_ ReceivedCounter : 27|4@1+ (1,0) [0|15] "" BODY_CONTROL_MODULE
 SG_ ChecksumOk : 31|1@1+ (1,0) [0|1] "" BODY_CONTROL_MODULE
 SG_ PayloadLength : 32|8@1+ (1,0) [0|64] "byte" BODY_CONTROL_MODULE
 SG_ ErrorCode : 40|8@1+ (1,0) [0|255] "" BODY_CONTROL_MODULE
 SG_ ProcessingTimeUs : 48|16@1+ (1,0) [0|65535] "us" BODY_CONTROL_MODULE
 SG_ ResponseSequence : 64|16@1+ (1,0) [0|65535] "" BODY_CONTROL_MODULE
 SG_ ReceivedCrc : 80|8@1+ (1,0) [0|255] "" BODY_CONTROL_MODULE
 SG_ CalculatedCrc : 88|8@1+ (1,0) [0|255] "" BODY_CONTROL_MODULE

CM_ BO_ 1559 "Cycle=50ms; Channel=CAN0; CAN-FD; NominalBitrate=500kbit/s; DataBitrate=2000kbit/s;  ResponseFor=0x197; ACK/NACK with CRC, DLC and counter check;";

BO_ 408 DATA_024_BODY_CONTROL_MODULE_IGNITION_STATE_TO_AIRBAG_CONTROL_UNIT: 64 BODY_CONTROL_MODULE
 SG_ CRC8 : 0|8@1+ (1,0) [0|255] "" AIRBAG_CONTROL_UNIT
 SG_ AliveCounter : 8|4@1+ (1,0) [0|15] "" AIRBAG_CONTROL_UNIT
 SG_ MuxState : 12|4@1+ (1,0) [0|15] "" AIRBAG_CONTROL_UNIT
 SG_ SIG_198_00 : 16|12@1+ (0.1,0.0) [0|4095] "m" AIRBAG_CONTROL_UNIT
 SG_ SIG_198_01 : 28|12@1+ (0.1,0.0) [0|4095] "rpm" AIRBAG_CONTROL_UNIT
 SG_ SIG_198_02 : 40|12@1+ (0.1,0.0) [0|4095] "deg" AIRBAG_CONTROL_UNIT
 SG_ SIG_198_03 : 52|12@1+ (0.1,0.0) [0|4095] "rpm" AIRBAG_CONTROL_UNIT
 SG_ SIG_198_04 : 64|12@1+ (0.1,0.0) [0|4095] "obj" AIRBAG_CONTROL_UNIT
 SG_ SIG_198_05 : 76|12@1+ (0.1,0.0) [0|4095] "rpm" AIRBAG_CONTROL_UNIT
 SG_ SIG_198_06 : 88|12@1+ (0.1,0.0) [0|4095] "Nm" AIRBAG_CONTROL_UNIT
 SG_ SIG_198_07 : 100|12@1+ (0.1,0.0) [0|4095] "%" AIRBAG_CONTROL_UNIT
 SG_ SIG_198_08 : 112|12@1+ (0.1,0.0) [0|4095] "rpm" AIRBAG_CONTROL_UNIT
 SG_ SIG_198_09 : 124|12@1+ (0.1,0.0) [0|4095] "obj" AIRBAG_CONTROL_UNIT
 SG_ SIG_198_10 : 136|12@1+ (0.1,0.0) [0|4095] "Nm" AIRBAG_CONTROL_UNIT
 SG_ SIG_198_11 : 148|12@1+ (0.1,0.0) [0|4095] "obj" AIRBAG_CONTROL_UNIT
 SG_ RouteInfoChar_00 : 160|8@1+ (1,0) [0|255] "ascii" AIRBAG_CONTROL_UNIT
 SG_ RouteInfoChar_01 : 168|8@1+ (1,0) [0|255] "ascii" AIRBAG_CONTROL_UNIT
 SG_ RouteInfoChar_02 : 176|8@1+ (1,0) [0|255] "ascii" AIRBAG_CONTROL_UNIT
 SG_ RouteInfoChar_03 : 184|8@1+ (1,0) [0|255] "ascii" AIRBAG_CONTROL_UNIT
 SG_ RouteInfoChar_04 : 192|8@1+ (1,0) [0|255] "ascii" AIRBAG_CONTROL_UNIT
 SG_ RouteInfoChar_05 : 200|8@1+ (1,0) [0|255] "ascii" AIRBAG_CONTROL_UNIT
 SG_ RouteInfoChar_06 : 208|8@1+ (1,0) [0|255] "ascii" AIRBAG_CONTROL_UNIT
 SG_ RouteInfoChar_07 : 216|8@1+ (1,0) [0|255] "ascii" AIRBAG_CONTROL_UNIT
 SG_ RouteInfoChar_08 : 224|8@1+ (1,0) [0|255] "ascii" AIRBAG_CONTROL_UNIT
 SG_ RouteInfoChar_09 : 232|8@1+ (1,0) [0|255] "ascii" AIRBAG_CONTROL_UNIT
 SG_ RouteInfoChar_10 : 240|8@1+ (1,0) [0|255] "ascii" AIRBAG_CONTROL_UNIT
 SG_ RouteInfoChar_11 : 248|8@1+ (1,0) [0|255] "ascii" AIRBAG_CONTROL_UNIT
 SG_ RouteInfoChar_12 : 256|8@1+ (1,0) [0|255] "ascii" AIRBAG_CONTROL_UNIT
 SG_ RouteInfoChar_13 : 264|8@1+ (1,0) [0|255] "ascii" AIRBAG_CONTROL_UNIT
 SG_ RouteInfoChar_14 : 272|8@1+ (1,0) [0|255] "ascii" AIRBAG_CONTROL_UNIT
 SG_ RouteInfoChar_15 : 280|8@1+ (1,0) [0|255] "ascii" AIRBAG_CONTROL_UNIT
 SG_ RouteInfoChar_16 : 288|8@1+ (1,0) [0|255] "ascii" AIRBAG_CONTROL_UNIT
 SG_ RouteInfoChar_17 : 296|8@1+ (1,0) [0|255] "ascii" AIRBAG_CONTROL_UNIT
 SG_ RouteInfoChar_18 : 304|8@1+ (1,0) [0|255] "ascii" AIRBAG_CONTROL_UNIT
 SG_ RouteInfoChar_19 : 312|8@1+ (1,0) [0|255] "ascii" AIRBAG_CONTROL_UNIT
 SG_ RouteInfoChar_20 : 320|8@1+ (1,0) [0|255] "ascii" AIRBAG_CONTROL_UNIT
 SG_ RouteInfoChar_21 : 328|8@1+ (1,0) [0|255] "ascii" AIRBAG_CONTROL_UNIT
 SG_ RouteInfoChar_22 : 336|8@1+ (1,0) [0|255] "ascii" AIRBAG_CONTROL_UNIT
 SG_ RouteInfoChar_23 : 344|8@1+ (1,0) [0|255] "ascii" AIRBAG_CONTROL_UNIT
 SG_ RouteInfoChar_24 : 352|8@1+ (1,0) [0|255] "ascii" AIRBAG_CONTROL_UNIT
 SG_ RouteInfoChar_25 : 360|8@1+ (1,0) [0|255] "ascii" AIRBAG_CONTROL_UNIT
 SG_ RouteInfoChar_26 : 368|8@1+ (1,0) [0|255] "ascii" AIRBAG_CONTROL_UNIT
 SG_ RouteInfoChar_27 : 376|8@1+ (1,0) [0|255] "ascii" AIRBAG_CONTROL_UNIT
 SG_ RouteInfoChar_28 : 384|8@1+ (1,0) [0|255] "ascii" AIRBAG_CONTROL_UNIT
 SG_ RouteInfoChar_29 : 392|8@1+ (1,0) [0|255] "ascii" AIRBAG_CONTROL_UNIT
 SG_ RouteInfoChar_30 : 400|8@1+ (1,0) [0|255] "ascii" AIRBAG_CONTROL_UNIT
 SG_ RouteInfoChar_31 : 408|8@1+ (1,0) [0|255] "ascii" AIRBAG_CONTROL_UNIT
 SG_ RouteInfoChar_32 : 416|8@1+ (1,0) [0|255] "ascii" AIRBAG_CONTROL_UNIT
 SG_ RouteInfoChar_33 : 424|8@1+ (1,0) [0|255] "ascii" AIRBAG_CONTROL_UNIT
 SG_ RouteInfoChar_34 : 432|8@1+ (1,0) [0|255] "ascii" AIRBAG_CONTROL_UNIT
 SG_ RouteInfoChar_35 : 440|8@1+ (1,0) [0|255] "ascii" AIRBAG_CONTROL_UNIT
 SG_ RouteInfoChar_36 : 448|8@1+ (1,0) [0|255] "ascii" AIRBAG_CONTROL_UNIT
 SG_ RouteInfoChar_37 : 456|8@1+ (1,0) [0|255] "ascii" AIRBAG_CONTROL_UNIT
 SG_ RouteInfoChar_38 : 464|8@1+ (1,0) [0|255] "ascii" AIRBAG_CONTROL_UNIT
 SG_ RouteInfoChar_39 : 472|8@1+ (1,0) [0|255] "ascii" AIRBAG_CONTROL_UNIT
 SG_ RouteInfoChar_40 : 480|8@1+ (1,0) [0|255] "ascii" AIRBAG_CONTROL_UNIT
 SG_ RouteInfoChar_41 : 488|8@1+ (1,0) [0|255] "ascii" AIRBAG_CONTROL_UNIT
 SG_ RouteInfoChar_42 : 496|8@1+ (1,0) [0|255] "ascii" AIRBAG_CONTROL_UNIT
 SG_ RouteInfoChar_43 : 504|8@1+ (1,0) [0|255] "ascii" AIRBAG_CONTROL_UNIT

CM_ BO_ 408 "Cycle=10ms; Channel=CAN0; CAN-FD; NominalBitrate=500kbit/s; DataBitrate=2000kbit/s;  Data request; receiver answers with response frame; PayloadRouteInfo='BODY_CONTROL_MODULE -> AIRBAG_CONTROL_UNIT' in bytes 20-63; Gateway to CAN4";
