VERSION "Realistic CAN Trace Generator"

NS_ :

BS_:

BU_: AIRBAG_CONTROL_UNIT BODY_CONTROL_MODULE CENTRAL_GATEWAY DIAG_TESTER DOOR_MODULE_FL DOOR_MODULE_FR DOOR_MODULE_RL DOOR_MODULE_RR HVAC_CONTROLLER INFOTAINMENT_HEAD_UNIT INSTRUMENT_CLUSTER_KOMBI KESSY_KEYLESS_ACCESS LIGHT_CONTROL_MODULE PARK_DISTANCE_CONTROL RAIN_LIGHT_SENSOR REAR_VIEW_CAMERA SEAT_CONTROLLER_DRIVER SEAT_CONTROLLER_PASSENGER SUNROOF_CONTROLLER TAILGATE_MODULE TELEMATICS_CONTROL_UNIT WIPER_CONTROLLER

BO_ 1560 RESP_024_AIRBAG_CONTROL_UNIT_TO_BODY_CONTROL_MODULE: 16 AIRBAG_CONTROL_UNIT
 SG_ CRC8 : 0|8@1+ (1,0) [0|255] "" BODY_CONTROL_MODULE
 SG_ ResponseCounter : 8|4@1+ (1,0) [0|15] "" BODY_CONTROL_MODULE
 SG_ AckState : 12|4@1+ (1,0) [0|15] "" BODY_CONTROL_MODULE
 SG_ ReceivedFrameId : 16|11@1+ (1,0) [0|2047] "" BODY_CONTROL_MODULE
 SG_ ReceivedCounter : 27|4@1+ (1,0) [0|15] "" BODY_CONTROL_MODULE
 SG_ ChecksumOk : 31|1@1+ (1,0) [0|1] "" BODY_CONTROL_MODULE
 SG_ PayloadLength : 32|8@1+ (1,0) [0|64] "byte" BODY_CONTROL_MODULE
 SG_ ErrorCode : 40|8@1+ (1,0) [0|255] "" BODY_CONTROL_MODULE
 SG_ ProcessingTimeUs : 48|16@1+ (1,0) [0|65535] "us" BODY_CONTROL_MODULE
 SG_ ResponseSequence : 64|16@1+ (1,0) [0|65535] "" BODY_CONTROL_MODULE
 SG_ ReceivedCrc : 80|8@1+ (1,0) [0|255] "" BODY_CONTROL_MODULE
 SG_ CalculatedCrc : 88|8@1+ (1,0) [0|255] "" BODY_CONTROL_MODULE

CM_ BO_ 1560 "Cycle=10ms; Channel=CAN0; CAN-FD; NominalBitrate=500kbit/s; DataBitrate=2000kbit/s;  ResponseFor=0x198; ACK/NACK with CRC, DLC and counter check;";

BO_ 409 DATA_025_BODY_CONTROL_MODULE_IGNITION_STATE_TO_INSTRUMENT_CLUSTER_KOMBI: 64 BODY_CONTROL_MODULE
 SG_ CRC8 : 0|8@1+ (1,0) [0|255] "" INSTRUMENT_CLUSTER_KOMBI
 SG_ AliveCounter : 8|4@1+ (1,0) [0|15] "" INSTRUMENT_CLUSTER_KOMBI
 SG_ MuxState : 12|4@1+ (1,0) [0|15] "" INSTRUMENT_CLUSTER_KOMBI
 SG_ SIG_199_00 : 16|12@1+ (0.1,0.0) [0|4095] "obj" INSTRUMENT_CLUSTER_KOMBI
 SG_ SIG_199_01 : 28|12@1+ (0.1,0.0) [0|4095] "km/h" INSTRUMENT_CLUSTER_KOMBI
 SG_ SIG_199_02 : 40|12@1+ (0.1,0.0) [0|4095] "obj" INSTRUMENT_CLUSTER_KOMBI
 SG_ SIG_199_03 : 52|12@1+ (0.1,0.0) [0|4095] "rpm" INSTRUMENT_CLUSTER_KOMBI
 SG_ SIG_199_04 : 64|12@1+ (0.1,0.0) [0|4095] "%" INSTRUMENT_CLUSTER_KOMBI
 SG_ SIG_199_05 : 76|12@1+ (0.1,0.0) [0|4095] "obj" INSTRUMENT_CLUSTER_KOMBI
 SG_ SIG_199_06 : 88|12@1+ (0.1,0.0) [0|4095] "obj" INSTRUMENT_CLUSTER_KOMBI
 SG_ SIG_199_07 : 100|12@1+ (0.1,0.0) [0|4095] "m" INSTRUMENT_CLUSTER_KOMBI
 SG_ SIG_199_08 : 112|12@1+ (0.1,0.0) [0|4095] "A" INSTRUMENT_CLUSTER_KOMBI
 SG_ SIG_199_09 : 124|12@1+ (0.1,0.0) [0|4095] "V" INSTRUMENT_CLUSTER_KOMBI
 SG_ SIG_199_10 : 136|12@1+ (0.1,0.0) [0|4095] "Nm" INSTRUMENT_CLUSTER_KOMBI
 SG_ SIG_199_11 : 148|12@1+ (0.1,0.0) [0|4095] "A" INSTRUMENT_CLUSTER_KOMBI
 SG_ RouteInfoChar_00 : 160|8@1+ (1,0) [0|255] "ascii" INSTRUMENT_CLUSTER_KOMBI
 SG_ RouteInfoChar_01 : 168|8@1+ (1,0) [0|255] "ascii" INSTRUMENT_CLUSTER_KOMBI
 SG_ RouteInfoChar_02 : 176|8@1+ (1,0) [0|255] "ascii" INSTRUMENT_CLUSTER_KOMBI
 SG_ RouteInfoChar_03 : 184|8@1+ (1,0) [0|255] "ascii" INSTRUMENT_CLUSTER_KOMBI
 SG_ RouteInfoChar_04 : 192|8@1+ (1,0) [0|255] "ascii" INSTRUMENT_CLUSTER_KOMBI
 SG_ RouteInfoChar_05 : 200|8@1+ (1,0) [0|255] "ascii" INSTRUMENT_CLUSTER_KOMBI
 SG_ RouteInfoChar_06 : 208|8@1+ (1,0) [0|255] "ascii" INSTRUMENT_CLUSTER_KOMBI
 SG_ RouteInfoChar_07 : 216|8@1+ (1,0) [0|255] "ascii" INSTRUMENT_CLUSTER_KOMBI
 SG_ RouteInfoChar_08 : 224|8@1+ (1,0) [0|255] "ascii" INSTRUMENT_CLUSTER_KOMBI
 SG_ RouteInfoChar_09 : 232|8@1+ (1,0) [0|255] "ascii" INSTRUMENT_CLUSTER_KOMBI
 SG_ RouteInfoChar_10 : 240|8@1+ (1,0) [0|255] "ascii" INSTRUMENT_CLUSTER_KOMBI
 SG_ RouteInfoChar_11 : 248|8@1+ (1,0) [0|255] "ascii" INSTRUMENT_CLUSTER_KOMBI
 SG_ RouteInfoChar_12 : 256|8@1+ (1,0) [0|255] "ascii" INSTRUMENT_CLUSTER_KOMBI
 SG_ RouteInfoChar_13 : 264|8@1+ (1,0) [0|255] "ascii" INSTRUMENT_CLUSTER_KOMBI
 SG_ RouteInfoChar_14 : 272|8@1+ (1,0) [0|255] "ascii" INSTRUMENT_CLUSTER_KOMBI
 SG_ RouteInfoChar_15 : 280|8@1+ (1,0) [0|255] "ascii" INSTRUMENT_CLUSTER_KOMBI
 SG_ RouteInfoChar_16 : 288|8@1+ (1,0) [0|255] "ascii" INSTRUMENT_CLUSTER_KOMBI
 SG_ RouteInfoChar_17 : 296|8@1+ (1,0) [0|255] "ascii" INSTRUMENT_CLUSTER_KOMBI
 SG_ RouteInfoChar_18 : 304|8@1+ (1,0) [0|255] "ascii" INSTRUMENT_CLUSTER_KOMBI
 SG_ RouteInfoChar_19 : 312|8@1+ (1,0) [0|255] "ascii" INSTRUMENT_CLUSTER_KOMBI
 SG_ RouteInfoChar_20 : 320|8@1+ (1,0) [0|255] "ascii" INSTRUMENT_CLUSTER_KOMBI
 SG_ RouteInfoChar_21 : 328|8@1+ (1,0) [0|255] "ascii" INSTRUMENT_CLUSTER_KOMBI
 SG_ RouteInfoChar_22 : 336|8@1+ (1,0) [0|255] "ascii" INSTRUMENT_CLUSTER_KOMBI
 SG_ RouteInfoChar_23 : 344|8@1+ (1,0) [0|255] "ascii" INSTRUMENT_CLUSTER_KOMBI
 SG_ RouteInfoChar_24 : 352|8@1+ (1,0) [0|255] "ascii" INSTRUMENT_CLUSTER_KOMBI
 SG_ RouteInfoChar_25 : 360|8@1+ (1,0) [0|255] "ascii" INSTRUMENT_CLUSTER_KOMBI
 SG_ RouteInfoChar_26 : 368|8@1+ (1,0) [0|255] "ascii" INSTRUMENT_CLUSTER_KOMBI
 SG_ RouteInfoChar_27 : 376|8@1+ (1,0) [0|255] "ascii" INSTRUMENT_CLUSTER_KOMBI
 SG_ RouteInfoChar_28 : 384|8@1+ (1,0) [0|255] "ascii" INSTRUMENT_CLUSTER_KOMBI
 SG_ RouteInfoChar_29 : 392|8@1+ (1,0) [0|255] "ascii" INSTRUMENT_CLUSTER_KOMBI
 SG_ RouteInfoChar_30 : 400|8@1+ (1,0) [0|255] "ascii" INSTRUMENT_CLUSTER_KOMBI
 SG_ RouteInfoChar_31 : 408|8@1+ (1,0) [0|255] "ascii" INSTRUMENT_CLUSTER_KOMBI
 SG_ RouteInfoChar_32 : 416|8@1+ (1,0) [0|255] "ascii" INSTRUMENT_CLUSTER_KOMBI
 SG_ RouteInfoChar_33 : 424|8@1+ (1,0) [0|255] "ascii" INSTRUMENT_CLUSTER_KOMBI
 SG_ RouteInfoChar_34 : 432|8@1+ (1,0) [0|255] "ascii" INSTRUMENT_CLUSTER_KOMBI
 SG_ RouteInfoChar_35 : 440|8@1+ (1,0) [0|255] "ascii" INSTRUMENT_CLUSTER_KOMBI
 SG_ RouteInfoChar_36 : 448|8@1+ (1,0) [0|255] "ascii" INSTRUMENT_CLUSTER_KOMBI
 SG_ RouteInfoChar_37 : 456|8@1+ (1,0) [0|255] "ascii" INSTRUMENT_CLUSTER_KOMBI
 SG_ RouteInfoChar_38 : 464|8@1+ (1,0) [0|255] "ascii" INSTRUMENT_CLUSTER_KOMBI
 SG_ RouteInfoChar_39 : 472|8@1+ (1,0) [0|255] "ascii" INSTRUMENT_CLUSTER_KOMBI
 SG_ RouteInfoChar_40 : 480|8@1+ (1,0) [0|255] "ascii" INSTRUMENT_CLUSTER_KOMBI
 SG_ RouteInfoChar_41 : 488|8@1+ (1,0) [0|255] "ascii" INSTRUMENT_CLUSTER_KOMBI
 SG_ RouteInfoChar_42 : 496|8@1+ (1,0) [0|255] "ascii" INSTRUMENT_CLUSTER_KOMBI
 SG_ RouteInfoChar_43 : 504|8@1+ (1,0) [0|255] "ascii" INSTRUMENT_CLUSTER_KOMBI

CM_ BO_ 409 "Cycle=20ms; Channel=CAN0; CAN-FD; NominalBitrate=500kbit/s; DataBitrate=2000kbit/s;  Data request; receiver answers with response frame; PayloadRouteInfo='BODY_CONTROL_MODULE -> INSTRUMENT_CLUSTER_KOMBI' in bytes 20-63; Gateway to CAN4";

BO_ 1561 RESP_025_INSTRUMENT_CLUSTER_KOMBI_TO_BODY_CONTROL_MODULE: 16 INSTRUMENT_CLUSTER_KOMBI
 SG_ CRC8 : 0|8@1+ (1,0) [0|255] "" BODY_CONTROL_MODULE
 SG_ ResponseCounter : 8|4@1+ (1,0) [0|15] "" BODY_CONTROL_MODULE
 SG_ AckState : 12|4@1+ (1,0) [0|15] "" BODY_CONTROL_MODULE
 SG_ ReceivedFrameId : 16|11@1+ (1,0) [0|2047] "" BODY_CONTROL_MODULE
 SG_ ReceivedCounter : 27|4@1+ (1,0) [0|15] "" BODY_CONTROL_MODULE
 SG_ ChecksumOk : 31|1@1+ (1,0) [0|1] "" BODY_CONTROL_MODULE
 SG_ PayloadLength : 32|8@1+ (1,0) [0|64] "byte" BODY_CONTROL_MODULE
 SG_ ErrorCode : 40|8@1+ (1,0) [0|255] "" BODY_CONTROL_MODULE
 SG_ ProcessingTimeUs : 48|16@1+ (1,0) [0|65535] "us" BODY_CONTROL_MODULE
 SG_ ResponseSequence : 64|16@1+ (1,0) [0|65535] "" BODY_CONTROL_MODULE
 SG_ ReceivedCrc : 80|8@1+ (1,0) [0|255] "" BODY_CONTROL_MODULE
 SG_ CalculatedCrc : 88|8@1+ (1,0) [0|255] "" BODY_CONTROL_MODULE

CM_ BO_ 1561 "Cycle=20ms; Channel=CAN0; CAN-FD; NominalBitrate=500kbit/s; DataBitrate=2000kbit/s;  ResponseFor=0x199; ACK/NACK with CRC, DLC and counter check;";

BO_ 410 DATA_026_BODY_CONTROL_MODULE_IGNITION_STATE_TO_INFOTAINMENT_HEAD_UNIT: 64 BODY_CONTROL_MODULE
 SG_ CRC8 : 0|8@1+ (1,0) [0|255] "" INFOTAINMENT_HEAD_UNIT
 SG_ AliveCounter : 8|4@1+ (1,0) [0|15] "" INFOTAINMENT_HEAD_UNIT
 SG_ MuxState : 12|4@1+ (1,0) [0|15] "" INFOTAINMENT_HEAD_UNIT
 SG_ SIG_19A_00 : 16|12@1+ (0.1,0.0) [0|4095] "Nm" INFOTAINMENT_HEAD_UNIT
 SG_ SIG_19A_01 : 28|12@1+ (0.1,0.0) [0|4095] "V" INFOTAINMENT_HEAD_UNIT
 SG_ SIG_19A_02 : 40|12@1+ (0.1,0.0) [0|4095] "%" INFOTAINMENT_HEAD_UNIT
 SG_ SIG_19A_03 : 52|12@1+ (0.1,0.0) [0|4095] "deg" INFOTAINMENT_HEAD_UNIT
 SG_ SIG_19A_04 : 64|12@1+ (0.1,0.0) [0|4095] "V" INFOTAINMENT_HEAD_UNIT
 SG_ SIG_19A_05 : 76|12@1+ (0.1,0.0) [0|4095] "C" INFOTAINMENT_HEAD_UNIT
 SG_ SIG_19A_06 : 88|12@1+ (0.1,0.0) [0|4095] "A" INFOTAINMENT_HEAD_UNIT
 SG_ SIG_19A_07 : 100|12@1+ (0.1,0.0) [0|4095] "rpm" INFOTAINMENT_HEAD_UNIT
 SG_ SIG_19A_08 : 112|12@1+ (0.1,0.0) [0|4095] "km/h" INFOTAINMENT_HEAD_UNIT
 SG_ SIG_19A_09 : 124|12@1+ (0.1,0.0) [0|4095] "C" INFOTAINMENT_HEAD_UNIT
 SG_ SIG_19A_10 : 136|12@1+ (0.1,0.0) [0|4095] "obj" INFOTAINMENT_HEAD_UNIT
 SG_ SIG_19A_11 : 148|12@1+ (0.1,0.0) [0|4095] "obj" INFOTAINMENT_HEAD_UNIT
 SG_ RouteInfoChar_00 : 160|8@1+ (1,0) [0|255] "ascii" INFOTAINMENT_HEAD_UNIT
 SG_ RouteInfoChar_01 : 168|8@1+ (1,0) [0|255] "ascii" INFOTAINMENT_HEAD_UNIT
 SG_ RouteInfoChar_02 : 176|8@1+ (1,0) [0|255] "ascii" INFOTAINMENT_HEAD_UNIT
 SG_ RouteInfoChar_03 : 184|8@1+ (1,0) [0|255] "ascii" INFOTAINMENT_HEAD_UNIT
 SG_ RouteInfoChar_04 : 192|8@1+ (1,0) [0|255] "ascii" INFOTAINMENT_HEAD_UNIT
 SG_ RouteInfoChar_05 : 200|8@1+ (1,0) [0|255] "ascii" INFOTAINMENT_HEAD_UNIT
 SG_ RouteInfoChar_06 : 208|8@1+ (1,0) [0|255] "ascii" INFOTAINMENT_HEAD_UNIT
 SG_ RouteInfoChar_07 : 216|8@1+ (1,0) [0|255] "ascii" INFOTAINMENT_HEAD_UNIT
 SG_ RouteInfoChar_08 : 224|8@1+ (1,0) [0|255] "ascii" INFOTAINMENT_HEAD_UNIT
 SG_ RouteInfoChar_09 : 232|8@1+ (1,0) [0|255] "ascii" INFOTAINMENT_HEAD_UNIT
 SG_ RouteInfoChar_10 : 240|8@1+ (1,0) [0|255] "ascii" INFOTAINMENT_HEAD_UNIT
 SG_ RouteInfoChar_11 : 248|8@1+ (1,0) [0|255] "ascii" INFOTAINMENT_HEAD_UNIT
 SG_ RouteInfoChar_12 : 256|8@1+ (1,0) [0|255] "ascii" INFOTAINMENT_HEAD_UNIT
 SG_ RouteInfoChar_13 : 264|8@1+ (1,0) [0|255] "ascii" INFOTAINMENT_HEAD_UNIT
 SG_ RouteInfoChar_14 : 272|8@1+ (1,0) [0|255] "ascii" INFOTAINMENT_HEAD_UNIT
 SG_ RouteInfoChar_15 : 280|8@1+ (1,0) [0|255] "ascii" INFOTAINMENT_HEAD_UNIT
 SG_ RouteInfoChar_16 : 288|8@1+ (1,0) [0|255] "ascii" INFOTAINMENT_HEAD_UNIT
 SG_ RouteInfoChar_17 : 296|8@1+ (1,0) [0|255] "ascii" INFOTAINMENT_HEAD_UNIT
 SG_ RouteInfoChar_18 : 304|8@1+ (1,0) [0|255] "ascii" INFOTAINMENT_HEAD_UNIT
 SG_ RouteInfoChar_19 : 312|8@1+ (1,0) [0|255] "ascii" INFOTAINMENT_HEAD_UNIT
 SG_ RouteInfoChar_20 : 320|8@1+ (1,0) [0|255] "ascii" INFOTAINMENT_HEAD_UNIT
 SG_ RouteInfoChar_21 : 328|8@1+ (1,0) [0|255] "ascii" INFOTAINMENT_HEAD_UNIT
 SG_ RouteInfoChar_22 : 336|8@1+ (1,0) [0|255] "ascii" INFOTAINMENT_HEAD_UNIT
 SG_ RouteInfoChar_23 : 344|8@1+ (1,0) [0|255] "ascii" INFOTAINMENT_HEAD_UNIT
 SG_ RouteInfoChar_24 : 352|8@1+ (1,0) [0|255] "ascii" INFOTAINMENT_HEAD_UNIT
 SG_ RouteInfoChar_25 : 360|8@1+ (1,0) [0|255] "ascii" INFOTAINMENT_HEAD_UNIT
 SG_ RouteInfoChar_26 : 368|8@1+ (1,0) [0|255] "ascii" INFOTAINMENT_HEAD_UNIT
 SG_ RouteInfoChar_27 : 376|8@1+ (1,0) [0|255] "ascii" INFOTAINMENT_HEAD_UNIT
 SG_ RouteInfoChar_28 : 384|8@1+ (1,0) [0|255] "ascii" INFOTAINMENT_HEAD_UNIT
 SG_ RouteInfoChar_29 : 392|8@1+ (1,0) [0|255] "ascii" INFOTAINMENT_HEAD_UNIT
 SG_ RouteInfoChar_30 : 400|8@1+ (1,0) [0|255] "ascii" INFOTAINMENT_HEAD_UNIT
 SG_ RouteInfoChar_31 : 408|8@1+ (1,0) [0|255] "ascii" INFOTAINMENT_HEAD_UNIT
 SG_ RouteInfoChar_32 : 416|8@1+ (1,0) [0|255] "ascii" INFOTAINMENT_HEAD_UNIT
 SG_ RouteInfoChar_33 : 424|8@1+ (1,0) [0|255] "ascii" INFOTAINMENT_HEAD_UNIT
 SG_ RouteInfoChar_34 : 432|8@1+ (1,0) [0|255] "ascii" INFOTAINMENT_HEAD_UNIT
 SG_ RouteInfoChar_35 : 440|8@1+ (1,0) [0|255] "ascii" INFOTAINMENT_HEAD_UNIT
 SG_ RouteInfoChar_36 : 448|8@1+ (1,0) [0|255] "ascii" INFOTAINMENT_HEAD_UNIT
 SG_ RouteInfoChar_37 : 456|8@1+ (1,0) [0|255] "ascii" INFOTAINMENT_HEAD_UNIT
 SG_ RouteInfoChar_38 : 464|8@1+ (1,0) [0|255] "ascii" INFOTAINMENT_HEAD_UNIT
 SG_ RouteInfoChar_39 : 472|8@1+ (1,0) [0|255] "ascii" INFOTAINMENT_HEAD_UNIT
 SG_ RouteInfoChar_40 : 480|8@1+ (1,0) [0|255] "ascii" INFOTAINMENT_HEAD_UNIT
 SG_ RouteInfoChar_41 : 488|8@1+ (1,0) [0|255] "ascii" INFOTAINMENT_HEAD_UNIT
 SG_ RouteInfoChar_42 : 496|8@1+ (1,0) [0|255] "ascii" INFOTAINMENT_HEAD_UNIT
 SG_ RouteInfoChar_43 : 504|8@1+ (1,0) [0|255] "ascii" INFOTAINMENT_HEAD_UNIT

CM_ BO_ 410 "Cycle=50ms; Channel=CAN0; CAN-FD; NominalBitrate=500kbit/s; DataBitrate=2000kbit/s;  Data request; receiver answers with response frame; PayloadRouteInfo='BODY_CONTROL_MODULE -> INFOTAINMENT_HEAD_UNIT' in bytes 20-63; Gateway to CAN4";

BO_ 1562 RESP_026_INFOTAINMENT_HEAD_UNIT_TO_BODY_CONTROL_MODULE: 16 INFOTAINMENT_HEAD_UNIT
 SG_ CRC8 : 0|8@1+ (1,0) [0|255] "" BODY_CONTROL_MODULE
 SG_ ResponseCounter : 8|4@1+ (1,0) [0|15] "" BODY_CONTROL_MODULE
 SG_ AckState : 12|4@1+ (1,0) [0|15] "" BODY_CONTROL_MODULE
 SG_ ReceivedFrameId : 16|11@1+ (1,0) [0|2047] "" BODY_CONTROL_MODULE
 SG_ ReceivedCounter : 27|4@1+ (1,0) [0|15] "" BODY_CONTROL_MODULE
 SG_ ChecksumOk : 31|1@1+ (1,0) [0|1] "" BODY_CONTROL_MODULE
 SG_ PayloadLength : 32|8@1+ (1,0) [0|64] "byte" BODY_CONTROL_MODULE
 SG_ ErrorCode : 40|8@1+ (1,0) [0|255] "" BODY_CONTROL_MODULE
 SG_ ProcessingTimeUs : 48|16@1+ (1,0) [0|65535] "us" BODY_CONTROL_MODULE
 SG_ ResponseSequence : 64|16@1+ (1,0) [0|65535] "" BODY_CONTROL_MODULE
 SG_ ReceivedCrc : 80|8@1+ (1,0) [0|255] "" BODY_CONTROL_MODULE
 SG_ CalculatedCrc : 88|8@1+ (1,0) [0|255] "" BODY_CONTROL_MODULE

CM_ BO_ 1562 "Cycle=50ms; Channel=CAN0; CAN-FD; NominalBitrate=500kbit/s; DataBitrate=2000kbit/s;  ResponseFor=0x19A; ACK/NACK with CRC, DLC and counter check;";

BO_ 411 DATA_027_BODY_CONTROL_MODULE_IGNITION_STATE_TO_TELEMATICS_CONTROL_UNIT: 64 BODY_CONTROL_MODULE
 SG_ CRC8 : 0|8@1+ (1,0) [0|255] "" TELEMATICS_CONTROL_UNIT
 SG_ AliveCounter : 8|4@1+ (1,0) [0|15] "" TELEMATICS_CONTROL_UNIT
 SG_ MuxState : 12|4@1+ (1,0) [0|15] "" TELEMATICS_CONTROL_UNIT
 SG_ SIG_19B_00 : 16|12@1+ (0.1,0.0) [0|4095] "rpm" TELEMATICS_CONTROL_UNIT
 SG_ SIG_19B_01 : 28|12@1+ (0.1,0.0) [0|4095] "rpm" TELEMATICS_CONTROL_UNIT
 SG_ SIG_19B_02 : 40|12@1+ (0.1,0.0) [0|4095] "m" TELEMATICS_CONTROL_UNIT
 SG_ SIG_19B_03 : 52|12@1+ (0.1,0.0) [0|4095] "Nm" TELEMATICS_CONTROL_UNIT
 SG_ SIG_19B_04 : 64|12@1+ (0.1,0.0) [0|4095] "m" TELEMATICS_CONTROL_UNIT
 SG_ SIG_19B_05 : 76|12@1+ (0.1,0.0) [0|4095] "V" TELEMATICS_CONTROL_UNIT
 SG_ SIG_19B_06 : 88|12@1+ (0.1,0.0) [0|4095] "deg" TELEMATICS_CONTROL_UNIT
 SG_ SIG_19B_07 : 100|12@1+ (0.1,0.0) [0|4095] "A" TELEMATICS_CONTROL_UNIT
 SG_ SIG_19B_08 : 112|12@1+ (0.1,0.0) [0|4095] "rpm" TELEMATICS_CONTROL_UNIT
 SG_ SIG_19B_09 : 124|12@1+ (0.1,0.0) [0|4095] "Nm" TELEMATICS_CONTROL_UNIT
 SG_ SIG_19B_10 : 136|12@1+ (0.1,0.0) [0|4095] "A" TELEMATICS_CONTROL_UNIT
 SG_ SIG_19B_11 : 148|12@1+ (0.1,0.0) [0|4095] "V" TELEMATICS_CONTROL_UNIT
 SG_ RouteInfoChar_00 : 160|8@1+ (1,0) [0|255] "ascii" TELEMATICS_CONTROL_UNIT
 SG_ RouteInfoChar_01 : 168|8@1+ (1,0) [0|255] "ascii" TELEMATICS_CONTROL_UNIT
 SG_ RouteInfoChar_02 : 176|8@1+ (1,0) [0|255] "ascii" TELEMATICS_CONTROL_UNIT
 SG_ RouteInfoChar_03 : 184|8@1+ (1,0) [0|255] "ascii" TELEMATICS_CONTROL_UNIT
 SG_ RouteInfoChar_04 : 192|8@1+ (1,0) [0|255] "ascii" TELEMATICS_CONTROL_UNIT
 SG_ RouteInfoChar_05 : 200|8@1+ (1,0) [0|255] "ascii" TELEMATICS_CONTROL_UNIT
 SG_ RouteInfoChar_06 : 208|8@1+ (1,0) [0|255] "ascii" TELEMATICS_CONTROL_UNIT
 SG_ RouteInfoChar_07 : 216|8@1+ (1,0) [0|255] "ascii" TELEMATICS_CONTROL_UNIT
 SG_ RouteInfoChar_08 : 224|8@1+ (1,0) [0|255] "ascii" TELEMATICS_CONTROL_UNIT
 SG_ RouteInfoChar_09 : 232|8@1+ (1,0) [0|255] "ascii" TELEMATICS_CONTROL_UNIT
 SG_ RouteInfoChar_10 : 240|8@1+ (1,0) [0|255] "ascii" TELEMATICS_CONTROL_UNIT
 SG_ RouteInfoChar_11 : 248|8@1+ (1,0) [0|255] "ascii" TELEMATICS_CONTROL_UNIT
 SG_ RouteInfoChar_12 : 256|8@1+ (1,0) [0|255] "ascii" TELEMATICS_CONTROL_UNIT
 SG_ RouteInfoChar_13 : 264|8@1+ (1,0) [0|255] "ascii" TELEMATICS_CONTROL_UNIT
 SG_ RouteInfoChar_14 : 272|8@1+ (1,0) [0|255] "ascii" TELEMATICS_CONTROL_UNIT
 SG_ RouteInfoChar_15 : 280|8@1+ (1,0) [0|255] "ascii" TELEMATICS_CONTROL_UNIT
 SG_ RouteInfoChar_16 : 288|8@1+ (1,0) [0|255] "ascii" TELEMATICS_CONTROL_UNIT
 SG_ RouteInfoChar_17 : 296|8@1+ (1,0) [0|255] "ascii" TELEMATICS_CONTROL_UNIT
 SG_ RouteInfoChar_18 : 304|8@1+ (1,0) [0|255] "ascii" TELEMATICS_CONTROL_UNIT
 SG_ RouteInfoChar_19 : 312|8@1+ (1,0) [0|255] "ascii" TELEMATICS_CONTROL_UNIT
 SG_ RouteInfoChar_20 : 320|8@1+ (1,0) [0|255] "ascii" TELEMATICS_CONTROL_UNIT
 SG_ RouteInfoChar_21 : 328|8@1+ (1,0) [0|255] "ascii" TELEMATICS_CONTROL_UNIT
 SG_ RouteInfoChar_22 : 336|8@1+ (1,0) [0|255] "ascii" TELEMATICS_CONTROL_UNIT
 SG_ RouteInfoChar_23 : 344|8@1+ (1,0) [0|255] "ascii" TELEMATICS_CONTROL_UNIT
 SG_ RouteInfoChar_24 : 352|8@1+ (1,0) [0|255] "ascii" TELEMATICS_CONTROL_UNIT
 SG_ RouteInfoChar_25 : 360|8@1+ (1,0) [0|255] "ascii" TELEMATICS_CONTROL_UNIT
 SG_ RouteInfoChar_26 : 368|8@1+ (1,0) [0|255] "ascii" TELEMATICS_CONTROL_UNIT
 SG_ RouteInfoChar_27 : 376|8@1+ (1,0) [0|255] "ascii" TELEMATICS_CONTROL_UNIT
 SG_ RouteInfoChar_28 : 384|8@1+ (1,0) [0|255] "ascii" TELEMATICS_CONTROL_UNIT
 SG_ RouteInfoChar_29 : 392|8@1+ (1,0) [0|255] "ascii" TELEMATICS_CONTROL_UNIT
 SG_ RouteInfoChar_30 : 400|8@1+ (1,0) [0|255] "ascii" TELEMATICS_CONTROL_UNIT
 SG_ RouteInfoChar_31 : 408|8@1+ (1,0) [0|255] "ascii" TELEMATICS_CONTROL_UNIT
 SG_ RouteInfoChar_32 : 416|8@1+ (1,0) [0|255] "ascii" TELEMATICS_CONTROL_UNIT
 SG_ RouteInfoChar_33 : 424|8@1+ (1,0) [0|255] "ascii" TELEMATICS_CONTROL_UNIT
 SG_ RouteInfoChar_34 : 432|8@1+ (1,0) [0|255] "ascii" TELEMATICS_CONTROL_UNIT
 SG_ RouteInfoChar_35 : 440|8@1+ (1,0) [0|255] "ascii" TELEMATICS_CONTROL_UNIT
 SG_ RouteInfoChar_36 : 448|8@1+ (1,0) [0|255] "ascii" TELEMATICS_CONTROL_UNIT
 SG_ RouteInfoChar_37 : 456|8@1+ (1,0) [0|255] "ascii" TELEMATICS_CONTROL_UNIT
 SG_ RouteInfoChar_38 : 464|8@1+ (1,0) [0|255] "ascii" TELEMATICS_CONTROL_UNIT
 SG_ RouteInfoChar_39 : 472|8@1+ (1,0) [0|255] "ascii" TELEMATICS_CONTROL_UNIT
 SG_ RouteInfoChar_40 : 480|8@1+ (1,0) [0|255] "ascii" TELEMATICS_CONTROL_UNIT
 SG_ RouteInfoChar_41 : 488|8@1+ (1,0) [0|255] "ascii" TELEMATICS_CONTROL_UNIT
 SG_ RouteInfoChar_42 : 496|8@1+ (1,0) [0|255] "ascii" TELEMATICS_CONTROL_UNIT
 SG_ RouteInfoChar_43 : 504|8@1+ (1,0) [0|255] "ascii" TELEMATICS_CONTROL_UNIT

CM_ BO_ 411 "Cycle=50ms; Channel=CAN0; CAN-FD; NominalBitrate=500kbit/s; DataBitrate=2000kbit/s;  Data request; receiver answers with response frame; PayloadRouteInfo='BODY_CONTROL_MODULE -> TELEMATICS_CONTROL_UNIT' in bytes 20-63; Gateway to CAN4";

BO_ 1563 RESP_027_TELEMATICS_CONTROL_UNIT_TO_BODY_CONTROL_MODULE: 16 TELEMATICS_CONTROL_UNIT
 SG_ CRC8 : 0|8@1+ (1,0) [0|255] "" BODY_CONTROL_MODULE
 SG_ ResponseCounter : 8|4@1+ (1,0) [0|15] "" BODY_CONTROL_MODULE
 SG_ AckState : 12|4@1+ (1,0) [0|15] "" BODY_CONTROL_MODULE
 SG_ ReceivedFrameId : 16|11@1+ (1,0) [0|2047] "" BODY_CONTROL_MODULE
 SG_ ReceivedCounter : 27|4@1+ (1,0) [0|15] "" BODY_CONTROL_MODULE
 SG_ ChecksumOk : 31|1@1+ (1,0) [0|1] "" BODY_CONTROL_MODULE
 SG_ PayloadLength : 32|8@1+ (1,0) [0|64] "byte" BODY_CONTROL_MODULE
 SG_ ErrorCode : 40|8@1+ (1,0) [0|255] "" BODY_CONTROL_MODULE
 SG_ ProcessingTimeUs : 48|16@1+ (1,0) [0|65535] "us" BODY_CONTROL_MODULE
 SG_ ResponseSequence : 64|16@1+ (1,0) [0|65535] "" BODY_CONTROL_MODULE
 SG_ ReceivedCrc : 80|8@1+ (1,0) [0|255] "" BODY_CONTROL_MODULE
 SG_ CalculatedCrc : 88|8@1+ (1,0) [0|255] "" BODY_CONTROL_MODULE

CM_ BO_ 1563 "Cycle=50ms; Channel=CAN0; CAN-FD; NominalBitrate=500kbit/s; DataBitrate=2000kbit/s;  ResponseFor=0x19B; ACK/NACK with CRC, DLC and counter check;";

BO_ 412 DATA_028_KESSY_KEYLESS_ACCESS_KESSY_AUTH_STATUS_TO_BODY_CONTROL_MODULE: 64 KESSY_KEYLESS_ACCESS
 SG_ CRC8 : 0|8@1+ (1,0) [0|255] "" BODY_CONTROL_MODULE
 SG_ AliveCounter : 8|4@1+ (1,0) [0|15] "" BODY_CONTROL_MODULE
 SG_ MuxState : 12|4@1+ (1,0) [0|15] "" BODY_CONTROL_MODULE
 SG_ SIG_19C_00 : 16|12@1+ (0.1,0.0) [0|4095] "deg" BODY_CONTROL_MODULE
 SG_ SIG_19C_01 : 28|12@1+ (0.1,0.0) [0|4095] "C" BODY_CONTROL_MODULE
 SG_ SIG_19C_02 : 40|12@1+ (0.1,0.0) [0|4095] "m" BODY_CONTROL_MODULE
 SG_ SIG_19C_03 : 52|12@1+ (0.1,0.0) [0|4095] "V" BODY_CONTROL_MODULE
 SG_ SIG_19C_04 : 64|12@1+ (0.1,0.0) [0|4095] "obj" BODY_CONTROL_MODULE
 SG_ SIG_19C_05 : 76|12@1+ (0.1,0.0) [0|4095] "m" BODY_CONTROL_MODULE
 SG_ SIG_19C_06 : 88|12@1+ (0.1,0.0) [0|4095] "km/h" BODY_CONTROL_MODULE
 SG_ SIG_19C_07 : 100|12@1+ (0.1,0.0) [0|4095] "m" BODY_CONTROL_MODULE
 SG_ SIG_19C_08 : 112|12@1+ (0.1,0.0) [0|4095] "V" BODY_CONTROL_MODULE
 SG_ SIG_19C_09 : 124|12@1+ (0.1,0.0) [0|4095] "rpm" BODY_CONTROL_MODULE
 SG_ SIG_19C_10 : 136|12@1+ (0.1,0.0) [0|4095] "deg" BODY_CONTROL_MODULE
 SG_ SIG_19C_11 : 148|12@1+ (0.1,0.0) [0|4095] "V" BODY_CONTROL_MODULE
 SG_ RouteInfoChar_00 : 160|8@1+ (1,0) [0|255] "ascii" BODY_CONTROL_MODULE
 SG_ RouteInfoChar_01 : 168|8@1+ (1,0) [0|255] "ascii" BODY_CONTROL_MODULE
 SG_ RouteInfoChar_02 : 176|8@1+ (1,0) [0|255] "ascii" BODY_CONTROL_MODULE
 SG_ RouteInfoChar_03 : 184|8@1+ (1,0) [0|255] "ascii" BODY_CONTROL_MODULE
 SG_ RouteInfoChar_04 : 192|8@1+ (1,0) [0|255] "ascii" BODY_CONTROL_MODULE
 SG_ RouteInfoChar_05 : 200|8@1+ (1,0) [0|255] "ascii" BODY_CONTROL_MODULE
 SG_ RouteInfoChar_06 : 208|8@1+ (1,0) [0|255] "ascii" BODY_CONTROL_MODULE
 SG_ RouteInfoChar_07 : 216|8@1+ (1,0) [0|255] "ascii" BODY_CONTROL_MODULE
 SG_ RouteInfoChar_08 : 224|8@1+ (1,0) [0|255] "ascii" BODY_CONTROL_MODULE
 SG_ RouteInfoChar_09 : 232|8@1+ (1,0) [0|255] "ascii" BODY_CONTROL_MODULE
 SG_ RouteInfoChar_10 : 240|8@1+ (1,0) [0|255] "ascii" BODY_CONTROL_MODULE
 SG_ RouteInfoChar_11 : 248|8@1+ (1,0) [0|255] "ascii" BODY_CONTROL_MODULE
 SG_ RouteInfoChar_12 : 256|8@1+ (1,0) [0|255] "ascii" BODY_CONTROL_MODULE
 SG_ RouteInfoChar_13 : 264|8@1+ (1,0) [0|255] "ascii" BODY_CONTROL_MODULE
 SG_ RouteInfoChar_14 : 272|8@1+ (1,0) [0|255] "ascii" BODY_CONTROL_MODULE
 SG_ RouteInfoChar_15 : 280|8@1+ (1,0) [0|255] "ascii" BODY_CONTROL_MODULE
 SG_ RouteInfoChar_16 : 288|8@1+ (1,0) [0|255] "ascii" BODY_CONTROL_MODULE
 SG_ RouteInfoChar_17 : 296|8@1+ (1,0) [0|255] "ascii" BODY_CONTROL_MODULE
 SG_ RouteInfoChar_18 : 304|8@1+ (1,0) [0|255] "ascii" BODY_CONTROL_MODULE
 SG_ RouteInfoChar_19 : 312|8@1+ (1,0) [0|255] "ascii" BODY_CONTROL_MODULE
 SG_ RouteInfoChar_20 : 320|8@1+ (1,0) [0|255] "ascii" BODY_CONTROL_MODULE
 SG_ RouteInfoChar_21 : 328|8@1+ (1,0) [0|255] "ascii" BODY_CONTROL_MODULE
 SG_ RouteInfoChar_22 : 336|8@1+ (1,0) [0|255] "ascii" BODY_CONTROL_MODULE
 SG_ RouteInfoChar_23 : 344|8@1+ (1,0) [0|255] "ascii" BODY_CONTROL_MODULE
 SG_ RouteInfoChar_24 : 352|8@1+ (1,0) [0|255] "ascii" BODY_CONTROL_MODULE
 SG_ RouteInfoChar_25 : 360|8@1+ (1,0) [0|255] "ascii" BODY_CONTROL_MODULE
 SG_ RouteInfoChar_26 : 368|8@1+ (1,0) [0|255] "ascii" BODY_CONTROL_MODULE
 SG_ RouteInfoChar_27 : 376|8@1+ (1,0) [0|255] "ascii" BODY_CONTROL_MODULE
 SG_ RouteInfoChar_28 : 384|8@1+ (1,0) [0|255] "ascii" BODY_CONTROL_MODULE
 SG_ RouteInfoChar_29 : 392|8@1+ (1,0) [0|255] "ascii" BODY_CONTROL_MODULE
 SG_ RouteInfoChar_30 : 400|8@1+ (1,0) [0|255] "ascii" BODY_CONTROL_MODULE
 SG_ RouteInfoChar_31 : 408|8@1+ (1,0) [0|255] "ascii" BODY_CONTROL_MODULE
 SG_ RouteInfoChar_32 : 416|8@1+ (1,0) [0|255] "ascii" BODY_CONTROL_MODULE
 SG_ RouteInfoChar_33 : 424|8@1+ (1,0) [0|255] "ascii" BODY_CONTROL_MODULE
 SG_ RouteInfoChar_34 : 432|8@1+ (1,0) [0|255] "ascii" BODY_CONTROL_MODULE
 SG_ RouteInfoChar_35 : 440|8@1+ (1,0) [0|255] "ascii" BODY_CONTROL_MODULE
 SG_ RouteInfoChar_36 : 448|8@1+ (1,0) [0|255] "ascii" BODY_CONTROL_MODULE
 SG_ RouteInfoChar_37 : 456|8@1+ (1,0) [0|255] "ascii" BODY_CONTROL_MODULE
 SG_ RouteInfoChar_38 : 464|8@1+ (1,0) [0|255] "ascii" BODY_CONTROL_MODULE
 SG_ RouteInfoChar_39 : 472|8@1+ (1,0) [0|255] "ascii" BODY_CONTROL_MODULE
 SG_ RouteInfoChar_40 : 480|8@1+ (1,0) [0|255] "ascii" BODY_CONTROL_MODULE
 SG_ RouteInfoChar_41 : 488|8@1+ (1,0) [0|255] "ascii" BODY_CONTROL_MODULE
 SG_ RouteInfoChar_42 : 496|8@1+ (1,0) [0|255] "ascii" BODY_CONTROL_MODULE
 SG_ RouteInfoChar_43 : 504|8@1+ (1,0) [0|255] "ascii" BODY_CONTROL_MODULE

CM_ BO_ 412 "Cycle=50ms; Channel=CAN0; CAN-FD; NominalBitrate=500kbit/s; DataBitrate=2000kbit/s;  Data request; receiver answers with response frame; PayloadRouteInfo='KESSY_KEYLESS_ACCESS -> BODY_CONTROL_MODULE' in bytes 20-63;";

BO_ 1564 RESP_028_BODY_CONTROL_MODULE_TO_KESSY_KEYLESS_ACCESS: 16 BODY_CONTROL_MODULE
 SG_ CRC8 : 0|8@1+ (1,0) [0|255] "" KESSY_KEYLESS_ACCESS
 SG_ ResponseCounter : 8|4@1+ (1,0) [0|15] "" KESSY_KEYLESS_ACCESS
 SG_ AckState : 12|4@1+ (1,0) [0|15] "" KESSY_KEYLESS_ACCESS
 SG_ ReceivedFrameId : 16|11@1+ (1,0) [0|2047] "" KESSY_KEYLESS_ACCESS
 SG_ ReceivedCounter : 27|4@1+ (1,0) [0|15] "" KESSY_KEYLESS_ACCESS
 SG_ ChecksumOk : 31|1@1+ (1,0) [0|1] "" KESSY_KEYLESS_ACCESS
 SG_ PayloadLength : 32|8@1+ (1,0) [0|64] "byte" KESSY_KEYLESS_ACCESS
 SG_ ErrorCode : 40|8@1+ (1,0) [0|255] "" KESSY_KEYLESS_ACCESS
 SG_ ProcessingTimeUs : 48|16@1+ (1,0) [0|65535] "us" KESSY_KEYLESS_ACCESS
 SG_ ResponseSequence : 64|16@1+ (1,0) [0|65535] "" KESSY_KEYLESS_ACCESS
 SG_ ReceivedCrc : 80|8@1+ (1,0) [0|255] "" KESSY_KEYLESS_ACCESS
 SG_ CalculatedCrc : 88|8@1+ (1,0) [0|255] "" KESSY_KEYLESS_ACCESS

CM_ BO_ 1564 "Cycle=50ms; Channel=CAN0; CAN-FD; NominalBitrate=500kbit/s; DataBitrate=2000kbit/s;  ResponseFor=0x19C; ACK/NACK with CRC, DLC and counter check;";

BO_ 413 DATA_029_KESSY_KEYLESS_ACCESS_KESSY_AUTH_STATUS_TO_DIAG_TESTER: 64 KESSY_KEYLESS_ACCESS
 SG_ CRC8 : 0|8@1+ (1,0) [0|255] "" DIAG_TESTER
 SG_ AliveCounter : 8|4@1+ (1,0) [0|15] "" DIAG_TESTER
 SG_ MuxState : 12|4@1+ (1,0) [0|15] "" DIAG_TESTER
 SG_ SIG_19D_00 : 16|12@1+ (0.1,0.0) [0|4095] "rpm" DIAG_TESTER
 SG_ SIG_19D_01 : 28|12@1+ (0.1,0.0) [0|4095] "rpm" DIAG_TESTER
 SG_ SIG_19D_02 : 40|12@1+ (0.1,0.0) [0|4095] "m" DIAG_TESTER
 SG_ SIG_19D_03 : 52|12@1+ (0.1,0.0) [0|4095] "deg" DIAG_TESTER
 SG_ SIG_19D_04 : 64|12@1+ (0.1,0.0) [0|4095] "V" DIAG_TESTER
 SG_ SIG_19D_05 : 76|12@1+ (0.1,0.0) [0|4095] "V" DIAG_TESTER
 SG_ SIG_19D_06 : 88|12@1+ (0.1,0.0) [0|4095] "obj" DIAG_TESTER
 SG_ SIG_19D_07 : 100|12@1+ (0.1,0.0) [0|4095] "Nm" DIAG_TESTER
 SG_ SIG_19D_08 : 112|12@1+ (0.1,0.0) [0|4095] "A" DIAG_TESTER
 SG_ SIG_19D_09 : 124|12@1+ (0.1,0.0) [0|4095] "Nm" DIAG_TESTER
 SG_ SIG_19D_10 : 136|12@1+ (0.1,0.0) [0|4095] "V" DIAG_TESTER
 SG_ SIG_19D_11 : 148|12@1+ (0.1,0.0) [0|4095] "m" DIAG_TESTER
 SG_ RouteInfoChar_00 : 160|8@1+ (1,0) [0|255] "ascii" DIAG_TESTER
 SG_ RouteInfoChar_01 : 168|8@1+ (1,0) [0|255] "ascii" DIAG_TESTER
 SG_ RouteInfoChar_02 : 176|8@1+ (1,0) [0|255] "ascii" DIAG_TESTER
 SG_ RouteInfoChar_03 : 184|8@1+ (1,0) [0|255] "ascii" DIAG_TESTER
 SG_ RouteInfoChar_04 : 192|8@1+ (1,0) [0|255] "ascii" DIAG_TESTER
 SG_ RouteInfoChar_05 : 200|8@1+ (1,0) [0|255] "ascii" DIAG_TESTER
 SG_ RouteInfoChar_06 : 208|8@1+ (1,0) [0|255] "ascii" DIAG_TESTER
 SG_ RouteInfoChar_07 : 216|8@1+ (1,0) [0|255] "ascii" DIAG_TESTER
 SG_ RouteInfoChar_08 : 224|8@1+ (1,0) [0|255] "ascii" DIAG_TESTER
 SG_ RouteInfoChar_09 : 232|8@1+ (1,0) [0|255] "ascii" DIAG_TESTER
 SG_ RouteInfoChar_10 : 240|8@1+ (1,0) [0|255] "ascii" DIAG_TESTER
 SG_ RouteInfoChar_11 : 248|8@1+ (1,0) [0|255] "ascii" DIAG_TESTER
 SG_ RouteInfoChar_12 : 256|8@1+ (1,0) [0|255] "ascii" DIAG_TESTER
 SG_ RouteInfoChar_13 : 264|8@1+ (1,0) [0|255] "ascii" DIAG_TESTER
 SG_ RouteInfoChar_14 : 272|8@1+ (1,0) [0|255] "ascii" DIAG_TESTER
 SG_ RouteInfoChar_15 : 280|8@1+ (1,0) [0|255] "ascii" DIAG_TESTER
 SG_ RouteInfoChar_16 : 288|8@1+ (1,0) [0|255] "ascii" DIAG_TESTER
 SG_ RouteInfoChar_17 : 296|8@1+ (1,0) [0|255] "ascii" DIAG_TESTER
 SG_ RouteInfoChar_18 : 304|8@1+ (1,0) [0|255] "ascii" DIAG_TESTER
 SG_ RouteInfoChar_19 : 312|8@1+ (1,0) [0|255] "ascii" DIAG_TESTER
 SG_ RouteInfoChar_20 : 320|8@1+ (1,0) [0|255] "ascii" DIAG_TESTER
 SG_ RouteInfoChar_21 : 328|8@1+ (1,0) [0|255] "ascii" DIAG_TESTER
 SG_ RouteInfoChar_22 : 336|8@1+ (1,0) [0|255] "ascii" DIAG_TESTER
 SG_ RouteInfoChar_23 : 344|8@1+ (1,0) [0|255] "ascii" DIAG_TESTER
 SG_ RouteInfoChar_24 : 352|8@1+ (1,0) [0|255] "ascii" DIAG_TESTER
 SG_ RouteInfoChar_25 : 360|8@1+ (1,0) [0|255] "ascii" DIAG_TESTER
 SG_ RouteInfoChar_26 : 368|8@1+ (1,0) [0|255] "ascii" DIAG_TESTER
 SG_ RouteInfoChar_27 : 376|8@1+ (1,0) [0|255] "ascii" DIAG_TESTER
 SG_ RouteInfoChar_28 : 384|8@1+ (1,0) [0|255] "ascii" DIAG_TESTER
 SG_ RouteInfoChar_29 : 392|8@1+ (1,0) [0|255] "ascii" DIAG_TESTER
 SG_ RouteInfoChar_30 : 400|8@1+ (1,0) [0|255] "ascii" DIAG_TESTER
 SG_ RouteInfoChar_31 : 408|8@1+ (1,0) [0|255] "ascii" DIAG_TESTER
 SG_ RouteInfoChar_32 : 416|8@1+ (1,0) [0|255] "ascii" DIAG_TESTER
 SG_ RouteInfoChar_33 : 424|8@1+ (1,0) [0|255] "ascii" DIAG_TESTER
 SG_ RouteInfoChar_34 : 432|8@1+ (1,0) [0|255] "ascii" DIAG_TESTER
 SG_ RouteInfoChar_35 : 440|8@1+ (1,0) [0|255] "ascii" DIAG_TESTER
 SG_ RouteInfoChar_36 : 448|8@1+ (1,0) [0|255] "ascii" DIAG_TESTER
 SG_ RouteInfoChar_37 : 456|8@1+ (1,0) [0|255] "ascii" DIAG_TESTER
 SG_ RouteInfoChar_38 : 464|8@1+ (1,0) [0|255] "ascii" DIAG_TESTER
 SG_ RouteInfoChar_39 : 472|8@1+ (1,0) [0|255] "ascii" DIAG_TESTER
 SG_ RouteInfoChar_40 : 480|8@1+ (1,0) [0|255] "ascii" DIAG_TESTER
 SG_ RouteInfoChar_41 : 488|8@1+ (1,0) [0|255] "ascii" DIAG_TESTER
 SG_ RouteInfoChar_42 : 496|8@1+ (1,0) [0|255] "ascii" DIAG_TESTER
 SG_ RouteInfoChar_43 : 504|8@1+ (1,0) [0|255] "ascii" DIAG_TESTER

CM_ BO_ 413 "Cycle=50ms; Channel=CAN0; CAN-FD; NominalBitrate=500kbit/s; DataBitrate=2000kbit/s;  Data request; receiver answers with response frame; PayloadRouteInfo='KESSY_KEYLESS_ACCESS -> DIAG_TESTER' in bytes 20-63; Gateway to CAN4";

BO_ 1565 RESP_029_DIAG_TESTER_TO_KESSY_KEYLESS_ACCESS: 16 DIAG_TESTER
 SG_ CRC8 : 0|8@1+ (1,0) [0|255] "" KESSY_KEYLESS_ACCESS
 SG_ ResponseCounter : 8|4@1+ (1,0) [0|15] "" KESSY_KEYLESS_ACCESS
 SG_ AckState : 12|4@1+ (1,0) [0|15] "" KESSY_KEYLESS_ACCESS
 SG_ ReceivedFrameId : 16|11@1+ (1,0) [0|2047] "" KESSY_KEYLESS_ACCESS
 SG_ ReceivedCounter : 27|4@1+ (1,0) [0|15] "" KESSY_KEYLESS_ACCESS
 SG_ ChecksumOk : 31|1@1+ (1,0) [0|1] "" KESSY_KEYLESS_ACCESS
 SG_ PayloadLength : 32|8@1+ (1,0) [0|64] "byte" KESSY_KEYLESS_ACCESS
 SG_ ErrorCode : 40|8@1+ (1,0) [0|255] "" KESSY_KEYLESS_ACCESS
 SG_ ProcessingTimeUs : 48|16@1+ (1,0) [0|65535] "us" KESSY_KEYLESS_ACCESS
 SG_ ResponseSequence : 64|16@1+ (1,0) [0|65535] "" KESSY_KEYLESS_ACCESS
 SG_ ReceivedCrc : 80|8@1+ (1,0) [0|255] "" KESSY_KEYLESS_ACCESS
 SG_ CalculatedCrc : 88|8@1+ (1,0) [0|255] "" KESSY_KEYLESS_ACCESS

CM_ BO_ 1565 "Cycle=50ms; Channel=CAN0; CAN-FD; NominalBitrate=500kbit/s; DataBitrate=2000kbit/s;  ResponseFor=0x19D; ACK/NACK with CRC, DLC and counter check;";

BO_ 414 DATA_030_DOOR_MODULE_FL_DOOR_STATUS_TO_BODY_CONTROL_MODULE: 64 DOOR_MODULE_FL
 SG_ CRC8 : 0|8@1+ (1,0) [0|255] "" BODY_CONTROL_MODULE
 SG_ AliveCounter : 8|4@1+ (1,0) [0|15] "" BODY_CONTROL_MODULE
 SG_ MuxState : 12|4@1+ (1,0) [0|15] "" BODY_CONTROL_MODULE
 SG_ SIG_19E_00 : 16|12@1+ (0.1,0.0) [0|4095] "C" BODY_CONTROL_MODULE
 SG_ SIG_19E_01 : 28|12@1+ (0.1,0.0) [0|4095] "V" BODY_CONTROL_MODULE
 SG_ SIG_19E_02 : 40|12@1+ (0.1,0.0) [0|4095] "km/h" BODY_CONTROL_MODULE
 SG_ SIG_19E_03 : 52|12@1+ (0.1,0.0) [0|4095] "rpm" BODY_CONTROL_MODULE
 SG_ SIG_19E_04 : 64|12@1+ (0.1,0.0) [0|4095] "%" BODY_CONTROL_MODULE
 SG_ SIG_19E_05 : 76|12@1+ (0.1,0.0) [0|4095] "V" BODY_CONTROL_MODULE
 SG_ SIG_19E_06 : 88|12@1+ (0.1,0.0) [0|4095] "km/h" BODY_CONTROL_MODULE
 SG_ SIG_19E_07 : 100|12@1+ (0.1,0.0) [0|4095] "km/h" BODY_CONTROL_MODULE
 SG_ SIG_19E_08 : 112|12@1+ (0.1,0.0) [0|4095] "A" BODY_CONTROL_MODULE
 SG_ SIG_19E_09 : 124|12@1+ (0.1,0.0) [0|4095] "deg" BODY_CONTROL_MODULE
 SG_ SIG_19E_10 : 136|12@1+ (0.1,0.0) [0|4095] "V" BODY_CONTROL_MODULE
 SG_ SIG_19E_11 : 148|12@1+ (0.1,0.0) [0|4095] "deg" BODY_CONTROL_MODULE
 SG_ RouteInfoChar_00 : 160|8@1+ (1,0) [0|255] "ascii" BODY_CONTROL_MODULE
 SG_ RouteInfoChar_01 : 168|8@1+ (1,0) [0|255] "ascii" BODY_CONTROL_MODULE
 SG_ RouteInfoChar_02 : 176|8@1+ (1,0) [0|255] "ascii" BODY_CONTROL_MODULE
 SG_ RouteInfoChar_03 : 184|8@1+ (1,0) [0|255] "ascii" BODY_CONTROL_MODULE
 SG_ RouteInfoChar_04 : 192|8@1+ (1,0) [0|255] "ascii" BODY_CONTROL_MODULE
 SG_ RouteInfoChar_05 : 200|8@1+ (1,0) [0|255] "ascii" BODY_CONTROL_MODULE
 SG_ RouteInfoChar_06 : 208|8@1+ (1,0) [0|255] "ascii" BODY_CONTROL_MODULE
 SG_ RouteInfoChar_07 : 216|8@1+ (1,0) [0|255] "ascii" BODY_CONTROL_MODULE
 SG_ RouteInfoChar_08 : 224|8@1+ (1,0) [0|255] "ascii" BODY_CONTROL_MODULE
 SG_ RouteInfoChar_09 : 232|8@1+ (1,0) [0|255] "ascii" BODY_CONTROL_MODULE
 SG_ RouteInfoChar_10 : 240|8@1+ (1,0) [0|255] "ascii" BODY_CONTROL_MODULE
 SG_ RouteInfoChar_11 : 248|8@1+ (1,0) [0|255] "ascii" BODY_CONTROL_MODULE
 SG_ RouteInfoChar_12 : 256|8@1+ (1,0) [0|255] "ascii" BODY_CONTROL_MODULE
 SG_ RouteInfoChar_13 : 264|8@1+ (1,0) [0|255] "ascii" BODY_CONTROL_MODULE
 SG_ RouteInfoChar_14 : 272|8@1+ (1,0) [0|255] "ascii" BODY_CONTROL_MODULE
 SG_ RouteInfoChar_15 : 280|8@1+ (1,0) [0|255] "ascii" BODY_CONTROL_MODULE
 SG_ RouteInfoChar_16 : 288|8@1+ (1,0) [0|255] "ascii" BODY_CONTROL_MODULE
 SG_ RouteInfoChar_17 : 296|8@1+ (1,0) [0|255] "ascii" BODY_CONTROL_MODULE
 SG_ RouteInfoChar_18 : 304|8@1+ (1,0) [0|255] "ascii" BODY_CONTROL_MODULE
 SG_ RouteInfoChar_19 : 312|8@1+ (1,0) [0|255] "ascii" BODY_CONTROL_MODULE
 SG_ RouteInfoChar_20 : 320|8@1+ (1,0) [0|255] "ascii" BODY_CONTROL_MODULE
 SG_ RouteInfoChar_21 : 328|8@1+ (1,0) [0|255] "ascii" BODY_CONTROL_MODULE
 SG_ RouteInfoChar_22 : 336|8@1+ (1,0) [0|255] "ascii" BODY_CONTROL_MODULE
 SG_ RouteInfoChar_23 : 344|8@1+ (1,0) [0|255] "ascii" BODY_CONTROL_MODULE
 SG_ RouteInfoChar_24 : 352|8@1+ (1,0) [0|255] "ascii" BODY_CONTROL_MODULE
 SG_ RouteInfoChar_25 : 360|8@1+ (1,0) [0|255] "ascii" BODY_CONTROL_MODULE
 SG_ RouteInfoChar_26 : 368|8@1+ (1,0) [0|255] "ascii" BODY_CONTROL_MODULE
 SG_ RouteInfoChar_27 : 376|8@1+ (1,0) [0|255] "ascii" BODY_CONTROL_MODULE
 SG_ RouteInfoChar_28 : 384|8@1+ (1,0) [0|255] "ascii" BODY_CONTROL_MODULE
 SG_ RouteInfoChar_29 : 392|8@1+ (1,0) [0|255] "ascii" BODY_CONTROL_MODULE
 SG_ RouteInfoChar_30 : 400|8@1+ (1,0) [0|255] "ascii" BODY_CONTROL_MODULE
 SG_ RouteInfoChar_31 : 408|8@1+ (1,0) [0|255] "ascii" BODY_CONTROL_MODULE
 SG_ RouteInfoChar_32 : 416|8@1+ (1,0) [0|255] "ascii" BODY_CONTROL_MODULE
 SG_ RouteInfoChar_33 : 424|8@1+ (1,0) [0|255] "ascii" BODY_CONTROL_MODULE
 SG_ RouteInfoChar_34 : 432|8@1+ (1,0) [0|255] "ascii" BODY_CONTROL_MODULE
 SG_ RouteInfoChar_35 : 440|8@1+ (1,0) [0|255] "ascii" BODY_CONTROL_MODULE
 SG_ RouteInfoChar_36 : 448|8@1+ (1,0) [0|255] "ascii" BODY_CONTROL_MODULE
 SG_ RouteInfoChar_37 : 456|8@1+ (1,0) [0|255] "ascii" BODY_CONTROL_MODULE
 SG_ RouteInfoChar_38 : 464|8@1+ (1,0) [0|255] "ascii" BODY_CONTROL_MODULE
 SG_ RouteInfoChar_39 : 472|8@1+ (1,0) [0|255] "ascii" BODY_CONTROL_MODULE
 SG_ RouteInfoChar_40 : 480|8@1+ (1,0) [0|255] "ascii" BODY_CONTROL_MODULE
 SG_ RouteInfoChar_41 : 488|8@1+ (1,0) [0|255] "ascii" BODY_CONTROL_MODULE
 SG_ RouteInfoChar_42 : 496|8@1+ (1,0) [0|255] "ascii" BODY_CONTROL_MODULE
 SG_ RouteInfoChar_43 : 504|8@1+ (1,0) [0|255] "ascii" BODY_CONTROL_MODULE

CM_ BO_ 414 "Cycle=50ms; Channel=CAN0; CAN-FD; NominalBitrate=500kbit/s; DataBitrate=2000kbit/s;  Data request; receiver answers with response frame; PayloadRouteInfo='DOOR_MODULE_FL -> BODY_CONTROL_MODULE' in bytes 20-63;";

BO_ 1566 RESP_030_BODY_CONTROL_MODULE_TO_DOOR_MODULE_FL: 16 BODY_CONTROL_MODULE
 SG_ CRC8 : 0|8@1+ (1,0) [0|255] "" DOOR_MODULE_FL
 SG_ ResponseCounter : 8|4@1+ (1,0) [0|15] "" DOOR_MODULE_FL
 SG_ AckState : 12|4@1+ (1,0) [0|15] "" DOOR_MODULE_FL
 SG_ ReceivedFrameId : 16|11@1+ (1,0) [0|2047] "" DOOR_MODULE_FL
 SG_ ReceivedCounter : 27|4@1+ (1,0) [0|15] "" DOOR_MODULE_FL
 SG_ ChecksumOk : 31|1@1+ (1,0) [0|1] "" DOOR_MODULE_FL
 SG_ PayloadLength : 32|8@1+ (1,0) [0|64] "byte" DOOR_MODULE_FL
 SG_ ErrorCode : 40|8@1+ (1,0) [0|255] "" DOOR_MODULE_FL
 SG_ ProcessingTimeUs : 48|16@1+ (1,0) [0|65535] "us" DOOR_MODULE_FL
 SG_ ResponseSequence : 64|16@1+ (1,0) [0|65535] "" DOOR_MODULE_FL
 SG_ ReceivedCrc : 80|8@1+ (1,0) [0|255] "" DOOR_MODULE_FL
 SG_ CalculatedCrc : 88|8@1+ (1,0) [0|255] "" DOOR_MODULE_FL

CM_ BO_ 1566 "Cycle=50ms; Channel=CAN0; CAN-FD; NominalBitrate=500kbit/s; DataBitrate=2000kbit/s;  ResponseFor=0x19E; ACK/NACK with CRC, DLC and counter check;";

BO_ 415 DATA_031_DOOR_MODULE_FL_DOOR_STATUS_TO_INSTRUMENT_CLUSTER_KOMBI: 64 DOOR_MODULE_FL
 SG_ CRC8 : 0|8@1+ (1,0) [0|255] "" INSTRUMENT_CLUSTER_KOMBI
 SG_ AliveCounter : 8|4@1+ (1,0) [0|15] "" INSTRUMENT_CLUSTER_KOMBI
 SG_ MuxState : 12|4@1+ (1,0) [0|15] "" INSTRUMENT_CLUSTER_KOMBI
 SG_ SIG_19F_00 : 16|12@1+ (0.1,0.0) [0|4095] "C" INSTRUMENT_CLUSTER_KOMBI
 SG_ SIG_19F_01 : 28|12@1+ (0.1,0.0) [0|4095] "m" INSTRUMENT_CLUSTER_KOMBI
 SG_ SIG_19F_02 : 40|12@1+ (0.1,0.0) [0|4095] "%" INSTRUMENT_CLUSTER_KOMBI
 SG_ SIG_19F_03 : 52|12@1+ (0.1,0.0) [0|4095] "m" INSTRUMENT_CLUSTER_KOMBI
 SG_ SIG_19F_04 : 64|12@1+ (0.1,0.0) [0|4095] "km/h" INSTRUMENT_CLUSTER_KOMBI
 SG_ SIG_19F_05 : 76|12@1+ (0.1,0.0) [0|4095] "rpm" INSTRUMENT_CLUSTER_KOMBI
 SG_ SIG_19F_06 : 88|12@1+ (0.1,0.0) [0|4095] "rpm" INSTRUMENT_CLUSTER_KOMBI
 SG_ SIG_19F_07 : 100|12@1+ (0.1,0.0) [0|4095] "deg" INSTRUMENT_CLUSTER_KOMBI
 SG_ SIG_19F_08 : 112|12@1+ (0.1,0.0) [0|4095] "m" INSTRUMENT_CLUSTER_KOMBI
 SG_ SIG_19F_09 : 124|12@1+ (0.1,0.0) [0|4095] "km/h" INSTRUMENT_CLUSTER_KOMBI
 SG_ SIG_19F_10 : 136|12@1+ (0.1,0.0) [0|4095] "A" INSTRUMENT_CLUSTER_KOMBI
 SG_ SIG_19F_11 : 148|12@1+ (0.1,0.0) [0|4095] "obj" INSTRUMENT_CLUSTER_KOMBI
 SG_ RouteInfoChar_00 : 160|8@1+ (1,0) [0|255] "ascii" INSTRUMENT_CLUSTER_KOMBI
 SG_ RouteInfoChar_01 : 168|8@1+ (1,0) [0|255] "ascii" INSTRUMENT_CLUSTER_KOMBI
 SG_ RouteInfoChar_02 : 176|8@1+ (1,0) [0|255] "ascii" INSTRUMENT_CLUSTER_KOMBI
 SG_ RouteInfoChar_03 : 184|8@1+ (1,0) [0|255] "ascii" INSTRUMENT_CLUSTER_KOMBI
 SG_ RouteInfoChar_04 : 192|8@1+ (1,0) [0|255] "ascii" INSTRUMENT_CLUSTER_KOMBI
 SG_ RouteInfoChar_05 : 200|8@1+ (1,0) [0|255] "ascii" INSTRUMENT_CLUSTER_KOMBI
 SG_ RouteInfoChar_06 : 208|8@1+ (1,0) [0|255] "ascii" INSTRUMENT_CLUSTER_KOMBI
 SG_ RouteInfoChar_07 : 216|8@1+ (1,0) [0|255] "ascii" INSTRUMENT_CLUSTER_KOMBI
 SG_ RouteInfoChar_08 : 224|8@1+ (1,0) [0|255] "ascii" INSTRUMENT_CLUSTER_KOMBI
 SG_ RouteInfoChar_09 : 232|8@1+ (1,0) [0|255] "ascii" INSTRUMENT_CLUSTER_KOMBI
 SG_ RouteInfoChar_10 : 240|8@1+ (1,0) [0|255] "ascii" INSTRUMENT_CLUSTER_KOMBI
 SG_ RouteInfoChar_11 : 248|8@1+ (1,0) [0|255] "ascii" INSTRUMENT_CLUSTER_KOMBI
 SG_ RouteInfoChar_12 : 256|8@1+ (1,0) [0|255] "ascii" INSTRUMENT_CLUSTER_KOMBI
 SG_ RouteInfoChar_13 : 264|8@1+ (1,0) [0|255] "ascii" INSTRUMENT_CLUSTER_KOMBI
 SG_ RouteInfoChar_14 : 272|8@1+ (1,0) [0|255] "ascii" INSTRUMENT_CLUSTER_KOMBI
 SG_ RouteInfoChar_15 : 280|8@1+ (1,0) [0|255] "ascii" INSTRUMENT_CLUSTER_KOMBI
 SG_ RouteInfoChar_16 : 288|8@1+ (1,0) [0|255] "ascii" INSTRUMENT_CLUSTER_KOMBI
 SG_ RouteInfoChar_17 : 296|8@1+ (1,0) [0|255] "ascii" INSTRUMENT_CLUSTER_KOMBI
 SG_ RouteInfoChar_18 : 304|8@1+ (1,0) [0|255] "ascii" INSTRUMENT_CLUSTER_KOMBI
 SG_ RouteInfoChar_19 : 312|8@1+ (1,0) [0|255] "ascii" INSTRUMENT_CLUSTER_KOMBI
 SG_ RouteInfoChar_20 : 320|8@1+ (1,0) [0|255] "ascii" INSTRUMENT_CLUSTER_KOMBI
 SG_ RouteInfoChar_21 : 328|8@1+ (1,0) [0|255] "ascii" INSTRUMENT_CLUSTER_KOMBI
 SG_ RouteInfoChar_22 : 336|8@1+ (1,0) [0|255] "ascii" INSTRUMENT_CLUSTER_KOMBI
 SG_ RouteInfoChar_23 : 344|8@1+ (1,0) [0|255] "ascii" INSTRUMENT_CLUSTER_KOMBI
 SG_ RouteInfoChar_24 : 352|8@1+ (1,0) [0|255] "ascii" INSTRUMENT_CLUSTER_KOMBI
 SG_ RouteInfoChar_25 : 360|8@1+ (1,0) [0|255] "ascii" INSTRUMENT_CLUSTER_KOMBI
 SG_ RouteInfoChar_26 : 368|8@1+ (1,0) [0|255] "ascii" INSTRUMENT_CLUSTER_KOMBI
 SG_ RouteInfoChar_27 : 376|8@1+ (1,0) [0|255] "ascii" INSTRUMENT_CLUSTER_KOMBI
 SG_ RouteInfoChar_28 : 384|8@1+ (1,0) [0|255] "ascii" INSTRUMENT_CLUSTER_KOMBI
 SG_ RouteInfoChar_29 : 392|8@1+ (1,0) [0|255] "ascii" INSTRUMENT_CLUSTER_KOMBI
 SG_ RouteInfoChar_30 : 400|8@1+ (1,0) [0|255] "ascii" INSTRUMENT_CLUSTER_KOMBI
 SG_ RouteInfoChar_31 : 408|8@1+ (1,0) [0|255] "ascii" INSTRUMENT_CLUSTER_KOMBI
 SG_ RouteInfoChar_32 : 416|8@1+ (1,0) [0|255] "ascii" INSTRUMENT_CLUSTER_KOMBI
 SG_ RouteInfoChar_33 : 424|8@1+ (1,0) [0|255] "ascii" INSTRUMENT_CLUSTER_KOMBI
 SG_ RouteInfoChar_34 : 432|8@1+ (1,0) [0|255] "ascii" INSTRUMENT_CLUSTER_KOMBI
 SG_ RouteInfoChar_35 : 440|8@1+ (1,0) [0|255] "ascii" INSTRUMENT_CLUSTER_KOMBI
 SG_ RouteInfoChar_36 : 448|8@1+ (1,0) [0|255] "ascii" INSTRUMENT_CLUSTER_KOMBI
 SG_ RouteInfoChar_37 : 456|8@1+ (1,0) [0|255] "ascii" INSTRUMENT_CLUSTER_KOMBI
 SG_ RouteInfoChar_38 : 464|8@1+ (1,0) [0|255] "ascii" INSTRUMENT_CLUSTER_KOMBI
 SG_ RouteInfoChar_39 : 472|8@1+ (1,0) [0|255] "ascii" INSTRUMENT_CLUSTER_KOMBI
 SG_ RouteInfoChar_40 : 480|8@1+ (1,0) [0|255] "ascii" INSTRUMENT_CLUSTER_KOMBI
 SG_ RouteInfoChar_41 : 488|8@1+ (1,0) [0|255] "ascii" INSTRUMENT_CLUSTER_KOMBI
 SG_ RouteInfoChar_42 : 496|8@1+ (1,0) [0|255] "ascii" INSTRUMENT_CLUSTER_KOMBI
 SG_ RouteInfoChar_43 : 504|8@1+ (1,0) [0|255] "ascii" INSTRUMENT_CLUSTER_KOMBI

CM_ BO_ 415 "Cycle=20ms; Channel=CAN0; CAN-FD; NominalBitrate=500kbit/s; DataBitrate=2000kbit/s;  Data request; receiver answers with response frame; PayloadRouteInfo='DOOR_MODULE_FL -> INSTRUMENT_CLUSTER_KOMBI' in bytes 20-63; Gateway to CAN3";

BO_ 1567 RESP_031_INSTRUMENT_CLUSTER_KOMBI_TO_DOOR_MODULE_FL: 16 INSTRUMENT_CLUSTER_KOMBI
 SG_ CRC8 : 0|8@1+ (1,0) [0|255] "" DOOR_MODULE_FL
 SG_ ResponseCounter : 8|4@1+ (1,0) [0|15] "" DOOR_MODULE_FL
 SG_ AckState : 12|4@1+ (1,0) [0|15] "" DOOR_MODULE_FL
 SG_ ReceivedFrameId : 16|11@1+ (1,0) [0|2047] "" DOOR_MODULE_FL
 SG_ ReceivedCounter : 27|4@1+ (1,0) [0|15] "" DOOR_MODULE_FL
 SG_ ChecksumOk : 31|1@1+ (1,0) [0|1] "" DOOR_MODULE_FL
 SG_ PayloadLength : 32|8@1+ (1,0) [0|64] "byte" DOOR_MODULE_FL
 SG_ ErrorCode : 40|8@1+ (1,0) [0|255] "" DOOR_MODULE_FL
 SG_ ProcessingTimeUs : 48|16@1+ (1,0) [0|65535] "us" DOOR_MODULE_FL
 SG_ ResponseSequence : 64|16@1+ (1,0) [0|65535] "" DOOR_MODULE_FL
 SG_ ReceivedCrc : 80|8@1+ (1,0) [0|255] "" DOOR_MODULE_FL
 SG_ CalculatedCrc : 88|8@1+ (1,0) [0|255] "" DOOR_MODULE_FL

CM_ BO_ 1567 "Cycle=20ms; Channel=CAN0; CAN-FD; NominalBitrate=500kbit/s; DataBitrate=2000kbit/s;  ResponseFor=0x19F; ACK/NACK with CRC, DLC and counter check;";

BO_ 416 DATA_032_DOOR_MODULE_FL_WINDOW_STATUS_TO_BODY_CONTROL_MODULE: 64 DOOR_MODULE_FL
 SG_ CRC8 : 0|8@1+ (1,0) [0|255] "" BODY_CONTROL_MODULE
 SG_ AliveCounter : 8|4@1+ (1,0) [0|15] "" BODY_CONTROL_MODULE
 SG_ MuxState : 12|4@1+ (1,0) [0|15] "" BODY_CONTROL_MODULE
 SG_ SIG_1A0_00 : 16|12@1+ (0.1,0.0) [0|4095] "m" BODY_CONTROL_MODULE
 SG_ SIG_1A0_01 : 28|12@1+ (0.1,0.0) [0|4095] "deg" BODY_CONTROL_MODULE
 SG_ SIG_1A0_02 : 40|12@1+ (0.1,0.0) [0|4095] "%" BODY_CONTROL_MODULE
 SG_ SIG_1A0_03 : 52|12@1+ (0.1,0.0) [0|4095] "deg" BODY_CONTROL_MODULE
 SG_ SIG_1A0_04 : 64|12@1+ (0.1,0.0) [0|4095] "km/h" BODY_CONTROL_MODULE
 SG_ SIG_1A0_05 : 76|12@1+ (0.1,0.0) [0|4095] "V" BODY_CONTROL_MODULE
 SG_ SIG_1A0_06 : 88|12@1+ (0.1,0.0) [0|4095] "A" BODY_CONTROL_MODULE
 SG_ SIG_1A0_07 : 100|12@1+ (0.1,0.0) [0|4095] "km/h" BODY_CONTROL_MODULE
 SG_ SIG_1A0_08 : 112|12@1+ (0.1,0.0) [0|4095] "A" BODY_CONTROL_MODULE
 SG_ SIG_1A0_09 : 124|12@1+ (0.1,0.0) [0|4095] "Nm" BODY_CONTROL_MODULE
 SG_ SIG_1A0_10 : 136|12@1+ (0.1,0.0) [0|4095] "Nm" BODY_CONTROL_MODULE
 SG_ SIG_1A0_11 : 148|12@1+ (0.1,0.0) [0|4095] "rpm" BODY_CONTROL_MODULE
 SG_ RouteInfoChar_00 : 160|8@1+ (1,0) [0|255] "ascii" BODY_CONTROL_MODULE
 SG_ RouteInfoChar_01 : 168|8@1+ (1,0) [0|255] "ascii" BODY_CONTROL_MODULE
 SG_ RouteInfoChar_02 : 176|8@1+ (1,0) [0|255] "ascii" BODY_CONTROL_MODULE
 SG_ RouteInfoChar_03 : 184|8@1+ (1,0) [0|255] "ascii" BODY_CONTROL_MODULE
 SG_ RouteInfoChar_04 : 192|8@1+ (1,0) [0|255] "ascii" BODY_CONTROL_MODULE
 SG_ RouteInfoChar_05 : 200|8@1+ (1,0) [0|255] "ascii" BODY_CONTROL_MODULE
 SG_ RouteInfoChar_06 : 208|8@1+ (1,0) [0|255] "ascii" BODY_CONTROL_MODULE
 SG_ RouteInfoChar_07 : 216|8@1+ (1,0) [0|255] "ascii" BODY_CONTROL_MODULE
 SG_ RouteInfoChar_08 : 224|8@1+ (1,0) [0|255] "ascii" BODY_CONTROL_MODULE
 SG_ RouteInfoChar_09 : 232|8@1+ (1,0) [0|255] "ascii" BODY_CONTROL_MODULE
 SG_ RouteInfoChar_10 : 240|8@1+ (1,0) [0|255] "ascii" BODY_CONTROL_MODULE
 SG_ RouteInfoChar_11 : 248|8@1+ (1,0) [0|255] "ascii" BODY_CONTROL_MODULE
 SG_ RouteInfoChar_12 : 256|8@1+ (1,0) [0|255] "ascii" BODY_CONTROL_MODULE
 SG_ RouteInfoChar_13 : 264|8@1+ (1,0) [0|255] "ascii" BODY_CONTROL_MODULE
 SG_ RouteInfoChar_14 : 272|8@1+ (1,0) [0|255] "ascii" BODY_CONTROL_MODULE
 SG_ RouteInfoChar_15 : 280|8@1+ (1,0) [0|255] "ascii" BODY_CONTROL_MODULE
 SG_ RouteInfoChar_16 : 288|8@1+ (1,0) [0|255] "ascii" BODY_CONTROL_MODULE
 SG_ RouteInfoChar_17 : 296|8@1+ (1,0) [0|255] "ascii" BODY_CONTROL_MODULE
 SG_ RouteInfoChar_18 : 304|8@1+ (1,0) [0|255] "ascii" BODY_CONTROL_MODULE
 SG_ RouteInfoChar_19 : 312|8@1+ (1,0) [0|255] "ascii" BODY_CONTROL_MODULE
 SG_ RouteInfoChar_20 : 320|8@1+ (1,0) [0|255] "ascii" BODY_CONTROL_MODULE
 SG_ RouteInfoChar_21 : 328|8@1+ (1,0) [0|255] "ascii" BODY_CONTROL_MODULE
 SG_ RouteInfoChar_22 : 336|8@1+ (1,0) [0|255] "ascii" BODY_CONTROL_MODULE
 SG_ RouteInfoChar_23 : 344|8@1+ (1,0) [0|255] "ascii" BODY_CONTROL_MODULE
 SG_ RouteInfoChar_24 : 352|8@1+ (1,0) [0|255] "ascii" BODY_CONTROL_MODULE
 SG_ RouteInfoChar_25 : 360|8@1+ (1,0) [0|255] "ascii" BODY_CONTROL_MODULE
 SG_ RouteInfoChar_26 : 368|8@1+ (1,0) [0|255] "ascii" BODY_CONTROL_MODULE
 SG_ RouteInfoChar_27 : 376|8@1+ (1,0) [0|255] "ascii" BODY_CONTROL_MODULE
 SG_ RouteInfoChar_28 : 384|8@1+ (1,0) [0|255] "ascii" BODY_CONTROL_MODULE
 SG_ RouteInfoChar_29 : 392|8@1+ (1,0) [0|255] "ascii" BODY_CONTROL_MODULE
 SG_ RouteInfoChar_30 : 400|8@1+ (1,0) [0|255] "ascii" BODY_CONTROL_MODULE
 SG_ RouteInfoChar_31 : 408|8@1+ (1,0) [0|255] "ascii" BODY_CONTROL_MODULE
 SG_ RouteInfoChar_32 : 416|8@1+ (1,0) [0|255] "ascii" BODY_CONTROL_MODULE
 SG_ RouteInfoChar_33 : 424|8@1+ (1,0) [0|255] "ascii" BODY_CONTROL_MODULE
 SG_ RouteInfoChar_34 : 432|8@1+ (1,0) [0|255] "ascii" BODY_CONTROL_MODULE
 SG_ RouteInfoChar_35 : 440|8@1+ (1,0) [0|255] "ascii" BODY_CONTROL_MODULE
 SG_ RouteInfoChar_36 : 448|8@1+ (1,0) [0|255] "ascii" BODY_CONTROL_MODULE
 SG_ RouteInfoChar_37 : 456|8@1+ (1,0) [0|255] "ascii" BODY_CONTROL_MODULE
 SG_ RouteInfoChar_38 : 464|8@1+ (1,0) [0|255] "ascii" BODY_CONTROL_MODULE
 SG_ RouteInfoChar_39 : 472|8@1+ (1,0) [0|255] "ascii" BODY_CONTROL_MODULE
 SG_ RouteInfoChar_40 : 480|8@1+ (1,0) [0|255] "ascii" BODY_CONTROL_MODULE
 SG_ RouteInfoChar_41 : 488|8@1+ (1,0) [0|255] "ascii" BODY_CONTROL_MODULE
 SG_ RouteInfoChar_42 : 496|8@1+ (1,0) [0|255] "ascii" BODY_CONTROL_MODULE
 SG_ RouteInfoChar_43 : 504|8@1+ (1,0) [0|255] "ascii" BODY_CONTROL_MODULE

CM_ BO_ 416 "Cycle=50ms; Channel=CAN0; CAN-FD; NominalBitrate=500kbit/s; DataBitrate=2000kbit/s;  Data request; receiver answers with response frame; PayloadRouteInfo='DOOR_MODULE_FL -> BODY_CONTROL_MODULE' in bytes 20-63;";

BO_ 1568 RESP_032_BODY_CONTROL_MODULE_TO_DOOR_MODULE_FL: 16 BODY_CONTROL_MODULE
 SG_ CRC8 : 0|8@1+ (1,0) [0|255] "" DOOR_MODULE_FL
 SG_ ResponseCounter : 8|4@1+ (1,0) [0|15] "" DOOR_MODULE_FL
 SG_ AckState : 12|4@1+ (1,0) [0|15] "" DOOR_MODULE_FL
 SG_ ReceivedFrameId : 16|11@1+ (1,0) [0|2047] "" DOOR_MODULE_FL
 SG_ ReceivedCounter : 27|4@1+ (1,0) [0|15] "" DOOR_MODULE_FL
 SG_ ChecksumOk : 31|1@1+ (1,0) [0|1] "" DOOR_MODULE_FL
 SG_ PayloadLength : 32|8@1+ (1,0) [0|64] "byte" DOOR_MODULE_FL
 SG_ ErrorCode : 40|8@1+ (1,0) [0|255] "" DOOR_MODULE_FL
 SG_ ProcessingTimeUs : 48|16@1+ (1,0) [0|65535] "us" DOOR_MODULE_FL
 SG_ ResponseSequence : 64|16@1+ (1,0) [0|65535] "" DOOR_MODULE_FL
 SG_ ReceivedCrc : 80|8@1+ (1,0) [0|255] "" DOOR_MODULE_FL
 SG_ CalculatedCrc : 88|8@1+ (1,0) [0|255] "" DOOR_MODULE_FL

CM_ BO_ 1568 "Cycle=50ms; Channel=CAN0; CAN-FD; NominalBitrate=500kbit/s; DataBitrate=2000kbit/s;  ResponseFor=0x1A0; ACK/NACK with CRC, DLC and counter check;";

BO_ 417 DATA_033_DOOR_MODULE_FL_LOCK_STATUS_TO_BODY_CONTROL_MODULE: 64 DOOR_MODULE_FL
 SG_ CRC8 : 0|8@1+ (1,0) [0|255] "" BODY_CONTROL_MODULE
 SG_ AliveCounter : 8|4@1+ (1,0) [0|15] "" BODY_CONTROL_MODULE
 SG_ MuxState : 12|4@1+ (1,0) [0|15] "" BODY_CONTROL_MODULE
 SG_ SIG_1A1_00 : 16|12@1+ (0.1,0.0) [0|4095] "A" BODY_CONTROL_MODULE
 SG_ SIG_1A1_01 : 28|12@1+ (0.1,0.0) [0|4095] "m" BODY_CONTROL_MODULE
 SG_ SIG_1A1_02 : 40|12@1+ (0.1,0.0) [0|4095] "%" BODY_CONTROL_MODULE
 SG_ SIG_1A1_03 : 52|12@1+ (0.1,0.0) [0|4095] "obj" BODY_CONTROL_MODULE
 SG_ SIG_1A1_04 : 64|12@1+ (0.1,0.0) [0|4095] "deg" BODY_CONTROL_MODULE
 SG_ SIG_1A1_05 : 76|12@1+ (0.1,0.0) [0|4095] "Nm" BODY_CONTROL_MODULE
 SG_ SIG_1A1_06 : 88|12@1+ (0.1,0.0) [0|4095] "deg" BODY_CONTROL_MODULE
 SG_ SIG_1A1_07 : 100|12@1+ (0.1,0.0) [0|4095] "deg" BODY_CONTROL_MODULE
 SG_ SIG_1A1_08 : 112|12@1+ (0.1,0.0) [0|4095] "%" BODY_CONTROL_MODULE
 SG_ SIG_1A1_09 : 124|12@1+ (0.1,0.0) [0|4095] "km/h" BODY_CONTROL_MODULE
 SG_ SIG_1A1_10 : 136|12@1+ (0.1,0.0) [0|4095] "deg" BODY_CONTROL_MODULE
 SG_ SIG_1A1_11 : 148|12@1+ (0.1,0.0) [0|4095] "A" BODY_CONTROL_MODULE
 SG_ RouteInfoChar_00 : 160|8@1+ (1,0) [0|255] "ascii" BODY_CONTROL_MODULE
 SG_ RouteInfoChar_01 : 168|8@1+ (1,0) [0|255] "ascii" BODY_CONTROL_MODULE
 SG_ RouteInfoChar_02 : 176|8@1+ (1,0) [0|255] "ascii" BODY_CONTROL_MODULE
 SG_ RouteInfoChar_03 : 184|8@1+ (1,0) [0|255] "ascii" BODY_CONTROL_MODULE
 SG_ RouteInfoChar_04 : 192|8@1+ (1,0) [0|255] "ascii" BODY_CONTROL_MODULE
 SG_ RouteInfoChar_05 : 200|8@1+ (1,0) [0|255] "ascii" BODY_CONTROL_MODULE
 SG_ RouteInfoChar_06 : 208|8@1+ (1,0) [0|255] "ascii" BODY_CONTROL_MODULE
 SG_ RouteInfoChar_07 : 216|8@1+ (1,0) [0|255] "ascii" BODY_CONTROL_MODULE
 SG_ RouteInfoChar_08 : 224|8@1+ (1,0) [0|255] "ascii" BODY_CONTROL_MODULE
 SG_ RouteInfoChar_09 : 232|8@1+ (1,0) [0|255] "ascii" BODY_CONTROL_MODULE
 SG_ RouteInfoChar_10 : 240|8@1+ (1,0) [0|255] "ascii" BODY_CONTROL_MODULE
 SG_ RouteInfoChar_11 : 248|8@1+ (1,0) [0|255] "ascii" BODY_CONTROL_MODULE
 SG_ RouteInfoChar_12 : 256|8@1+ (1,0) [0|255] "ascii" BODY_CONTROL_MODULE
 SG_ RouteInfoChar_13 : 264|8@1+ (1,0) [0|255] "ascii" BODY_CONTROL_MODULE
 SG_ RouteInfoChar_14 : 272|8@1+ (1,0) [0|255] "ascii" BODY_CONTROL_MODULE
 SG_ RouteInfoChar_15 : 280|8@1+ (1,0) [0|255] "ascii" BODY_CONTROL_MODULE
 SG_ RouteInfoChar_16 : 288|8@1+ (1,0) [0|255] "ascii" BODY_CONTROL_MODULE
 SG_ RouteInfoChar_17 : 296|8@1+ (1,0) [0|255] "ascii" BODY_CONTROL_MODULE
 SG_ RouteInfoChar_18 : 304|8@1+ (1,0) [0|255] "ascii" BODY_CONTROL_MODULE
 SG_ RouteInfoChar_19 : 312|8@1+ (1,0) [0|255] "ascii" BODY_CONTROL_MODULE
 SG_ RouteInfoChar_20 : 320|8@1+ (1,0) [0|255] "ascii" BODY_CONTROL_MODULE
 SG_ RouteInfoChar_21 : 328|8@1+ (1,0) [0|255] "ascii" BODY_CONTROL_MODULE
 SG_ RouteInfoChar_22 : 336|8@1+ (1,0) [0|255] "ascii" BODY_CONTROL_MODULE
 SG_ RouteInfoChar_23 : 344|8@1+ (1,0) [0|255] "ascii" BODY_CONTROL_MODULE
 SG_ RouteInfoChar_24 : 352|8@1+ (1,0) [0|255] "ascii" BODY_CONTROL_MODULE
 SG_ RouteInfoChar_25 : 360|8@1+ (1,0) [0|255] "ascii" BODY_CONTROL_MODULE
 SG_ RouteInfoChar_26 : 368|8@1+ (1,0) [0|255] "ascii" BODY_CONTROL_MODULE
 SG_ RouteInfoChar_27 : 376|8@1+ (1,0) [0|255] "ascii" BODY_CONTROL_MODULE
 SG_ RouteInfoChar_28 : 384|8@1+ (1,0) [0|255] "ascii" BODY_CONTROL_MODULE
 SG_ RouteInfoChar_29 : 392|8@1+ (1,0) [0|255] "ascii" BODY_CONTROL_MODULE
 SG_ RouteInfoChar_30 : 400|8@1+ (1,0) [0|255] "ascii" BODY_CONTROL_MODULE
 SG_ RouteInfoChar_31 : 408|8@1+ (1,0) [0|255] "ascii" BODY_CONTROL_MODULE
 SG_ RouteInfoChar_32 : 416|8@1+ (1,0) [0|255] "ascii" BODY_CONTROL_MODULE
 SG_ RouteInfoChar_33 : 424|8@1+ (1,0) [0|255] "ascii" BODY_CONTROL_MODULE
 SG_ RouteInfoChar_34 : 432|8@1+ (1,0) [0|255] "ascii" BODY_CONTROL_MODULE
 SG_ RouteInfoChar_35 : 440|8@1+ (1,0) [0|255] "ascii" BODY_CONTROL_MODULE
 SG_ RouteInfoChar_36 : 448|8@1+ (1,0) [0|255] "ascii" BODY_CONTROL_MODULE
 SG_ RouteInfoChar_37 : 456|8@1+ (1,0) [0|255] "ascii" BODY_CONTROL_MODULE
 SG_ RouteInfoChar_38 : 464|8@1+ (1,0) [0|255] "ascii" BODY_CONTROL_MODULE
 SG_ RouteInfoChar_39 : 472|8@1+ (1,0) [0|255] "ascii" BODY_CONTROL_MODULE
 SG_ RouteInfoChar_40 : 480|8@1+ (1,0) [0|255] "ascii" BODY_CONTROL_MODULE
 SG_ RouteInfoChar_41 : 488|8@1+ (1,0) [0|255] "ascii" BODY_CONTROL_MODULE
 SG_ RouteInfoChar_42 : 496|8@1+ (1,0) [0|255] "ascii" BODY_CONTROL_MODULE
 SG_ RouteInfoChar_43 : 504|8@1+ (1,0) [0|255] "ascii" BODY_CONTROL_MODULE

CM_ BO_ 417 "Cycle=50ms; Channel=CAN0; CAN-FD; NominalBitrate=500kbit/s; DataBitrate=2000kbit/s;  Data request; receiver answers with response frame; PayloadRouteInfo='DOOR_MODULE_FL -> BODY_CONTROL_MODULE' in bytes 20-63;";

BO_ 1569 RESP_033_BODY_CONTROL_MODULE_TO_DOOR_MODULE_FL: 16 BODY_CONTROL_MODULE
 SG_ CRC8 : 0|8@1+ (1,0) [0|255] "" DOOR_MODULE_FL
 SG_ ResponseCounter : 8|4@1+ (1,0) [0|15] "" DOOR_MODULE_FL
 SG_ AckState : 12|4@1+ (1,0) [0|15] "" DOOR_MODULE_FL
 SG_ ReceivedFrameId : 16|11@1+ (1,0) [0|2047] "" DOOR_MODULE_FL
 SG_ ReceivedCounter : 27|4@1+ (1,0) [0|15] "" DOOR_MODULE_FL
 SG_ ChecksumOk : 31|1@1+ (1,0) [0|1] "" DOOR_MODULE_FL
 SG_ PayloadLength : 32|8@1+ (1,0) [0|64] "byte" DOOR_MODULE_FL
 SG_ ErrorCode : 40|8@1+ (1,0) [0|255] "" DOOR_MODULE_FL
 SG_ ProcessingTimeUs : 48|16@1+ (1,0) [0|65535] "us" DOOR_MODULE_FL
 SG_ ResponseSequence : 64|16@1+ (1,0) [0|65535] "" DOOR_MODULE_FL
 SG_ ReceivedCrc : 80|8@1+ (1,0) [0|255] "" DOOR_MODULE_FL
 SG_ CalculatedCrc : 88|8@1+ (1,0) [0|255] "" DOOR_MODULE_FL

CM_ BO_ 1569 "Cycle=50ms; Channel=CAN0; CAN-FD; NominalBitrate=500kbit/s; DataBitrate=2000kbit/s;  ResponseFor=0x1A1; ACK/NACK with CRC, DLC and counter check;";

BO_ 418 DATA_034_DOOR_MODULE_FR_DOOR_STATUS_TO_BODY_CONTROL_MODULE: 64 DOOR_MODULE_FR
 SG_ CRC8 : 0|8@1+ (1,0) [0|255] "" BODY_CONTROL_MODULE
 SG_ AliveCounter : 8|4@1+ (1,0) [0|15] "" BODY_CONTROL_MODULE
 SG_ MuxState : 12|4@1+ (1,0) [0|15] "" BODY_CONTROL_MODULE
 SG_ SIG_1A2_00 : 16|12@1+ (0.1,0.0) [0|4095] "%" BODY_CONTROL_MODULE
 SG_ SIG_1A2_01 : 28|12@1+ (0.1,0.0) [0|4095] "Nm" BODY_CONTROL_MODULE
 SG_ SIG_1A2_02 : 40|12@1+ (0.1,0.0) [0|4095] "V" BODY_CONTROL_MODULE
 SG_ SIG_1A2_03 : 52|12@1+ (0.1,0.0) [0|4095] "deg" BODY_CONTROL_MODULE
 SG_ SIG_1A2_04 : 64|12@1+ (0.1,0.0) [0|4095] "rpm" BODY_CONTROL_MODULE
 SG_ SIG_1A2_05 : 76|12@1+ (0.1,0.0) [0|4095] "%" BODY_CONTROL_MODULE
 SG_ SIG_1A2_06 : 88|12@1+ (0.1,0.0) [0|4095] "km/h" BODY_CONTROL_MODULE
 SG_ SIG_1A2_07 : 100|12@1+ (0.1,0.0) [0|4095] "C" BODY_CONTROL_MODULE
 SG_ SIG_1A2_08 : 112|12@1+ (0.1,0.0) [0|4095] "Nm" BODY_CONTROL_MODULE
 SG_ SIG_1A2_09 : 124|12@1+ (0.1,0.0) [0|4095] "Nm" BODY_CONTROL_MODULE
 SG_ SIG_1A2_10 : 136|12@1+ (0.1,0.0) [0|4095] "C" BODY_CONTROL_MODULE
 SG_ SIG_1A2_11 : 148|12@1+ (0.1,0.0) [0|4095] "A" BODY_CONTROL_MODULE
 SG_ RouteInfoChar_00 : 160|8@1+ (1,0) [0|255] "ascii" BODY_CONTROL_MODULE
 SG_ RouteInfoChar_01 : 168|8@1+ (1,0) [0|255] "ascii" BODY_CONTROL_MODULE
 SG_ RouteInfoChar_02 : 176|8@1+ (1,0) [0|255] "ascii" BODY_CONTROL_MODULE
 SG_ RouteInfoChar_03 : 184|8@1+ (1,0) [0|255] "ascii" BODY_CONTROL_MODULE
 SG_ RouteInfoChar_04 : 192|8@1+ (1,0) [0|255] "ascii" BODY_CONTROL_MODULE
 SG_ RouteInfoChar_05 : 200|8@1+ (1,0) [0|255] "ascii" BODY_CONTROL_MODULE
 SG_ RouteInfoChar_06 : 208|8@1+ (1,0) [0|255] "ascii" BODY_CONTROL_MODULE
 SG_ RouteInfoChar_07 : 216|8@1+ (1,0) [0|255] "ascii" BODY_CONTROL_MODULE
 SG_ RouteInfoChar_08 : 224|8@1+ (1,0) [0|255] "ascii" BODY_CONTROL_MODULE
 SG_ RouteInfoChar_09 : 232|8@1+ (1,0) [0|255] "ascii" BODY_CONTROL_MODULE
 SG_ RouteInfoChar_10 : 240|8@1+ (1,0) [0|255] "ascii" BODY_CONTROL_MODULE
 SG_ RouteInfoChar_11 : 248|8@1+ (1,0) [0|255] "ascii" BODY_CONTROL_MODULE
 SG_ RouteInfoChar_12 : 256|8@1+ (1,0) [0|255] "ascii" BODY_CONTROL_MODULE
 SG_ RouteInfoChar_13 : 264|8@1+ (1,0) [0|255] "ascii" BODY_CONTROL_MODULE
 SG_ RouteInfoChar_14 : 272|8@1+ (1,0) [0|255] "ascii" BODY_CONTROL_MODULE
 SG_ RouteInfoChar_15 : 280|8@1+ (1,0) [0|255] "ascii" BODY_CONTROL_MODULE
 SG_ RouteInfoChar_16 : 288|8@1+ (1,0) [0|255] "ascii" BODY_CONTROL_MODULE
 SG_ RouteInfoChar_17 : 296|8@1+ (1,0) [0|255] "ascii" BODY_CONTROL_MODULE
 SG_ RouteInfoChar_18 : 304|8@1+ (1,0) [0|255] "ascii" BODY_CONTROL_MODULE
 SG_ RouteInfoChar_19 : 312|8@1+ (1,0) [0|255] "ascii" BODY_CONTROL_MODULE
 SG_ RouteInfoChar_20 : 320|8@1+ (1,0) [0|255] "ascii" BODY_CONTROL_MODULE
 SG_ RouteInfoChar_21 : 328|8@1+ (1,0) [0|255] "ascii" BODY_CONTROL_MODULE
 SG_ RouteInfoChar_22 : 336|8@1+ (1,0) [0|255] "ascii" BODY_CONTROL_MODULE
 SG_ RouteInfoChar_23 : 344|8@1+ (1,0) [0|255] "ascii" BODY_CONTROL_MODULE
 SG_ RouteInfoChar_24 : 352|8@1+ (1,0) [0|255] "ascii" BODY_CONTROL_MODULE
 SG_ RouteInfoChar_25 : 360|8@1+ (1,0) [0|255] "ascii" BODY_CONTROL_MODULE
 SG_ RouteInfoChar_26 : 368|8@1+ (1,0) [0|255] "ascii" BODY_CONTROL_MODULE
 SG_ RouteInfoChar_27 : 376|8@1+ (1,0) [0|255] "ascii" BODY_CONTROL_MODULE
 SG_ RouteInfoChar_28 : 384|8@1+ (1,0) [0|255] "ascii" BODY_CONTROL_MODULE
 SG_ RouteInfoChar_29 : 392|8@1+ (1,0) [0|255] "ascii" BODY_CONTROL_MODULE
 SG_ RouteInfoChar_30 : 400|8@1+ (1,0) [0|255] "ascii" BODY_CONTROL_MODULE
 SG_ RouteInfoChar_31 : 408|8@1+ (1,0) [0|255] "ascii" BODY_CONTROL_MODULE
 SG_ RouteInfoChar_32 : 416|8@1+ (1,0) [0|255] "ascii" BODY_CONTROL_MODULE
 SG_ RouteInfoChar_33 : 424|8@1+ (1,0) [0|255] "ascii" BODY_CONTROL_MODULE
 SG_ RouteInfoChar_34 : 432|8@1+ (1,0) [0|255] "ascii" BODY_CONTROL_MODULE
 SG_ RouteInfoChar_35 : 440|8@1+ (1,0) [0|255] "ascii" BODY_CONTROL_MODULE
 SG_ RouteInfoChar_36 : 448|8@1+ (1,0) [0|255] "ascii" BODY_CONTROL_MODULE
 SG_ RouteInfoChar_37 : 456|8@1+ (1,0) [0|255] "ascii" BODY_CONTROL_MODULE
 SG_ RouteInfoChar_38 : 464|8@1+ (1,0) [0|255] "ascii" BODY_CONTROL_MODULE
 SG_ RouteInfoChar_39 : 472|8@1+ (1,0) [0|255] "ascii" BODY_CONTROL_MODULE
 SG_ RouteInfoChar_40 : 480|8@1+ (1,0) [0|255] "ascii" BODY_CONTROL_MODULE
 SG_ RouteInfoChar_41 : 488|8@1+ (1,0) [0|255] "ascii" BODY_CONTROL_MODULE
 SG_ RouteInfoChar_42 : 496|8@1+ (1,0) [0|255] "ascii" BODY_CONTROL_MODULE
 SG_ RouteInfoChar_43 : 504|8@1+ (1,0) [0|255] "ascii" BODY_CONTROL_MODULE

CM_ BO_ 418 "Cycle=50ms; Channel=CAN0; CAN-FD; NominalBitrate=500kbit/s; DataBitrate=2000kbit/s;  Data request; receiver answers with response frame; PayloadRouteInfo='DOOR_MODULE_FR -> BODY_CONTROL_MODULE' in bytes 20-63;";

BO_ 1570 RESP_034_BODY_CONTROL_MODULE_TO_DOOR_MODULE_FR: 16 BODY_CONTROL_MODULE
 SG_ CRC8 : 0|8@1+ (1,0) [0|255] "" DOOR_MODULE_FR
 SG_ ResponseCounter : 8|4@1+ (1,0) [0|15] "" DOOR_MODULE_FR
 SG_ AckState : 12|4@1+ (1,0) [0|15] "" DOOR_MODULE_FR
 SG_ ReceivedFrameId : 16|11@1+ (1,0) [0|2047] "" DOOR_MODULE_FR
 SG_ ReceivedCounter : 27|4@1+ (1,0) [0|15] "" DOOR_MODULE_FR
 SG_ ChecksumOk : 31|1@1+ (1,0) [0|1] "" DOOR_MODULE_FR
 SG_ PayloadLength : 32|8@1+ (1,0) [0|64] "byte" DOOR_MODULE_FR
 SG_ ErrorCode : 40|8@1+ (1,0) [0|255] "" DOOR_MODULE_FR
 SG_ ProcessingTimeUs : 48|16@1+ (1,0) [0|65535] "us" DOOR_MODULE_FR
 SG_ ResponseSequence : 64|16@1+ (1,0) [0|65535] "" DOOR_MODULE_FR
 SG_ ReceivedCrc : 80|8@1+ (1,0) [0|255] "" DOOR_MODULE_FR
 SG_ CalculatedCrc : 88|8@1+ (1,0) [0|255] "" DOOR_MODULE_FR

CM_ BO_ 1570 "Cycle=50ms; Channel=CAN0; CAN-FD; NominalBitrate=500kbit/s; DataBitrate=2000kbit/s;  ResponseFor=0x1A2; ACK/NACK with CRC, DLC and counter check;";

BO_ 419 DATA_035_DOOR_MODULE_FR_DOOR_STATUS_TO_INSTRUMENT_CLUSTER_KOMBI: 64 DOOR_MODULE_FR
 SG_ CRC8 : 0|8@1+ (1,0) [0|255] "" INSTRUMENT_CLUSTER_KOMBI
 SG_ AliveCounter : 8|4@1+ (1,0) [0|15] "" INSTRUMENT_CLUSTER_KOMBI
 SG_ MuxState : 12|4@1+ (1,0) [0|15] "" INSTRUMENT_CLUSTER_KOMBI
 SG_ SIG_1A3_00 : 16|12@1+ (0.1,0.0) [0|4095] "V" INSTRUMENT_CLUSTER_KOMBI
 SG_ SIG_1A3_01 : 28|12@1+ (0.1,0.0) [0|4095] "Nm" INSTRUMENT_CLUSTER_KOMBI
 SG_ SIG_1A3_02 : 40|12@1+ (0.1,0.0) [0|4095] "Nm" INSTRUMENT_CLUSTER_KOMBI
 SG_ SIG_1A3_03 : 52|12@1+ (0.1,0.0) [0|4095] "km/h" INSTRUMENT_CLUSTER_KOMBI
 SG_ SIG_1A3_04 : 64|12@1+ (0.1,0.0) [0|4095] "Nm" INSTRUMENT_CLUSTER_KOMBI
 SG_ SIG_1A3_05 : 76|12@1+ (0.1,0.0) [0|4095] "%" INSTRUMENT_CLUSTER_KOMBI
 SG_ SIG_1A3_06 : 88|12@1+ (0.1,0.0) [0|4095] "A" INSTRUMENT_CLUSTER_KOMBI
 SG_ SIG_1A3_07 : 100|12@1+ (0.1,0.0) [0|4095] "V" INSTRUMENT_CLUSTER_KOMBI
 SG_ SIG_1A3_08 : 112|12@1+ (0.1,0.0) [0|4095] "rpm" INSTRUMENT_CLUSTER_KOMBI
 SG_ SIG_1A3_09 : 124|12@1+ (0.1,0.0) [0|4095] "V" INSTRUMENT_CLUSTER_KOMBI
 SG_ SIG_1A3_10 : 136|12@1+ (0.1,0.0) [0|4095] "A" INSTRUMENT_CLUSTER_KOMBI
 SG_ SIG_1A3_11 : 148|12@1+ (0.1,0.0) [0|4095] "m" INSTRUMENT_CLUSTER_KOMBI
 SG_ RouteInfoChar_00 : 160|8@1+ (1,0) [0|255] "ascii" INSTRUMENT_CLUSTER_KOMBI
 SG_ RouteInfoChar_01 : 168|8@1+ (1,0) [0|255] "ascii" INSTRUMENT_CLUSTER_KOMBI
 SG_ RouteInfoChar_02 : 176|8@1+ (1,0) [0|255] "ascii" INSTRUMENT_CLUSTER_KOMBI
 SG_ RouteInfoChar_03 : 184|8@1+ (1,0) [0|255] "ascii" INSTRUMENT_CLUSTER_KOMBI
 SG_ RouteInfoChar_04 : 192|8@1+ (1,0) [0|255] "ascii" INSTRUMENT_CLUSTER_KOMBI
 SG_ RouteInfoChar_05 : 200|8@1+ (1,0) [0|255] "ascii" INSTRUMENT_CLUSTER_KOMBI
 SG_ RouteInfoChar_06 : 208|8@1+ (1,0) [0|255] "ascii" INSTRUMENT_CLUSTER_KOMBI
 SG_ RouteInfoChar_07 : 216|8@1+ (1,0) [0|255] "ascii" INSTRUMENT_CLUSTER_KOMBI
 SG_ RouteInfoChar_08 : 224|8@1+ (1,0) [0|255] "ascii" INSTRUMENT_CLUSTER_KOMBI
 SG_ RouteInfoChar_09 : 232|8@1+ (1,0) [0|255] "ascii" INSTRUMENT_CLUSTER_KOMBI
 SG_ RouteInfoChar_10 : 240|8@1+ (1,0) [0|255] "ascii" INSTRUMENT_CLUSTER_KOMBI
 SG_ RouteInfoChar_11 : 248|8@1+ (1,0) [0|255] "ascii" INSTRUMENT_CLUSTER_KOMBI
 SG_ RouteInfoChar_12 : 256|8@1+ (1,0) [0|255] "ascii" INSTRUMENT_CLUSTER_KOMBI
 SG_ RouteInfoChar_13 : 264|8@1+ (1,0) [0|255] "ascii" INSTRUMENT_CLUSTER_KOMBI
 SG_ RouteInfoChar_14 : 272|8@1+ (1,0) [0|255] "ascii" INSTRUMENT_CLUSTER_KOMBI
 SG_ RouteInfoChar_15 : 280|8@1+ (1,0) [0|255] "ascii" INSTRUMENT_CLUSTER_KOMBI
 SG_ RouteInfoChar_16 : 288|8@1+ (1,0) [0|255] "ascii" INSTRUMENT_CLUSTER_KOMBI
 SG_ RouteInfoChar_17 : 296|8@1+ (1,0) [0|255] "ascii" INSTRUMENT_CLUSTER_KOMBI
 SG_ RouteInfoChar_18 : 304|8@1+ (1,0) [0|255] "ascii" INSTRUMENT_CLUSTER_KOMBI
 SG_ RouteInfoChar_19 : 312|8@1+ (1,0) [0|255] "ascii" INSTRUMENT_CLUSTER_KOMBI
 SG_ RouteInfoChar_20 : 320|8@1+ (1,0) [0|255] "ascii" INSTRUMENT_CLUSTER_KOMBI
 SG_ RouteInfoChar_21 : 328|8@1+ (1,0) [0|255] "ascii" INSTRUMENT_CLUSTER_KOMBI
 SG_ RouteInfoChar_22 : 336|8@1+ (1,0) [0|255] "ascii" INSTRUMENT_CLUSTER_KOMBI
 SG_ RouteInfoChar_23 : 344|8@1+ (1,0) [0|255] "ascii" INSTRUMENT_CLUSTER_KOMBI
 SG_ RouteInfoChar_24 : 352|8@1+ (1,0) [0|255] "ascii" INSTRUMENT_CLUSTER_KOMBI
 SG_ RouteInfoChar_25 : 360|8@1+ (1,0) [0|255] "ascii" INSTRUMENT_CLUSTER_KOMBI
 SG_ RouteInfoChar_26 : 368|8@1+ (1,0) [0|255] "ascii" INSTRUMENT_CLUSTER_KOMBI
 SG_ RouteInfoChar_27 : 376|8@1+ (1,0) [0|255] "ascii" INSTRUMENT_CLUSTER_KOMBI
 SG_ RouteInfoChar_28 : 384|8@1+ (1,0) [0|255] "ascii" INSTRUMENT_CLUSTER_KOMBI
 SG_ RouteInfoChar_29 : 392|8@1+ (1,0) [0|255] "ascii" INSTRUMENT_CLUSTER_KOMBI
 SG_ RouteInfoChar_30 : 400|8@1+ (1,0) [0|255] "ascii" INSTRUMENT_CLUSTER_KOMBI
 SG_ RouteInfoChar_31 : 408|8@1+ (1,0) [0|255] "ascii" INSTRUMENT_CLUSTER_KOMBI
 SG_ RouteInfoChar_32 : 416|8@1+ (1,0) [0|255] "ascii" INSTRUMENT_CLUSTER_KOMBI
 SG_ RouteInfoChar_33 : 424|8@1+ (1,0) [0|255] "ascii" INSTRUMENT_CLUSTER_KOMBI
 SG_ RouteInfoChar_34 : 432|8@1+ (1,0) [0|255] "ascii" INSTRUMENT_CLUSTER_KOMBI
 SG_ RouteInfoChar_35 : 440|8@1+ (1,0) [0|255] "ascii" INSTRUMENT_CLUSTER_KOMBI
 SG_ RouteInfoChar_36 : 448|8@1+ (1,0) [0|255] "ascii" INSTRUMENT_CLUSTER_KOMBI
 SG_ RouteInfoChar_37 : 456|8@1+ (1,0) [0|255] "ascii" INSTRUMENT_CLUSTER_KOMBI
 SG_ RouteInfoChar_38 : 464|8@1+ (1,0) [0|255] "ascii" INSTRUMENT_CLUSTER_KOMBI
 SG_ RouteInfoChar_39 : 472|8@1+ (1,0) [0|255] "ascii" INSTRUMENT_CLUSTER_KOMBI
 SG_ RouteInfoChar_40 : 480|8@1+ (1,0) [0|255] "ascii" INSTRUMENT_CLUSTER_KOMBI
 SG_ RouteInfoChar_41 : 488|8@1+ (1,0) [0|255] "ascii" INSTRUMENT_CLUSTER_KOMBI
 SG_ RouteInfoChar_42 : 496|8@1+ (1,0) [0|255] "ascii" INSTRUMENT_CLUSTER_KOMBI
 SG_ RouteInfoChar_43 : 504|8@1+ (1,0) [0|255] "ascii" INSTRUMENT_CLUSTER_KOMBI

CM_ BO_ 419 "Cycle=20ms; Channel=CAN0; CAN-FD; NominalBitrate=500kbit/s; DataBitrate=2000kbit/s;  Data request; receiver answers with response frame; PayloadRouteInfo='DOOR_MODULE_FR -> INSTRUMENT_CLUSTER_KOMBI' in bytes 20-63; Gateway to CAN3";

BO_ 1571 RESP_035_INSTRUMENT_CLUSTER_KOMBI_TO_DOOR_MODULE_FR: 16 INSTRUMENT_CLUSTER_KOMBI
 SG_ CRC8 : 0|8@1+ (1,0) [0|255] "" DOOR_MODULE_FR
 SG_ ResponseCounter : 8|4@1+ (1,0) [0|15] "" DOOR_MODULE_FR
 SG_ AckState : 12|4@1+ (1,0) [0|15] "" DOOR_MODULE_FR
 SG_ ReceivedFrameId : 16|11@1+ (1,0) [0|2047] "" DOOR_MODULE_FR
 SG_ ReceivedCounter : 27|4@1+ (1,0) [0|15] "" DOOR_MODULE_FR
 SG_ ChecksumOk : 31|1@1+ (1,0) [0|1] "" DOOR_MODULE_FR
 SG_ PayloadLength : 32|8@1+ (1,0) [0|64] "byte" DOOR_MODULE_FR
 SG_ ErrorCode : 40|8@1+ (1,0) [0|255] "" DOOR_MODULE_FR
 SG_ ProcessingTimeUs : 48|16@1+ (1,0) [0|65535] "us" DOOR_MODULE_FR
 SG_ ResponseSequence : 64|16@1+ (1,0) [0|65535] "" DOOR_MODULE_FR
 SG_ ReceivedCrc : 80|8@1+ (1,0) [0|255] "" DOOR_MODULE_FR
 SG_ CalculatedCrc : 88|8@1+ (1,0) [0|255] "" DOOR_MODULE_FR

CM_ BO_ 1571 "Cycle=20ms; Channel=CAN0; CAN-FD; NominalBitrate=500kbit/s; DataBitrate=2000kbit/s;  ResponseFor=0x1A3; ACK/NACK with CRC, DLC and counter check;";

BO_ 420 DATA_036_DOOR_MODULE_FR_WINDOW_STATUS_TO_BODY_CONTROL_MODULE: 64 DOOR_MODULE_FR
 SG_ CRC8 : 0|8@1+ (1,0) [0|255] "" BODY_CONTROL_MODULE
 SG_ AliveCounter : 8|4@1+ (1,0) [0|15] "" BODY_CONTROL_MODULE
 SG_ MuxState : 12|4@1+ (1,0) [0|15] "" BODY_CONTROL_MODULE
 SG_ SIG_1A4_00 : 16|12@1+ (0.1,0.0) [0|4095] "%" BODY_CONTROL_MODULE
 SG_ SIG_1A4_01 : 28|12@1+ (0.1,0.0) [0|4095] "m" BODY_CONTROL_MODULE
 SG_ SIG_1A4_02 : 40|12@1+ (0.1,0.0) [0|4095] "A" BODY_CONTROL_MODULE
 SG_ SIG_1A4_03 : 52|12@1+ (0.1,0.0) [0|4095] "km/h" BODY_CONTROL_MODULE
 SG_ SIG_1A4_04 : 64|12@1+ (0.1,0.0) [0|4095] "rpm" BODY_CONTROL_MODULE
 SG_ SIG_1A4_05 : 76|12@1+ (0.1,0.0) [0|4095] "V" BODY_CONTROL_MODULE
 SG_ SIG_1A4_06 : 88|12@1+ (0.1,0.0) [0|4095] "deg" BODY_CONTROL_MODULE
 SG_ SIG_1A4_07 : 100|12@1+ (0.1,0.0) [0|4095] "obj" BODY_CONTROL_MODULE
 SG_ SIG_1A4_08 : 112|12@1+ (0.1,0.0) [0|4095] "V" BODY_CONTROL_MODULE
 SG_ SIG_1A4_09 : 124|12@1+ (0.1,0.0) [0|4095] "km/h" BODY_CONTROL_MODULE
 SG_ SIG_1A4_10 : 136|12@1+ (0.1,0.0) [0|4095] "rpm" BODY_CONTROL_MODULE
 SG_ SIG_1A4_11 : 148|12@1+ (0.1,0.0) [0|4095] "obj" BODY_CONTROL_MODULE
 SG_ RouteInfoChar_00 : 160|8@1+ (1,0) [0|255] "ascii" BODY_CONTROL_MODULE
 SG_ RouteInfoChar_01 : 168|8@1+ (1,0) [0|255] "ascii" BODY_CONTROL_MODULE
 SG_ RouteInfoChar_02 : 176|8@1+ (1,0) [0|255] "ascii" BODY_CONTROL_MODULE
 SG_ RouteInfoChar_03 : 184|8@1+ (1,0) [0|255] "ascii" BODY_CONTROL_MODULE
 SG_ RouteInfoChar_04 : 192|8@1+ (1,0) [0|255] "ascii" BODY_CONTROL_MODULE
 SG_ RouteInfoChar_05 : 200|8@1+ (1,0) [0|255] "ascii" BODY_CONTROL_MODULE
 SG_ RouteInfoChar_06 : 208|8@1+ (1,0) [0|255] "ascii" BODY_CONTROL_MODULE
 SG_ RouteInfoChar_07 : 216|8@1+ (1,0) [0|255] "ascii" BODY_CONTROL_MODULE
 SG_ RouteInfoChar_08 : 224|8@1+ (1,0) [0|255] "ascii" BODY_CONTROL_MODULE
 SG_ RouteInfoChar_09 : 232|8@1+ (1,0) [0|255] "ascii" BODY_CONTROL_MODULE
 SG_ RouteInfoChar_10 : 240|8@1+ (1,0) [0|255] "ascii" BODY_CONTROL_MODULE
 SG_ RouteInfoChar_11 : 248|8@1+ (1,0) [0|255] "ascii" BODY_CONTROL_MODULE
 SG_ RouteInfoChar_12 : 256|8@1+ (1,0) [0|255] "ascii" BODY_CONTROL_MODULE
 SG_ RouteInfoChar_13 : 264|8@1+ (1,0) [0|255] "ascii" BODY_CONTROL_MODULE
 SG_ RouteInfoChar_14 : 272|8@1+ (1,0) [0|255] "ascii" BODY_CONTROL_MODULE
 SG_ RouteInfoChar_15 : 280|8@1+ (1,0) [0|255] "ascii" BODY_CONTROL_MODULE
 SG_ RouteInfoChar_16 : 288|8@1+ (1,0) [0|255] "ascii" BODY_CONTROL_MODULE
 SG_ RouteInfoChar_17 : 296|8@1+ (1,0) [0|255] "ascii" BODY_CONTROL_MODULE
 SG_ RouteInfoChar_18 : 304|8@1+ (1,0) [0|255] "ascii" BODY_CONTROL_MODULE
 SG_ RouteInfoChar_19 : 312|8@1+ (1,0) [0|255] "ascii" BODY_CONTROL_MODULE
 SG_ RouteInfoChar_20 : 320|8@1+ (1,0) [0|255] "ascii" BODY_CONTROL_MODULE
 SG_ RouteInfoChar_21 : 328|8@1+ (1,0) [0|255] "ascii" BODY_CONTROL_MODULE
 SG_ RouteInfoChar_22 : 336|8@1+ (1,0) [0|255] "ascii" BODY_CONTROL_MODULE
 SG_ RouteInfoChar_23 : 344|8@1+ (1,0) [0|255] "ascii" BODY_CONTROL_MODULE
 SG_ RouteInfoChar_24 : 352|8@1+ (1,0) [0|255] "ascii" BODY_CONTROL_MODULE
 SG_ RouteInfoChar_25 : 360|8@1+ (1,0) [0|255] "ascii" BODY_CONTROL_MODULE
 SG_ RouteInfoChar_26 : 368|8@1+ (1,0) [0|255] "ascii" BODY_CONTROL_MODULE
 SG_ RouteInfoChar_27 : 376|8@1+ (1,0) [0|255] "ascii" BODY_CONTROL_MODULE
 SG_ RouteInfoChar_28 : 384|8@1+ (1,0) [0|255] "ascii" BODY_CONTROL_MODULE
 SG_ RouteInfoChar_29 : 392|8@1+ (1,0) [0|255] "ascii" BODY_CONTROL_MODULE
 SG_ RouteInfoChar_30 : 400|8@1+ (1,0) [0|255] "ascii" BODY_CONTROL_MODULE
 SG_ RouteInfoChar_31 : 408|8@1+ (1,0) [0|255] "ascii" BODY_CONTROL_MODULE
 SG_ RouteInfoChar_32 : 416|8@1+ (1,0) [0|255] "ascii" BODY_CONTROL_MODULE
 SG_ RouteInfoChar_33 : 424|8@1+ (1,0) [0|255] "ascii" BODY_CONTROL_MODULE
 SG_ RouteInfoChar_34 : 432|8@1+ (1,0) [0|255] "ascii" BODY_CONTROL_MODULE
 SG_ RouteInfoChar_35 : 440|8@1+ (1,0) [0|255] "ascii" BODY_CONTROL_MODULE
 SG_ RouteInfoChar_36 : 448|8@1+ (1,0) [0|255] "ascii" BODY_CONTROL_MODULE
 SG_ RouteInfoChar_37 : 456|8@1+ (1,0) [0|255] "ascii" BODY_CONTROL_MODULE
 SG_ RouteInfoChar_38 : 464|8@1+ (1,0) [0|255] "ascii" BODY_CONTROL_MODULE
 SG_ RouteInfoChar_39 : 472|8@1+ (1,0) [0|255] "ascii" BODY_CONTROL_MODULE
 SG_ RouteInfoChar_40 : 480|8@1+ (1,0) [0|255] "ascii" BODY_CONTROL_MODULE
 SG_ RouteInfoChar_41 : 488|8@1+ (1,0) [0|255] "ascii" BODY_CONTROL_MODULE
 SG_ RouteInfoChar_42 : 496|8@1+ (1,0) [0|255] "ascii" BODY_CONTROL_MODULE
 SG_ RouteInfoChar_43 : 504|8@1+ (1,0) [0|255] "ascii" BODY_CONTROL_MODULE

CM_ BO_ 420 "Cycle=50ms; Channel=CAN0; CAN-FD; NominalBitrate=500kbit/s; DataBitrate=2000kbit/s;  Data request; receiver answers with response frame; PayloadRouteInfo='DOOR_MODULE_FR -> BODY_CONTROL_MODULE' in bytes 20-63;";

BO_ 1572 RESP_036_BODY_CONTROL_MODULE_TO_DOOR_MODULE_FR: 16 BODY_CONTROL_MODULE
 SG_ CRC8 : 0|8@1+ (1,0) [0|255] "" DOOR_MODULE_FR
 SG_ ResponseCounter : 8|4@1+ (1,0) [0|15] "" DOOR_MODULE_FR
 SG_ AckState : 12|4@1+ (1,0) [0|15] "" DOOR_MODULE_FR
 SG_ ReceivedFrameId : 16|11@1+ (1,0) [0|2047] "" DOOR_MODULE_FR
 SG_ ReceivedCounter : 27|4@1+ (1,0) [0|15] "" DOOR_MODULE_FR
 SG_ ChecksumOk : 31|1@1+ (1,0) [0|1] "" DOOR_MODULE_FR
 SG_ PayloadLength : 32|8@1+ (1,0) [0|64] "byte" DOOR_MODULE_FR
 SG_ ErrorCode : 40|8@1+ (1,0) [0|255] "" DOOR_MODULE_FR
 SG_ ProcessingTimeUs : 48|16@1+ (1,0) [0|65535] "us" DOOR_MODULE_FR
 SG_ ResponseSequence : 64|16@1+ (1,0) [0|65535] "" DOOR_MODULE_FR
 SG_ ReceivedCrc : 80|8@1+ (1,0) [0|255] "" DOOR_MODULE_FR
 SG_ CalculatedCrc : 88|8@1+ (1,0) [0|255] "" DOOR_MODULE_FR

CM_ BO_ 1572 "Cycle=50ms; Channel=CAN0; CAN-FD; NominalBitrate=500kbit/s; DataBitrate=2000kbit/s;  ResponseFor=0x1A4; ACK/NACK with CRC, DLC and counter check;";

BO_ 421 DATA_037_DOOR_MODULE_FR_LOCK_STATUS_TO_BODY_CONTROL_MODULE: 64 DOOR_MODULE_FR
 SG_ CRC8 : 0|8@1+ (1,0) [0|255] "" BODY_CONTROL_MODULE
 SG_ AliveCounter : 8|4@1+ (1,0) [0|15] "" BODY_CONTROL_MODULE
 SG_ MuxState : 12|4@1+ (1,0) [0|15] "" BODY_CONTROL_MODULE
 SG_ SIG_1A5_00 : 16|12@1+ (0.1,0.0) [0|4095] "%" BODY_CONTROL_MODULE
 SG_ SIG_1A5_01 : 28|12@1+ (0.1,0.0) [0|4095] "A" BODY_CONTROL_MODULE
 SG_ SIG_1A5_02 : 40|12@1+ (0.1,0.0) [0|4095] "A" BODY_CONTROL_MODULE
 SG_ SIG_1A5_03 : 52|12@1+ (0.1,0.0) [0|4095] "%" BODY_CONTROL_MODULE
 SG_ SIG_1A5_04 : 64|12@1+ (0.1,0.0) [0|4095] "obj" BODY_CONTROL_MODULE
 SG_ SIG_1A5_05 : 76|12@1+ (0.1,0.0) [0|4095] "m" BODY_CONTROL_MODULE
 SG_ SIG_1A5_06 : 88|12@1+ (0.1,0.0) [0|4095] "rpm" BODY_CONTROL_MODULE
 SG_ SIG_1A5_07 : 100|12@1+ (0.1,0.0) [0|4095] "%" BODY_CONTROL_MODULE
 SG_ SIG_1A5_08 : 112|12@1+ (0.1,0.0) [0|4095] "obj" BODY_CONTROL_MODULE
 SG_ SIG_1A5_09 : 124|12@1+ (0.1,0.0) [0|4095] "Nm" BODY_CONTROL_MODULE
 SG_ SIG_1A5_10 : 136|12@1+ (0.1,0.0) [0|4095] "V" BODY_CONTROL_MODULE
 SG_ SIG_1A5_11 : 148|12@1+ (0.1,0.0) [0|4095] "km/h" BODY_CONTROL_MODULE
 SG_ RouteInfoChar_00 : 160|8@1+ (1,0) [0|255] "ascii" BODY_CONTROL_MODULE
 SG_ RouteInfoChar_01 : 168|8@1+ (1,0) [0|255] "ascii" BODY_CONTROL_MODULE
 SG_ RouteInfoChar_02 : 176|8@1+ (1,0) [0|255] "ascii" BODY_CONTROL_MODULE
 SG_ RouteInfoChar_03 : 184|8@1+ (1,0) [0|255] "ascii" BODY_CONTROL_MODULE
 SG_ RouteInfoChar_04 : 192|8@1+ (1,0) [0|255] "ascii" BODY_CONTROL_MODULE
 SG_ RouteInfoChar_05 : 200|8@1+ (1,0) [0|255] "ascii" BODY_CONTROL_MODULE
 SG_ RouteInfoChar_06 : 208|8@1+ (1,0) [0|255] "ascii" BODY_CONTROL_MODULE
 SG_ RouteInfoChar_07 : 216|8@1+ (1,0) [0|255] "ascii" BODY_CONTROL_MODULE
 SG_ RouteInfoChar_08 : 224|8@1+ (1,0) [0|255] "ascii" BODY_CONTROL_MODULE
 SG_ RouteInfoChar_09 : 232|8@1+ (1,0) [0|255] "ascii" BODY_CONTROL_MODULE
 SG_ RouteInfoChar_10 : 240|8@1+ (1,0) [0|255] "ascii" BODY_CONTROL_MODULE
 SG_ RouteInfoChar_11 : 248|8@1+ (1,0) [0|255] "ascii" BODY_CONTROL_MODULE
 SG_ RouteInfoChar_12 : 256|8@1+ (1,0) [0|255] "ascii" BODY_CONTROL_MODULE
 SG_ RouteInfoChar_13 : 264|8@1+ (1,0) [0|255] "ascii" BODY_CONTROL_MODULE
 SG_ RouteInfoChar_14 : 272|8@1+ (1,0) [0|255] "ascii" BODY_CONTROL_MODULE
 SG_ RouteInfoChar_15 : 280|8@1+ (1,0) [0|255] "ascii" BODY_CONTROL_MODULE
 SG_ RouteInfoChar_16 : 288|8@1+ (1,0) [0|255] "ascii" BODY_CONTROL_MODULE
 SG_ RouteInfoChar_17 : 296|8@1+ (1,0) [0|255] "ascii" BODY_CONTROL_MODULE
 SG_ RouteInfoChar_18 : 304|8@1+ (1,0) [0|255] "ascii" BODY_CONTROL_MODULE
 SG_ RouteInfoChar_19 : 312|8@1+ (1,0) [0|255] "ascii" BODY_CONTROL_MODULE
 SG_ RouteInfoChar_20 : 320|8@1+ (1,0) [0|255] "ascii" BODY_CONTROL_MODULE
 SG_ RouteInfoChar_21 : 328|8@1+ (1,0) [0|255] "ascii" BODY_CONTROL_MODULE
 SG_ RouteInfoChar_22 : 336|8@1+ (1,0) [0|255] "ascii" BODY_CONTROL_MODULE
 SG_ RouteInfoChar_23 : 344|8@1+ (1,0) [0|255] "ascii" BODY_CONTROL_MODULE
 SG_ RouteInfoChar_24 : 352|8@1+ (1,0) [0|255] "ascii" BODY_CONTROL_MODULE
 SG_ RouteInfoChar_25 : 360|8@1+ (1,0) [0|255] "ascii" BODY_CONTROL_MODULE
 SG_ RouteInfoChar_26 : 368|8@1+ (1,0) [0|255] "ascii" BODY_CONTROL_MODULE
 SG_ RouteInfoChar_27 : 376|8@1+ (1,0) [0|255] "ascii" BODY_CONTROL_MODULE
 SG_ RouteInfoChar_28 : 384|8@1+ (1,0) [0|255] "ascii" BODY_CONTROL_MODULE
 SG_ RouteInfoChar_29 : 392|8@1+ (1,0) [0|255] "ascii" BODY_CONTROL_MODULE
 SG_ RouteInfoChar_30 : 400|8@1+ (1,0) [0|255] "ascii" BODY_CONTROL_MODULE
 SG_ RouteInfoChar_31 : 408|8@1+ (1,0) [0|255] "ascii" BODY_CONTROL_MODULE
 SG_ RouteInfoChar_32 : 416|8@1+ (1,0) [0|255] "ascii" BODY_CONTROL_MODULE
 SG_ RouteInfoChar_33 : 424|8@1+ (1,0) [0|255] "ascii" BODY_CONTROL_MODULE
 SG_ RouteInfoChar_34 : 432|8@1+ (1,0) [0|255] "ascii" BODY_CONTROL_MODULE
 SG_ RouteInfoChar_35 : 440|8@1+ (1,0) [0|255] "ascii" BODY_CONTROL_MODULE
 SG_ RouteInfoChar_36 : 448|8@1+ (1,0) [0|255] "ascii" BODY_CONTROL_MODULE
 SG_ RouteInfoChar_37 : 456|8@1+ (1,0) [0|255] "ascii" BODY_CONTROL_MODULE
 SG_ RouteInfoChar_38 : 464|8@1+ (1,0) [0|255] "ascii" BODY_CONTROL_MODULE
 SG_ RouteInfoChar_39 : 472|8@1+ (1,0) [0|255] "ascii" BODY_CONTROL_MODULE
 SG_ RouteInfoChar_40 : 480|8@1+ (1,0) [0|255] "ascii" BODY_CONTROL_MODULE
 SG_ RouteInfoChar_41 : 488|8@1+ (1,0) [0|255] "ascii" BODY_CONTROL_MODULE
 SG_ RouteInfoChar_42 : 496|8@1+ (1,0) [0|255] "ascii" BODY_CONTROL_MODULE
 SG_ RouteInfoChar_43 : 504|8@1+ (1,0) [0|255] "ascii" BODY_CONTROL_MODULE

CM_ BO_ 421 "Cycle=50ms; Channel=CAN0; CAN-FD; NominalBitrate=500kbit/s; DataBitrate=2000kbit/s;  Data request; receiver answers with response frame; PayloadRouteInfo='DOOR_MODULE_FR -> BODY_CONTROL_MODULE' in bytes 20-63;";

BO_ 1573 RESP_037_BODY_CONTROL_MODULE_TO_DOOR_MODULE_FR: 16 BODY_CONTROL_MODULE
 SG_ CRC8 : 0|8@1+ (1,0) [0|255] "" DOOR_MODULE_FR
 SG_ ResponseCounter : 8|4@1+ (1,0) [0|15] "" DOOR_MODULE_FR
 SG_ AckState : 12|4@1+ (1,0) [0|15] "" DOOR_MODULE_FR
 SG_ ReceivedFrameId : 16|11@1+ (1,0) [0|2047] "" DOOR_MODULE_FR
 SG_ ReceivedCounter : 27|4@1+ (1,0) [0|15] "" DOOR_MODULE_FR
 SG_ ChecksumOk : 31|1@1+ (1,0) [0|1] "" DOOR_MODULE_FR
 SG_ PayloadLength : 32|8@1+ (1,0) [0|64] "byte" DOOR_MODULE_FR
 SG_ ErrorCode : 40|8@1+ (1,0) [0|255] "" DOOR_MODULE_FR
 SG_ ProcessingTimeUs : 48|16@1+ (1,0) [0|65535] "us" DOOR_MODULE_FR
 SG_ ResponseSequence : 64|16@1+ (1,0) [0|65535] "" DOOR_MODULE_FR
 SG_ ReceivedCrc : 80|8@1+ (1,0) [0|255] "" DOOR_MODULE_FR
 SG_ CalculatedCrc : 88|8@1+ (1,0) [0|255] "" DOOR_MODULE_FR

CM_ BO_ 1573 "Cycle=50ms; Channel=CAN0; CAN-FD; NominalBitrate=500kbit/s; DataBitrate=2000kbit/s;  ResponseFor=0x1A5; ACK/NACK with CRC, DLC and counter check;";

BO_ 422 DATA_038_DOOR_MODULE_RL_DOOR_STATUS_TO_BODY_CONTROL_MODULE: 64 DOOR_MODULE_RL
 SG_ CRC8 : 0|8@1+ (1,0) [0|255] "" BODY_CONTROL_MODULE
 SG_ AliveCounter : 8|4@1+ (1,0) [0|15] "" BODY_CONTROL_MODULE
 SG_ MuxState : 12|4@1+ (1,0) [0|15] "" BODY_CONTROL_MODULE
 SG_ SIG_1A6_00 : 16|12@1+ (0.1,0.0) [0|4095] "%" BODY_CONTROL_MODULE
 SG_ SIG_1A6_01 : 28|12@1+ (0.1,0.0) [0|4095] "km/h" BODY_CONTROL_MODULE
 SG_ SIG_1A6_02 : 40|12@1+ (0.1,0.0) [0|4095] "m" BODY_CONTROL_MODULE
 SG_ SIG_1A6_03 : 52|12@1+ (0.1,0.0) [0|4095] "m" BODY_CONTROL_MODULE
 SG_ SIG_1A6_04 : 64|12@1+ (0.1,0.0) [0|4095] "Nm" BODY_CONTROL_MODULE
 SG_ SIG_1A6_05 : 76|12@1+ (0.1,0.0) [0|4095] "A" BODY_CONTROL_MODULE
 SG_ SIG_1A6_06 : 88|12@1+ (0.1,0.0) [0|4095] "%" BODY_CONTROL_MODULE
 SG_ SIG_1A6_07 : 100|12@1+ (0.1,0.0) [0|4095] "rpm" BODY_CONTROL_MODULE
 SG_ SIG_1A6_08 : 112|12@1+ (0.1,0.0) [0|4095] "A" BODY_CONTROL_MODULE
 SG_ SIG_1A6_09 : 124|12@1+ (0.1,0.0) [0|4095] "obj" BODY_CONTROL_MODULE
 SG_ SIG_1A6_10 : 136|12@1+ (0.1,0.0) [0|4095] "A" BODY_CONTROL_MODULE
 SG_ SIG_1A6_11 : 148|12@1+ (0.1,0.0) [0|4095] "rpm" BODY_CONTROL_MODULE
 SG_ RouteInfoChar_00 : 160|8@1+ (1,0) [0|255] "ascii" BODY_CONTROL_MODULE
 SG_ RouteInfoChar_01 : 168|8@1+ (1,0) [0|255] "ascii" BODY_CONTROL_MODULE
 SG_ RouteInfoChar_02 : 176|8@1+ (1,0) [0|255] "ascii" BODY_CONTROL_MODULE
 SG_ RouteInfoChar_03 : 184|8@1+ (1,0) [0|255] "ascii" BODY_CONTROL_MODULE
 SG_ RouteInfoChar_04 : 192|8@1+ (1,0) [0|255] "ascii" BODY_CONTROL_MODULE
 SG_ RouteInfoChar_05 : 200|8@1+ (1,0) [0|255] "ascii" BODY_CONTROL_MODULE
 SG_ RouteInfoChar_06 : 208|8@1+ (1,0) [0|255] "ascii" BODY_CONTROL_MODULE
 SG_ RouteInfoChar_07 : 216|8@1+ (1,0) [0|255] "ascii" BODY_CONTROL_MODULE
 SG_ RouteInfoChar_08 : 224|8@1+ (1,0) [0|255] "ascii" BODY_CONTROL_MODULE
 SG_ RouteInfoChar_09 : 232|8@1+ (1,0) [0|255] "ascii" BODY_CONTROL_MODULE
 SG_ RouteInfoChar_10 : 240|8@1+ (1,0) [0|255] "ascii" BODY_CONTROL_MODULE
 SG_ RouteInfoChar_11 : 248|8@1+ (1,0) [0|255] "ascii" BODY_CONTROL_MODULE
 SG_ RouteInfoChar_12 : 256|8@1+ (1,0) [0|255] "ascii" BODY_CONTROL_MODULE
 SG_ RouteInfoChar_13 : 264|8@1+ (1,0) [0|255] "ascii" BODY_CONTROL_MODULE
 SG_ RouteInfoChar_14 : 272|8@1+ (1,0) [0|255] "ascii" BODY_CONTROL_MODULE
 SG_ RouteInfoChar_15 : 280|8@1+ (1,0) [0|255] "ascii" BODY_CONTROL_MODULE
 SG_ RouteInfoChar_16 : 288|8@1+ (1,0) [0|255] "ascii" BODY_CONTROL_MODULE
 SG_ RouteInfoChar_17 : 296|8@1+ (1,0) [0|255] "ascii" BODY_CONTROL_MODULE
 SG_ RouteInfoChar_18 : 304|8@1+ (1,0) [0|255] "ascii" BODY_CONTROL_MODULE
 SG_ RouteInfoChar_19 : 312|8@1+ (1,0) [0|255] "ascii" BODY_CONTROL_MODULE
 SG_ RouteInfoChar_20 : 320|8@1+ (1,0) [0|255] "ascii" BODY_CONTROL_MODULE
 SG_ RouteInfoChar_21 : 328|8@1+ (1,0) [0|255] "ascii" BODY_CONTROL_MODULE
 SG_ RouteInfoChar_22 : 336|8@1+ (1,0) [0|255] "ascii" BODY_CONTROL_MODULE
 SG_ RouteInfoChar_23 : 344|8@1+ (1,0) [0|255] "ascii" BODY_CONTROL_MODULE
 SG_ RouteInfoChar_24 : 352|8@1+ (1,0) [0|255] "ascii" BODY_CONTROL_MODULE
 SG_ RouteInfoChar_25 : 360|8@1+ (1,0) [0|255] "ascii" BODY_CONTROL_MODULE
 SG_ RouteInfoChar_26 : 368|8@1+ (1,0) [0|255] "ascii" BODY_CONTROL_MODULE
 SG_ RouteInfoChar_27 : 376|8@1+ (1,0) [0|255] "ascii" BODY_CONTROL_MODULE
 SG_ RouteInfoChar_28 : 384|8@1+ (1,0) [0|255] "ascii" BODY_CONTROL_MODULE
 SG_ RouteInfoChar_29 : 392|8@1+ (1,0) [0|255] "ascii" BODY_CONTROL_MODULE
 SG_ RouteInfoChar_30 : 400|8@1+ (1,0) [0|255] "ascii" BODY_CONTROL_MODULE
 SG_ RouteInfoChar_31 : 408|8@1+ (1,0) [0|255] "ascii" BODY_CONTROL_MODULE
 SG_ RouteInfoChar_32 : 416|8@1+ (1,0) [0|255] "ascii" BODY_CONTROL_MODULE
 SG_ RouteInfoChar_33 : 424|8@1+ (1,0) [0|255] "ascii" BODY_CONTROL_MODULE
 SG_ RouteInfoChar_34 : 432|8@1+ (1,0) [0|255] "ascii" BODY_CONTROL_MODULE
 SG_ RouteInfoChar_35 : 440|8@1+ (1,0) [0|255] "ascii" BODY_CONTROL_MODULE
 SG_ RouteInfoChar_36 : 448|8@1+ (1,0) [0|255] "ascii" BODY_CONTROL_MODULE
 SG_ RouteInfoChar_37 : 456|8@1+ (1,0) [0|255] "ascii" BODY_CONTROL_MODULE
 SG_ RouteInfoChar_38 : 464|8@1+ (1,0) [0|255] "ascii" BODY_CONTROL_MODULE
 SG_ RouteInfoChar_39 : 472|8@1+ (1,0) [0|255] "ascii" BODY_CONTROL_MODULE
 SG_ RouteInfoChar_40 : 480|8@1+ (1,0) [0|255] "ascii" BODY_CONTROL_MODULE
 SG_ RouteInfoChar_41 : 488|8@1+ (1,0) [0|255] "ascii" BODY_CONTROL_MODULE
 SG_ RouteInfoChar_42 : 496|8@1+ (1,0) [0|255] "ascii" BODY_CONTROL_MODULE
 SG_ RouteInfoChar_43 : 504|8@1+ (1,0) [0|255] "ascii" BODY_CONTROL_MODULE

CM_ BO_ 422 "Cycle=50ms; Channel=CAN0; CAN-FD; NominalBitrate=500kbit/s; DataBitrate=2000kbit/s;  Data request; receiver answers with response frame; PayloadRouteInfo='DOOR_MODULE_RL -> BODY_CONTROL_MODULE' in bytes 20-63;";

BO_ 1574 RESP_038_BODY_CONTROL_MODULE_TO_DOOR_MODULE_RL: 16 BODY_CONTROL_MODULE
 SG_ CRC8 : 0|8@1+ (1,0) [0|255] "" DOOR_MODULE_RL
 SG_ ResponseCounter : 8|4@1+ (1,0) [0|15] "" DOOR_MODULE_RL
 SG_ AckState : 12|4@1+ (1,0) [0|15] "" DOOR_MODULE_RL
 SG_ ReceivedFrameId : 16|11@1+ (1,0) [0|2047] "" DOOR_MODULE_RL
 SG_ ReceivedCounter : 27|4@1+ (1,0) [0|15] "" DOOR_MODULE_RL
 SG_ ChecksumOk : 31|1@1+ (1,0) [0|1] "" DOOR_MODULE_RL
 SG_ PayloadLength : 32|8@1+ (1,0) [0|64] "byte" DOOR_MODULE_RL
 SG_ ErrorCode : 40|8@1+ (1,0) [0|255] "" DOOR_MODULE_RL
 SG_ ProcessingTimeUs : 48|16@1+ (1,0) [0|65535] "us" DOOR_MODULE_RL
 SG_ ResponseSequence : 64|16@1+ (1,0) [0|65535] "" DOOR_MODULE_RL
 SG_ ReceivedCrc : 80|8@1+ (1,0) [0|255] "" DOOR_MODULE_RL
 SG_ CalculatedCrc : 88|8@1+ (1,0) [0|255] "" DOOR_MODULE_RL

CM_ BO_ 1574 "Cycle=50ms; Channel=CAN0; CAN-FD; NominalBitrate=500kbit/s; DataBitrate=2000kbit/s;  ResponseFor=0x1A6; ACK/NACK with CRC, DLC and counter check;";

BO_ 423 DATA_039_DOOR_MODULE_RL_DOOR_STATUS_TO_INSTRUMENT_CLUSTER_KOMBI: 64 DOOR_MODULE_RL
 SG_ CRC8 : 0|8@1+ (1,0) [0|255] "" INSTRUMENT_CLUSTER_KOMBI
 SG_ AliveCounter : 8|4@1+ (1,0) [0|15] "" INSTRUMENT_CLUSTER_KOMBI
 SG_ MuxState : 12|4@1+ (1,0) [0|15] "" INSTRUMENT_CLUSTER_KOMBI
 SG_ SIG_1A7_00 : 16|12@1+ (0.1,0.0) [0|4095] "V" INSTRUMENT_CLUSTER_KOMBI
 SG_ SIG_1A7_01 : 28|12@1+ (0.1,0.0) [0|4095] "m" INSTRUMENT_CLUSTER_KOMBI
 SG_ SIG_1A7_02 : 40|12@1+ (0.1,0.0) [0|4095] "V" INSTRUMENT_CLUSTER_KOMBI
 SG_ SIG_1A7_03 : 52|12@1+ (0.1,0.0) [0|4095] "%" INSTRUMENT_CLUSTER_KOMBI
 SG_ SIG_1A7_04 : 64|12@1+ (0.1,0.0) [0|4095] "A" INSTRUMENT_CLUSTER_KOMBI
 SG_ SIG_1A7_05 : 76|12@1+ (0.1,0.0) [0|4095] "%" INSTRUMENT_CLUSTER_KOMBI
 SG_ SIG_1A7_06 : 88|12@1+ (0.1,0.0) [0|4095] "V" INSTRUMENT_CLUSTER_KOMBI
 SG_ SIG_1A7_07 : 100|12@1+ (0.1,0.0) [0|4095] "m" INSTRUMENT_CLUSTER_KOMBI
 SG_ SIG_1A7_08 : 112|12@1+ (0.1,0.0) [0|4095] "deg" INSTRUMENT_CLUSTER_KOMBI
 SG_ SIG_1A7_09 : 124|12@1+ (0.1,0.0) [0|4095] "Nm" INSTRUMENT_CLUSTER_KOMBI
 SG_ SIG_1A7_10 : 136|12@1+ (0.1,0.0) [0|4095] "%" INSTRUMENT_CLUSTER_KOMBI
 SG_ SIG_1A7_11 : 148|12@1+ (0.1,0.0) [0|4095] "%" INSTRUMENT_CLUSTER_KOMBI
 SG_ RouteInfoChar_00 : 160|8@1+ (1,0) [0|255] "ascii" INSTRUMENT_CLUSTER_KOMBI
 SG_ RouteInfoChar_01 : 168|8@1+ (1,0) [0|255] "ascii" INSTRUMENT_CLUSTER_KOMBI
 SG_ RouteInfoChar_02 : 176|8@1+ (1,0) [0|255] "ascii" INSTRUMENT_CLUSTER_KOMBI
 SG_ RouteInfoChar_03 : 184|8@1+ (1,0) [0|255] "ascii" INSTRUMENT_CLUSTER_KOMBI
 SG_ RouteInfoChar_04 : 192|8@1+ (1,0) [0|255] "ascii" INSTRUMENT_CLUSTER_KOMBI
 SG_ RouteInfoChar_05 : 200|8@1+ (1,0) [0|255] "ascii" INSTRUMENT_CLUSTER_KOMBI
 SG_ RouteInfoChar_06 : 208|8@1+ (1,0) [0|255] "ascii" INSTRUMENT_CLUSTER_KOMBI
 SG_ RouteInfoChar_07 : 216|8@1+ (1,0) [0|255] "ascii" INSTRUMENT_CLUSTER_KOMBI
 SG_ RouteInfoChar_08 : 224|8@1+ (1,0) [0|255] "ascii" INSTRUMENT_CLUSTER_KOMBI
 SG_ RouteInfoChar_09 : 232|8@1+ (1,0) [0|255] "ascii" INSTRUMENT_CLUSTER_KOMBI
 SG_ RouteInfoChar_10 : 240|8@1+ (1,0) [0|255] "ascii" INSTRUMENT_CLUSTER_KOMBI
 SG_ RouteInfoChar_11 : 248|8@1+ (1,0) [0|255] "ascii" INSTRUMENT_CLUSTER_KOMBI
 SG_ RouteInfoChar_12 : 256|8@1+ (1,0) [0|255] "ascii" INSTRUMENT_CLUSTER_KOMBI
 SG_ RouteInfoChar_13 : 264|8@1+ (1,0) [0|255] "ascii" INSTRUMENT_CLUSTER_KOMBI
 SG_ RouteInfoChar_14 : 272|8@1+ (1,0) [0|255] "ascii" INSTRUMENT_CLUSTER_KOMBI
 SG_ RouteInfoChar_15 : 280|8@1+ (1,0) [0|255] "ascii" INSTRUMENT_CLUSTER_KOMBI
 SG_ RouteInfoChar_16 : 288|8@1+ (1,0) [0|255] "ascii" INSTRUMENT_CLUSTER_KOMBI
 SG_ RouteInfoChar_17 : 296|8@1+ (1,0) [0|255] "ascii" INSTRUMENT_CLUSTER_KOMBI
 SG_ RouteInfoChar_18 : 304|8@1+ (1,0) [0|255] "ascii" INSTRUMENT_CLUSTER_KOMBI
 SG_ RouteInfoChar_19 : 312|8@1+ (1,0) [0|255] "ascii" INSTRUMENT_CLUSTER_KOMBI
 SG_ RouteInfoChar_20 : 320|8@1+ (1,0) [0|255] "ascii" INSTRUMENT_CLUSTER_KOMBI
 SG_ RouteInfoChar_21 : 328|8@1+ (1,0) [0|255] "ascii" INSTRUMENT_CLUSTER_KOMBI
 SG_ RouteInfoChar_22 : 336|8@1+ (1,0) [0|255] "ascii" INSTRUMENT_CLUSTER_KOMBI
 SG_ RouteInfoChar_23 : 344|8@1+ (1,0) [0|255] "ascii" INSTRUMENT_CLUSTER_KOMBI
 SG_ RouteInfoChar_24 : 352|8@1+ (1,0) [0|255] "ascii" INSTRUMENT_CLUSTER_KOMBI
 SG_ RouteInfoChar_25 : 360|8@1+ (1,0) [0|255] "ascii" INSTRUMENT_CLUSTER_KOMBI
 SG_ RouteInfoChar_26 : 368|8@1+ (1,0) [0|255] "ascii" INSTRUMENT_CLUSTER_KOMBI
 SG_ RouteInfoChar_27 : 376|8@1+ (1,0) [0|255] "ascii" INSTRUMENT_CLUSTER_KOMBI
 SG_ RouteInfoChar_28 : 384|8@1+ (1,0) [0|255] "ascii" INSTRUMENT_CLUSTER_KOMBI
 SG_ RouteInfoChar_29 : 392|8@1+ (1,0) [0|255] "ascii" INSTRUMENT_CLUSTER_KOMBI
 SG_ RouteInfoChar_30 : 400|8@1+ (1,0) [0|255] "ascii" INSTRUMENT_CLUSTER_KOMBI
 SG_ RouteInfoChar_31 : 408|8@1+ (1,0) [0|255] "ascii" INSTRUMENT_CLUSTER_KOMBI
 SG_ RouteInfoChar_32 : 416|8@1+ (1,0) [0|255] "ascii" INSTRUMENT_CLUSTER_KOMBI
 SG_ RouteInfoChar_33 : 424|8@1+ (1,0) [0|255] "ascii" INSTRUMENT_CLUSTER_KOMBI
 SG_ RouteInfoChar_34 : 432|8@1+ (1,0) [0|255] "ascii" INSTRUMENT_CLUSTER_KOMBI
 SG_ RouteInfoChar_35 : 440|8@1+ (1,0) [0|255] "ascii" INSTRUMENT_CLUSTER_KOMBI
 SG_ RouteInfoChar_36 : 448|8@1+ (1,0) [0|255] "ascii" INSTRUMENT_CLUSTER_KOMBI
 SG_ RouteInfoChar_37 : 456|8@1+ (1,0) [0|255] "ascii" INSTRUMENT_CLUSTER_KOMBI
 SG_ RouteInfoChar_38 : 464|8@1+ (1,0) [0|255] "ascii" INSTRUMENT_CLUSTER_KOMBI
 SG_ RouteInfoChar_39 : 472|8@1+ (1,0) [0|255] "ascii" INSTRUMENT_CLUSTER_KOMBI
 SG_ RouteInfoChar_40 : 480|8@1+ (1,0) [0|255] "ascii" INSTRUMENT_CLUSTER_KOMBI
 SG_ RouteInfoChar_41 : 488|8@1+ (1,0) [0|255] "ascii" INSTRUMENT_CLUSTER_KOMBI
 SG_ RouteInfoChar_42 : 496|8@1+ (1,0) [0|255] "ascii" INSTRUMENT_CLUSTER_KOMBI
 SG_ RouteInfoChar_43 : 504|8@1+ (1,0) [0|255] "ascii" INSTRUMENT_CLUSTER_KOMBI

CM_ BO_ 423 "Cycle=20ms; Channel=CAN0; CAN-FD; NominalBitrate=500kbit/s; DataBitrate=2000kbit/s;  Data request; receiver answers with response frame; PayloadRouteInfo='DOOR_MODULE_RL -> INSTRUMENT_CLUSTER_KOMBI' in bytes 20-63; Gateway to CAN3";

BO_ 1575 RESP_039_INSTRUMENT_CLUSTER_KOMBI_TO_DOOR_MODULE_RL: 16 INSTRUMENT_CLUSTER_KOMBI
 SG_ CRC8 : 0|8@1+ (1,0) [0|255] "" DOOR_MODULE_RL
 SG_ ResponseCounter : 8|4@1+ (1,0) [0|15] "" DOOR_MODULE_RL
 SG_ AckState : 12|4@1+ (1,0) [0|15] "" DOOR_MODULE_RL
 SG_ ReceivedFrameId : 16|11@1+ (1,0) [0|2047] "" DOOR_MODULE_RL
 SG_ ReceivedCounter : 27|4@1+ (1,0) [0|15] "" DOOR_MODULE_RL
 SG_ ChecksumOk : 31|1@1+ (1,0) [0|1] "" DOOR_MODULE_RL
 SG_ PayloadLength : 32|8@1+ (1,0) [0|64] "byte" DOOR_MODULE_RL
 SG_ ErrorCode : 40|8@1+ (1,0) [0|255] "" DOOR_MODULE_RL
 SG_ ProcessingTimeUs : 48|16@1+ (1,0) [0|65535] "us" DOOR_MODULE_RL
 SG_ ResponseSequence : 64|16@1+ (1,0) [0|65535] "" DOOR_MODULE_RL
 SG_ ReceivedCrc : 80|8@1+ (1,0) [0|255] "" DOOR_MODULE_RL
 SG_ CalculatedCrc : 88|8@1+ (1,0) [0|255] "" DOOR_MODULE_RL

CM_ BO_ 1575 "Cycle=20ms; Channel=CAN0; CAN-FD; NominalBitrate=500kbit/s; DataBitrate=2000kbit/s;  ResponseFor=0x1A7; ACK/NACK with CRC, DLC and counter check;";

BO_ 424 DATA_040_DOOR_MODULE_RL_WINDOW_STATUS_TO_BODY_CONTROL_MODULE: 64 DOOR_MODULE_RL
 SG_ CRC8 : 0|8@1+ (1,0) [0|255] "" BODY_CONTROL_MODULE
 SG_ AliveCounter : 8|4@1+ (1,0) [0|15] "" BODY_CONTROL_MODULE
 SG_ MuxState : 12|4@1+ (1,0) [0|15] "" BODY_CONTROL_MODULE
 SG_ SIG_1A8_00 : 16|12@1+ (0.1,0.0) [0|4095] "deg" BODY_CONTROL_MODULE
 SG_ SIG_1A8_01 : 28|12@1+ (0.1,0.0) [0|4095] "obj" BODY_CONTROL_MODULE
 SG_ SIG_1A8_02 : 40|12@1+ (0.1,0.0) [0|4095] "obj" BODY_CONTROL_MODULE
 SG_ SIG_1A8_03 : 52|12@1+ (0.1,0.0) [0|4095] "V" BODY_CONTROL_MODULE
 SG_ SIG_1A8_04 : 64|12@1+ (0.1,0.0) [0|4095] "%" BODY_CONTROL_MODULE
 SG_ SIG_1A8_05 : 76|12@1+ (0.1,0.0) [0|4095] "m" BODY_CONTROL_MODULE
 SG_ SIG_1A8_06 : 88|12@1+ (0.1,0.0) [0|4095] "km/h" BODY_CONTROL_MODULE
 SG_ SIG_1A8_07 : 100|12@1+ (0.1,0.0) [0|4095] "V" BODY_CONTROL_MODULE
 SG_ SIG_1A8_08 : 112|12@1+ (0.1,0.0) [0|4095] "V" BODY_CONTROL_MODULE
 SG_ SIG_1A8_09 : 124|12@1+ (0.1,0.0) [0|4095] "Nm" BODY_CONTROL_MODULE
 SG_ SIG_1A8_10 : 136|12@1+ (0.1,0.0) [0|4095] "%" BODY_CONTROL_MODULE
 SG_ SIG_1A8_11 : 148|12@1+ (0.1,0.0) [0|4095] "obj" BODY_CONTROL_MODULE
 SG_ RouteInfoChar_00 : 160|8@1+ (1,0) [0|255] "ascii" BODY_CONTROL_MODULE
 SG_ RouteInfoChar_01 : 168|8@1+ (1,0) [0|255] "ascii" BODY_CONTROL_MODULE
 SG_ RouteInfoChar_02 : 176|8@1+ (1,0) [0|255] "ascii" BODY_CONTROL_MODULE
 SG_ RouteInfoChar_03 : 184|8@1+ (1,0) [0|255] "ascii" BODY_CONTROL_MODULE
 SG_ RouteInfoChar_04 : 192|8@1+ (1,0) [0|255] "ascii" BODY_CONTROL_MODULE
 SG_ RouteInfoChar_05 : 200|8@1+ (1,0) [0|255] "ascii" BODY_CONTROL_MODULE
 SG_ RouteInfoChar_06 : 208|8@1+ (1,0) [0|255] "ascii" BODY_CONTROL_MODULE
 SG_ RouteInfoChar_07 : 216|8@1+ (1,0) [0|255] "ascii" BODY_CONTROL_MODULE
 SG_ RouteInfoChar_08 : 224|8@1+ (1,0) [0|255] "ascii" BODY_CONTROL_MODULE
 SG_ RouteInfoChar_09 : 232|8@1+ (1,0) [0|255] "ascii" BODY_CONTROL_MODULE
 SG_ RouteInfoChar_10 : 240|8@1+ (1,0) [0|255] "ascii" BODY_CONTROL_MODULE
 SG_ RouteInfoChar_11 : 248|8@1+ (1,0) [0|255] "ascii" BODY_CONTROL_MODULE
 SG_ RouteInfoChar_12 : 256|8@1+ (1,0) [0|255] "ascii" BODY_CONTROL_MODULE
 SG_ RouteInfoChar_13 : 264|8@1+ (1,0) [0|255] "ascii" BODY_CONTROL_MODULE
 SG_ RouteInfoChar_14 : 272|8@1+ (1,0) [0|255] "ascii" BODY_CONTROL_MODULE
 SG_ RouteInfoChar_15 : 280|8@1+ (1,0) [0|255] "ascii" BODY_CONTROL_MODULE
 SG_ RouteInfoChar_16 : 288|8@1+ (1,0) [0|255] "ascii" BODY_CONTROL_MODULE
 SG_ RouteInfoChar_17 : 296|8@1+ (1,0) [0|255] "ascii" BODY_CONTROL_MODULE
 SG_ RouteInfoChar_18 : 304|8@1+ (1,0) [0|255] "ascii" BODY_CONTROL_MODULE
 SG_ RouteInfoChar_19 : 312|8@1+ (1,0) [0|255] "ascii" BODY_CONTROL_MODULE
 SG_ RouteInfoChar_20 : 320|8@1+ (1,0) [0|255] "ascii" BODY_CONTROL_MODULE
 SG_ RouteInfoChar_21 : 328|8@1+ (1,0) [0|255] "ascii" BODY_CONTROL_MODULE
 SG_ RouteInfoChar_22 : 336|8@1+ (1,0) [0|255] "ascii" BODY_CONTROL_MODULE
 SG_ RouteInfoChar_23 : 344|8@1+ (1,0) [0|255] "ascii" BODY_CONTROL_MODULE
 SG_ RouteInfoChar_24 : 352|8@1+ (1,0) [0|255] "ascii" BODY_CONTROL_MODULE
 SG_ RouteInfoChar_25 : 360|8@1+ (1,0) [0|255] "ascii" BODY_CONTROL_MODULE
 SG_ RouteInfoChar_26 : 368|8@1+ (1,0) [0|255] "ascii" BODY_CONTROL_MODULE
 SG_ RouteInfoChar_27 : 376|8@1+ (1,0) [0|255] "ascii" BODY_CONTROL_MODULE
 SG_ RouteInfoChar_28 : 384|8@1+ (1,0) [0|255] "ascii" BODY_CONTROL_MODULE
 SG_ RouteInfoChar_29 : 392|8@1+ (1,0) [0|255] "ascii" BODY_CONTROL_MODULE
 SG_ RouteInfoChar_30 : 400|8@1+ (1,0) [0|255] "ascii" BODY_CONTROL_MODULE
 SG_ RouteInfoChar_31 : 408|8@1+ (1,0) [0|255] "ascii" BODY_CONTROL_MODULE
 SG_ RouteInfoChar_32 : 416|8@1+ (1,0) [0|255] "ascii" BODY_CONTROL_MODULE
 SG_ RouteInfoChar_33 : 424|8@1+ (1,0) [0|255] "ascii" BODY_CONTROL_MODULE
 SG_ RouteInfoChar_34 : 432|8@1+ (1,0) [0|255] "ascii" BODY_CONTROL_MODULE
 SG_ RouteInfoChar_35 : 440|8@1+ (1,0) [0|255] "ascii" BODY_CONTROL_MODULE
 SG_ RouteInfoChar_36 : 448|8@1+ (1,0) [0|255] "ascii" BODY_CONTROL_MODULE
 SG_ RouteInfoChar_37 : 456|8@1+ (1,0) [0|255] "ascii" BODY_CONTROL_MODULE
 SG_ RouteInfoChar_38 : 464|8@1+ (1,0) [0|255] "ascii" BODY_CONTROL_MODULE
 SG_ RouteInfoChar_39 : 472|8@1+ (1,0) [0|255] "ascii" BODY_CONTROL_MODULE
 SG_ RouteInfoChar_40 : 480|8@1+ (1,0) [0|255] "ascii" BODY_CONTROL_MODULE
 SG_ RouteInfoChar_41 : 488|8@1+ (1,0) [0|255] "ascii" BODY_CONTROL_MODULE
 SG_ RouteInfoChar_42 : 496|8@1+ (1,0) [0|255] "ascii" BODY_CONTROL_MODULE
 SG_ RouteInfoChar_43 : 504|8@1+ (1,0) [0|255] "ascii" BODY_CONTROL_MODULE

CM_ BO_ 424 "Cycle=50ms; Channel=CAN0; CAN-FD; NominalBitrate=500kbit/s; DataBitrate=2000kbit/s;  Data request; receiver answers with response frame; PayloadRouteInfo='DOOR_MODULE_RL -> BODY_CONTROL_MODULE' in bytes 20-63;";

BO_ 1576 RESP_040_BODY_CONTROL_MODULE_TO_DOOR_MODULE_RL: 16 BODY_CONTROL_MODULE
 SG_ CRC8 : 0|8@1+ (1,0) [0|255] "" DOOR_MODULE_RL
 SG_ ResponseCounter : 8|4@1+ (1,0) [0|15] "" DOOR_MODULE_RL
 SG_ AckState : 12|4@1+ (1,0) [0|15] "" DOOR_MODULE_RL
 SG_ ReceivedFrameId : 16|11@1+ (1,0) [0|2047] "" DOOR_MODULE_RL
 SG_ ReceivedCounter : 27|4@1+ (1,0) [0|15] "" DOOR_MODULE_RL
 SG_ ChecksumOk : 31|1@1+ (1,0) [0|1] "" DOOR_MODULE_RL
 SG_ PayloadLength : 32|8@1+ (1,0) [0|64] "byte" DOOR_MODULE_RL
 SG_ ErrorCode : 40|8@1+ (1,0) [0|255] "" DOOR_MODULE_RL
 SG_ ProcessingTimeUs : 48|16@1+ (1,0) [0|65535] "us" DOOR_MODULE_RL
 SG_ ResponseSequence : 64|16@1+ (1,0) [0|65535] "" DOOR_MODULE_RL
 SG_ ReceivedCrc : 80|8@1+ (1,0) [0|255] "" DOOR_MODULE_RL
 SG_ CalculatedCrc : 88|8@1+ (1,0) [0|255] "" DOOR_MODULE_RL

CM_ BO_ 1576 "Cycle=50ms; Channel=CAN0; CAN-FD; NominalBitrate=500kbit/s; DataBitrate=2000kbit/s;  ResponseFor=0x1A8; ACK/NACK with CRC, DLC and counter check;";

BO_ 425 DATA_041_DOOR_MODULE_RL_LOCK_STATUS_TO_BODY_CONTROL_MODULE: 64 DOOR_MODULE_RL
 SG_ CRC8 : 0|8@1+ (1,0) [0|255] "" BODY_CONTROL_MODULE
 SG_ AliveCounter : 8|4@1+ (1,0) [0|15] "" BODY_CONTROL_MODULE
 SG_ MuxState : 12|4@1+ (1,0) [0|15] "" BODY_CONTROL_MODULE
 SG_ SIG_1A9_00 : 16|12@1+ (0.1,0.0) [0|4095] "obj" BODY_CONTROL_MODULE
 SG_ SIG_1A9_01 : 28|12@1+ (0.1,0.0) [0|4095] "A" BODY_CONTROL_MODULE
 SG_ SIG_1A9_02 : 40|12@1+ (0.1,0.0) [0|4095] "C" BODY_CONTROL_MODULE
 SG_ SIG_1A9_03 : 52|12@1+ (0.1,0.0) [0|4095] "C" BODY_CONTROL_MODULE
 SG_ SIG_1A9_04 : 64|12@1+ (0.1,0.0) [0|4095] "C" BODY_CONTROL_MODULE
 SG_ SIG_1A9_05 : 76|12@1+ (0.1,0.0) [0|4095] "Nm" BODY_CONTROL_MODULE
 SG_ SIG_1A9_06 : 88|12@1+ (0.1,0.0) [0|4095] "m" BODY_CONTROL_MODULE
 SG_ SIG_1A9_07 : 100|12@1+ (0.1,0.0) [0|4095] "C" BODY_CONTROL_MODULE
 SG_ SIG_1A9_08 : 112|12@1+ (0.1,0.0) [0|4095] "deg" BODY_CONTROL_MODULE
 SG_ SIG_1A9_09 : 124|12@1+ (0.1,0.0) [0|4095] "rpm" BODY_CONTROL_MODULE
 SG_ SIG_1A9_10 : 136|12@1+ (0.1,0.0) [0|4095] "V" BODY_CONTROL_MODULE
 SG_ SIG_1A9_11 : 148|12@1+ (0.1,0.0) [0|4095] "m" BODY_CONTROL_MODULE
 SG_ RouteInfoChar_00 : 160|8@1+ (1,0) [0|255] "ascii" BODY_CONTROL_MODULE
 SG_ RouteInfoChar_01 : 168|8@1+ (1,0) [0|255] "ascii" BODY_CONTROL_MODULE
 SG_ RouteInfoChar_02 : 176|8@1+ (1,0) [0|255] "ascii" BODY_CONTROL_MODULE
 SG_ RouteInfoChar_03 : 184|8@1+ (1,0) [0|255] "ascii" BODY_CONTROL_MODULE
 SG_ RouteInfoChar_04 : 192|8@1+ (1,0) [0|255] "ascii" BODY_CONTROL_MODULE
 SG_ RouteInfoChar_05 : 200|8@1+ (1,0) [0|255] "ascii" BODY_CONTROL_MODULE
 SG_ RouteInfoChar_06 : 208|8@1+ (1,0) [0|255] "ascii" BODY_CONTROL_MODULE
 SG_ RouteInfoChar_07 : 216|8@1+ (1,0) [0|255] "ascii" BODY_CONTROL_MODULE
 SG_ RouteInfoChar_08 : 224|8@1+ (1,0) [0|255] "ascii" BODY_CONTROL_MODULE
 SG_ RouteInfoChar_09 : 232|8@1+ (1,0) [0|255] "ascii" BODY_CONTROL_MODULE
 SG_ RouteInfoChar_10 : 240|8@1+ (1,0) [0|255] "ascii" BODY_CONTROL_MODULE
 SG_ RouteInfoChar_11 : 248|8@1+ (1,0) [0|255] "ascii" BODY_CONTROL_MODULE
 SG_ RouteInfoChar_12 : 256|8@1+ (1,0) [0|255] "ascii" BODY_CONTROL_MODULE
 SG_ RouteInfoChar_13 : 264|8@1+ (1,0) [0|255] "ascii" BODY_CONTROL_MODULE
 SG_ RouteInfoChar_14 : 272|8@1+ (1,0) [0|255] "ascii" BODY_CONTROL_MODULE
 SG_ RouteInfoChar_15 : 280|8@1+ (1,0) [0|255] "ascii" BODY_CONTROL_MODULE
 SG_ RouteInfoChar_16 : 288|8@1+ (1,0) [0|255] "ascii" BODY_CONTROL_MODULE
 SG_ RouteInfoChar_17 : 296|8@1+ (1,0) [0|255] "ascii" BODY_CONTROL_MODULE
 SG_ RouteInfoChar_18 : 304|8@1+ (1,0) [0|255] "ascii" BODY_CONTROL_MODULE
 SG_ RouteInfoChar_19 : 312|8@1+ (1,0) [0|255] "ascii" BODY_CONTROL_MODULE
 SG_ RouteInfoChar_20 : 320|8@1+ (1,0) [0|255] "ascii" BODY_CONTROL_MODULE
 SG_ RouteInfoChar_21 : 328|8@1+ (1,0) [0|255] "ascii" BODY_CONTROL_MODULE
 SG_ RouteInfoChar_22 : 336|8@1+ (1,0) [0|255] "ascii" BODY_CONTROL_MODULE
 SG_ RouteInfoChar_23 : 344|8@1+ (1,0) [0|255] "ascii" BODY_CONTROL_MODULE
 SG_ RouteInfoChar_24 : 352|8@1+ (1,0) [0|255] "ascii" BODY_CONTROL_MODULE
 SG_ RouteInfoChar_25 : 360|8@1+ (1,0) [0|255] "ascii" BODY_CONTROL_MODULE
 SG_ RouteInfoChar_26 : 368|8@1+ (1,0) [0|255] "ascii" BODY_CONTROL_MODULE
 SG_ RouteInfoChar_27 : 376|8@1+ (1,0) [0|255] "ascii" BODY_CONTROL_MODULE
 SG_ RouteInfoChar_28 : 384|8@1+ (1,0) [0|255] "ascii" BODY_CONTROL_MODULE
 SG_ RouteInfoChar_29 : 392|8@1+ (1,0) [0|255] "ascii" BODY_CONTROL_MODULE
 SG_ RouteInfoChar_30 : 400|8@1+ (1,0) [0|255] "ascii" BODY_CONTROL_MODULE
 SG_ RouteInfoChar_31 : 408|8@1+ (1,0) [0|255] "ascii" BODY_CONTROL_MODULE
 SG_ RouteInfoChar_32 : 416|8@1+ (1,0) [0|255] "ascii" BODY_CONTROL_MODULE
 SG_ RouteInfoChar_33 : 424|8@1+ (1,0) [0|255] "ascii" BODY_CONTROL_MODULE
 SG_ RouteInfoChar_34 : 432|8@1+ (1,0) [0|255] "ascii" BODY_CONTROL_MODULE
 SG_ RouteInfoChar_35 : 440|8@1+ (1,0) [0|255] "ascii" BODY_CONTROL_MODULE
 SG_ RouteInfoChar_36 : 448|8@1+ (1,0) [0|255] "ascii" BODY_CONTROL_MODULE
 SG_ RouteInfoChar_37 : 456|8@1+ (1,0) [0|255] "ascii" BODY_CONTROL_MODULE
 SG_ RouteInfoChar_38 : 464|8@1+ (1,0) [0|255] "ascii" BODY_CONTROL_MODULE
 SG_ RouteInfoChar_39 : 472|8@1+ (1,0) [0|255] "ascii" BODY_CONTROL_MODULE
 SG_ RouteInfoChar_40 : 480|8@1+ (1,0) [0|255] "ascii" BODY_CONTROL_MODULE
 SG_ RouteInfoChar_41 : 488|8@1+ (1,0) [0|255] "ascii" BODY_CONTROL_MODULE
 SG_ RouteInfoChar_42 : 496|8@1+ (1,0) [0|255] "ascii" BODY_CONTROL_MODULE
 SG_ RouteInfoChar_43 : 504|8@1+ (1,0) [0|255] "ascii" BODY_CONTROL_MODULE

CM_ BO_ 425 "Cycle=50ms; Channel=CAN0; CAN-FD; NominalBitrate=500kbit/s; DataBitrate=2000kbit/s;  Data request; receiver answers with response frame; PayloadRouteInfo='DOOR_MODULE_RL -> BODY_CONTROL_MODULE' in bytes 20-63;";

BO_ 1577 RESP_041_BODY_CONTROL_MODULE_TO_DOOR_MODULE_RL: 16 BODY_CONTROL_MODULE
 SG_ CRC8 : 0|8@1+ (1,0) [0|255] "" DOOR_MODULE_RL
 SG_ ResponseCounter : 8|4@1+ (1,0) [0|15] "" DOOR_MODULE_RL
 SG_ AckState : 12|4@1+ (1,0) [0|15] "" DOOR_MODULE_RL
 SG_ ReceivedFrameId : 16|11@1+ (1,0) [0|2047] "" DOOR_MODULE_RL
 SG_ ReceivedCounter : 27|4@1+ (1,0) [0|15] "" DOOR_MODULE_RL
 SG_ ChecksumOk : 31|1@1+ (1,0) [0|1] "" DOOR_MODULE_RL
 SG_ PayloadLength : 32|8@1+ (1,0) [0|64] "byte" DOOR_MODULE_RL
 SG_ ErrorCode : 40|8@1+ (1,0) [0|255] "" DOOR_MODULE_RL
 SG_ ProcessingTimeUs : 48|16@1+ (1,0) [0|65535] "us" DOOR_MODULE_RL
 SG_ ResponseSequence : 64|16@1+ (1,0) [0|65535] "" DOOR_MODULE_RL
 SG_ ReceivedCrc : 80|8@1+ (1,0) [0|255] "" DOOR_MODULE_RL
 SG_ CalculatedCrc : 88|8@1+ (1,0) [0|255] "" DOOR_MODULE_RL

CM_ BO_ 1577 "Cycle=50ms; Channel=CAN0; CAN-FD; NominalBitrate=500kbit/s; DataBitrate=2000kbit/s;  ResponseFor=0x1A9; ACK/NACK with CRC, DLC and counter check;";

BO_ 426 DATA_042_DOOR_MODULE_RR_DOOR_STATUS_TO_BODY_CONTROL_MODULE: 64 DOOR_MODULE_RR
 SG_ CRC8 : 0|8@1+ (1,0) [0|255] "" BODY_CONTROL_MODULE
 SG_ AliveCounter : 8|4@1+ (1,0) [0|15] "" BODY_CONTROL_MODULE
 SG_ MuxState : 12|4@1+ (1,0) [0|15] "" BODY_CONTROL_MODULE
 SG_ SIG_1AA_00 : 16|12@1+ (0.1,0.0) [0|4095] "obj" BODY_CONTROL_MODULE
 SG_ SIG_1AA_01 : 28|12@1+ (0.1,0.0) [0|4095] "A" BODY_CONTROL_MODULE
 SG_ SIG_1AA_02 : 40|12@1+ (0.1,0.0) [0|4095] "rpm" BODY_CONTROL_MODULE
 SG_ SIG_1AA_03 : 52|12@1+ (0.1,0.0) [0|4095] "Nm" BODY_CONTROL_MODULE
 SG_ SIG_1AA_04 : 64|12@1+ (0.1,0.0) [0|4095] "V" BODY_CONTROL_MODULE
 SG_ SIG_1AA_05 : 76|12@1+ (0.1,0.0) [0|4095] "Nm" BODY_CONTROL_MODULE
 SG_ SIG_1AA_06 : 88|12@1+ (0.1,0.0) [0|4095] "Nm" BODY_CONTROL_MODULE
 SG_ SIG_1AA_07 : 100|12@1+ (0.1,0.0) [0|4095] "deg" BODY_CONTROL_MODULE
 SG_ SIG_1AA_08 : 112|12@1+ (0.1,0.0) [0|4095] "km/h" BODY_CONTROL_MODULE
 SG_ SIG_1AA_09 : 124|12@1+ (0.1,0.0) [0|4095] "km/h" BODY_CONTROL_MODULE
 SG_ SIG_1AA_10 : 136|12@1+ (0.1,0.0) [0|4095] "Nm" BODY_CONTROL_MODULE
 SG_ SIG_1AA_11 : 148|12@1+ (0.1,0.0) [0|4095] "C" BODY_CONTROL_MODULE
 SG_ RouteInfoChar_00 : 160|8@1+ (1,0) [0|255] "ascii" BODY_CONTROL_MODULE
 SG_ RouteInfoChar_01 : 168|8@1+ (1,0) [0|255] "ascii" BODY_CONTROL_MODULE
 SG_ RouteInfoChar_02 : 176|8@1+ (1,0) [0|255] "ascii" BODY_CONTROL_MODULE
 SG_ RouteInfoChar_03 : 184|8@1+ (1,0) [0|255] "ascii" BODY_CONTROL_MODULE
 SG_ RouteInfoChar_04 : 192|8@1+ (1,0) [0|255] "ascii" BODY_CONTROL_MODULE
 SG_ RouteInfoChar_05 : 200|8@1+ (1,0) [0|255] "ascii" BODY_CONTROL_MODULE
 SG_ RouteInfoChar_06 : 208|8@1+ (1,0) [0|255] "ascii" BODY_CONTROL_MODULE
 SG_ RouteInfoChar_07 : 216|8@1+ (1,0) [0|255] "ascii" BODY_CONTROL_MODULE
 SG_ RouteInfoChar_08 : 224|8@1+ (1,0) [0|255] "ascii" BODY_CONTROL_MODULE
 SG_ RouteInfoChar_09 : 232|8@1+ (1,0) [0|255] "ascii" BODY_CONTROL_MODULE
 SG_ RouteInfoChar_10 : 240|8@1+ (1,0) [0|255] "ascii" BODY_CONTROL_MODULE
 SG_ RouteInfoChar_11 : 248|8@1+ (1,0) [0|255] "ascii" BODY_CONTROL_MODULE
 SG_ RouteInfoChar_12 : 256|8@1+ (1,0) [0|255] "ascii" BODY_CONTROL_MODULE
 SG_ RouteInfoChar_13 : 264|8@1+ (1,0) [0|255] "ascii" BODY_CONTROL_MODULE
 SG_ RouteInfoChar_14 : 272|8@1+ (1,0) [0|255] "ascii" BODY_CONTROL_MODULE
 SG_ RouteInfoChar_15 : 280|8@1+ (1,0) [0|255] "ascii" BODY_CONTROL_MODULE
 SG_ RouteInfoChar_16 : 288|8@1+ (1,0) [0|255] "ascii" BODY_CONTROL_MODULE
 SG_ RouteInfoChar_17 : 296|8@1+ (1,0) [0|255] "ascii" BODY_CONTROL_MODULE
 SG_ RouteInfoChar_18 : 304|8@1+ (1,0) [0|255] "ascii" BODY_CONTROL_MODULE
 SG_ RouteInfoChar_19 : 312|8@1+ (1,0) [0|255] "ascii" BODY_CONTROL_MODULE
 SG_ RouteInfoChar_20 : 320|8@1+ (1,0) [0|255] "ascii" BODY_CONTROL_MODULE
 SG_ RouteInfoChar_21 : 328|8@1+ (1,0) [0|255] "ascii" BODY_CONTROL_MODULE
 SG_ RouteInfoChar_22 : 336|8@1+ (1,0) [0|255] "ascii" BODY_CONTROL_MODULE
 SG_ RouteInfoChar_23 : 344|8@1+ (1,0) [0|255] "ascii" BODY_CONTROL_MODULE
 SG_ RouteInfoChar_24 : 352|8@1+ (1,0) [0|255] "ascii" BODY_CONTROL_MODULE
 SG_ RouteInfoChar_25 : 360|8@1+ (1,0) [0|255] "ascii" BODY_CONTROL_MODULE
 SG_ RouteInfoChar_26 : 368|8@1+ (1,0) [0|255] "ascii" BODY_CONTROL_MODULE
 SG_ RouteInfoChar_27 : 376|8@1+ (1,0) [0|255] "ascii" BODY_CONTROL_MODULE
 SG_ RouteInfoChar_28 : 384|8@1+ (1,0) [0|255] "ascii" BODY_CONTROL_MODULE
 SG_ RouteInfoChar_29 : 392|8@1+ (1,0) [0|255] "ascii" BODY_CONTROL_MODULE
 SG_ RouteInfoChar_30 : 400|8@1+ (1,0) [0|255] "ascii" BODY_CONTROL_MODULE
 SG_ RouteInfoChar_31 : 408|8@1+ (1,0) [0|255] "ascii" BODY_CONTROL_MODULE
 SG_ RouteInfoChar_32 : 416|8@1+ (1,0) [0|255] "ascii" BODY_CONTROL_MODULE
 SG_ RouteInfoChar_33 : 424|8@1+ (1,0) [0|255] "ascii" BODY_CONTROL_MODULE
 SG_ RouteInfoChar_34 : 432|8@1+ (1,0) [0|255] "ascii" BODY_CONTROL_MODULE
 SG_ RouteInfoChar_35 : 440|8@1+ (1,0) [0|255] "ascii" BODY_CONTROL_MODULE
 SG_ RouteInfoChar_36 : 448|8@1+ (1,0) [0|255] "ascii" BODY_CONTROL_MODULE
 SG_ RouteInfoChar_37 : 456|8@1+ (1,0) [0|255] "ascii" BODY_CONTROL_MODULE
 SG_ RouteInfoChar_38 : 464|8@1+ (1,0) [0|255] "ascii" BODY_CONTROL_MODULE
 SG_ RouteInfoChar_39 : 472|8@1+ (1,0) [0|255] "ascii" BODY_CONTROL_MODULE
 SG_ RouteInfoChar_40 : 480|8@1+ (1,0) [0|255] "ascii" BODY_CONTROL_MODULE
 SG_ RouteInfoChar_41 : 488|8@1+ (1,0) [0|255] "ascii" BODY_CONTROL_MODULE
 SG_ RouteInfoChar_42 : 496|8@1+ (1,0) [0|255] "ascii" BODY_CONTROL_MODULE
 SG_ RouteInfoChar_43 : 504|8@1+ (1,0) [0|255] "ascii" BODY_CONTROL_MODULE

CM_ BO_ 426 "Cycle=50ms; Channel=CAN0; CAN-FD; NominalBitrate=500kbit/s; DataBitrate=2000kbit/s;  Data request; receiver answers with response frame; PayloadRouteInfo='DOOR_MODULE_RR -> BODY_CONTROL_MODULE' in bytes 20-63;";

BO_ 1578 RESP_042_BODY_CONTROL_MODULE_TO_DOOR_MODULE_RR: 16 BODY_CONTROL_MODULE
 SG_ CRC8 : 0|8@1+ (1,0) [0|255] "" DOOR_MODULE_RR
 SG_ ResponseCounter : 8|4@1+ (1,0) [0|15] "" DOOR_MODULE_RR
 SG_ AckState : 12|4@1+ (1,0) [0|15] "" DOOR_MODULE_RR
 SG_ ReceivedFrameId : 16|11@1+ (1,0) [0|2047] "" DOOR_MODULE_RR
 SG_ ReceivedCounter : 27|4@1+ (1,0) [0|15] "" DOOR_MODULE_RR
 SG_ ChecksumOk : 31|1@1+ (1,0) [0|1] "" DOOR_MODULE_RR
 SG_ PayloadLength : 32|8@1+ (1,0) [0|64] "byte" DOOR_MODULE_RR
 SG_ ErrorCode : 40|8@1+ (1,0) [0|255] "" DOOR_MODULE_RR
 SG_ ProcessingTimeUs : 48|16@1+ (1,0) [0|65535] "us" DOOR_MODULE_RR
 SG_ ResponseSequence : 64|16@1+ (1,0) [0|65535] "" DOOR_MODULE_RR
 SG_ ReceivedCrc : 80|8@1+ (1,0) [0|255] "" DOOR_MODULE_RR
 SG_ CalculatedCrc : 88|8@1+ (1,0) [0|255] "" DOOR_MODULE_RR

CM_ BO_ 1578 "Cycle=50ms; Channel=CAN0; CAN-FD; NominalBitrate=500kbit/s; DataBitrate=2000kbit/s;  ResponseFor=0x1AA; ACK/NACK with CRC, DLC and counter check;";

BO_ 427 DATA_043_DOOR_MODULE_RR_DOOR_STATUS_TO_INSTRUMENT_CLUSTER_KOMBI: 64 DOOR_MODULE_RR
 SG_ CRC8 : 0|8@1+ (1,0) [0|255] "" INSTRUMENT_CLUSTER_KOMBI
 SG_ AliveCounter : 8|4@1+ (1,0) [0|15] "" INSTRUMENT_CLUSTER_KOMBI
 SG_ MuxState : 12|4@1+ (1,0) [0|15] "" INSTRUMENT_CLUSTER_KOMBI
 SG_ SIG_1AB_00 : 16|12@1+ (0.1,0.0) [0|4095] "obj" INSTRUMENT_CLUSTER_KOMBI
 SG_ SIG_1AB_01 : 28|12@1+ (0.1,0.0) [0|4095] "rpm" INSTRUMENT_CLUSTER_KOMBI
 SG_ SIG_1AB_02 : 40|12@1+ (0.1,0.0) [0|4095] "C" INSTRUMENT_CLUSTER_KOMBI
 SG_ SIG_1AB_03 : 52|12@1+ (0.1,0.0) [0|4095] "%" INSTRUMENT_CLUSTER_KOMBI
 SG_ SIG_1AB_04 : 64|12@1+ (0.1,0.0) [0|4095] "obj" INSTRUMENT_CLUSTER_KOMBI
 SG_ SIG_1AB_05 : 76|12@1+ (0.1,0.0) [0|4095] "Nm" INSTRUMENT_CLUSTER_KOMBI
 SG_ SIG_1AB_06 : 88|12@1+ (0.1,0.0) [0|4095] "%" INSTRUMENT_CLUSTER_KOMBI
 SG_ SIG_1AB_07 : 100|12@1+ (0.1,0.0) [0|4095] "C" INSTRUMENT_CLUSTER_KOMBI
 SG_ SIG_1AB_08 : 112|12@1+ (0.1,0.0) [0|4095] "%" INSTRUMENT_CLUSTER_KOMBI
 SG_ SIG_1AB_09 : 124|12@1+ (0.1,0.0) [0|4095] "Nm" INSTRUMENT_CLUSTER_KOMBI
 SG_ SIG_1AB_10 : 136|12@1+ (0.1,0.0) [0|4095] "deg" INSTRUMENT_CLUSTER_KOMBI
 SG_ SIG_1AB_11 : 148|12@1+ (0.1,0.0) [0|4095] "km/h" INSTRUMENT_CLUSTER_KOMBI
 SG_ RouteInfoChar_00 : 160|8@1+ (1,0) [0|255] "ascii" INSTRUMENT_CLUSTER_KOMBI
 SG_ RouteInfoChar_01 : 168|8@1+ (1,0) [0|255] "ascii" INSTRUMENT_CLUSTER_KOMBI
 SG_ RouteInfoChar_02 : 176|8@1+ (1,0) [0|255] "ascii" INSTRUMENT_CLUSTER_KOMBI
 SG_ RouteInfoChar_03 : 184|8@1+ (1,0) [0|255] "ascii" INSTRUMENT_CLUSTER_KOMBI
 SG_ RouteInfoChar_04 : 192|8@1+ (1,0) [0|255] "ascii" INSTRUMENT_CLUSTER_KOMBI
 SG_ RouteInfoChar_05 : 200|8@1+ (1,0) [0|255] "ascii" INSTRUMENT_CLUSTER_KOMBI
 SG_ RouteInfoChar_06 : 208|8@1+ (1,0) [0|255] "ascii" INSTRUMENT_CLUSTER_KOMBI
 SG_ RouteInfoChar_07 : 216|8@1+ (1,0) [0|255] "ascii" INSTRUMENT_CLUSTER_KOMBI
 SG_ RouteInfoChar_08 : 224|8@1+ (1,0) [0|255] "ascii" INSTRUMENT_CLUSTER_KOMBI
 SG_ RouteInfoChar_09 : 232|8@1+ (1,0) [0|255] "ascii" INSTRUMENT_CLUSTER_KOMBI
 SG_ RouteInfoChar_10 : 240|8@1+ (1,0) [0|255] "ascii" INSTRUMENT_CLUSTER_KOMBI
 SG_ RouteInfoChar_11 : 248|8@1+ (1,0) [0|255] "ascii" INSTRUMENT_CLUSTER_KOMBI
 SG_ RouteInfoChar_12 : 256|8@1+ (1,0) [0|255] "ascii" INSTRUMENT_CLUSTER_KOMBI
 SG_ RouteInfoChar_13 : 264|8@1+ (1,0) [0|255] "ascii" INSTRUMENT_CLUSTER_KOMBI
 SG_ RouteInfoChar_14 : 272|8@1+ (1,0) [0|255] "ascii" INSTRUMENT_CLUSTER_KOMBI
 SG_ RouteInfoChar_15 : 280|8@1+ (1,0) [0|255] "ascii" INSTRUMENT_CLUSTER_KOMBI
 SG_ RouteInfoChar_16 : 288|8@1+ (1,0) [0|255] "ascii" INSTRUMENT_CLUSTER_KOMBI
 SG_ RouteInfoChar_17 : 296|8@1+ (1,0) [0|255] "ascii" INSTRUMENT_CLUSTER_KOMBI
 SG_ RouteInfoChar_18 : 304|8@1+ (1,0) [0|255] "ascii" INSTRUMENT_CLUSTER_KOMBI
 SG_ RouteInfoChar_19 : 312|8@1+ (1,0) [0|255] "ascii" INSTRUMENT_CLUSTER_KOMBI
 SG_ RouteInfoChar_20 : 320|8@1+ (1,0) [0|255] "ascii" INSTRUMENT_CLUSTER_KOMBI
 SG_ RouteInfoChar_21 : 328|8@1+ (1,0) [0|255] "ascii" INSTRUMENT_CLUSTER_KOMBI
 SG_ RouteInfoChar_22 : 336|8@1+ (1,0) [0|255] "ascii" INSTRUMENT_CLUSTER_KOMBI
 SG_ RouteInfoChar_23 : 344|8@1+ (1,0) [0|255] "ascii" INSTRUMENT_CLUSTER_KOMBI
 SG_ RouteInfoChar_24 : 352|8@1+ (1,0) [0|255] "ascii" INSTRUMENT_CLUSTER_KOMBI
 SG_ RouteInfoChar_25 : 360|8@1+ (1,0) [0|255] "ascii" INSTRUMENT_CLUSTER_KOMBI
 SG_ RouteInfoChar_26 : 368|8@1+ (1,0) [0|255] "ascii" INSTRUMENT_CLUSTER_KOMBI
 SG_ RouteInfoChar_27 : 376|8@1+ (1,0) [0|255] "ascii" INSTRUMENT_CLUSTER_KOMBI
 SG_ RouteInfoChar_28 : 384|8@1+ (1,0) [0|255] "ascii" INSTRUMENT_CLUSTER_KOMBI
 SG_ RouteInfoChar_29 : 392|8@1+ (1,0) [0|255] "ascii" INSTRUMENT_CLUSTER_KOMBI
 SG_ RouteInfoChar_30 : 400|8@1+ (1,0) [0|255] "ascii" INSTRUMENT_CLUSTER_KOMBI
 SG_ RouteInfoChar_31 : 408|8@1+ (1,0) [0|255] "ascii" INSTRUMENT_CLUSTER_KOMBI
 SG_ RouteInfoChar_32 : 416|8@1+ (1,0) [0|255] "ascii" INSTRUMENT_CLUSTER_KOMBI
 SG_ RouteInfoChar_33 : 424|8@1+ (1,0) [0|255] "ascii" INSTRUMENT_CLUSTER_KOMBI
 SG_ RouteInfoChar_34 : 432|8@1+ (1,0) [0|255] "ascii" INSTRUMENT_CLUSTER_KOMBI
 SG_ RouteInfoChar_35 : 440|8@1+ (1,0) [0|255] "ascii" INSTRUMENT_CLUSTER_KOMBI
 SG_ RouteInfoChar_36 : 448|8@1+ (1,0) [0|255] "ascii" INSTRUMENT_CLUSTER_KOMBI
 SG_ RouteInfoChar_37 : 456|8@1+ (1,0) [0|255] "ascii" INSTRUMENT_CLUSTER_KOMBI
 SG_ RouteInfoChar_38 : 464|8@1+ (1,0) [0|255] "ascii" INSTRUMENT_CLUSTER_KOMBI
 SG_ RouteInfoChar_39 : 472|8@1+ (1,0) [0|255] "ascii" INSTRUMENT_CLUSTER_KOMBI
 SG_ RouteInfoChar_40 : 480|8@1+ (1,0) [0|255] "ascii" INSTRUMENT_CLUSTER_KOMBI
 SG_ RouteInfoChar_41 : 488|8@1+ (1,0) [0|255] "ascii" INSTRUMENT_CLUSTER_KOMBI
 SG_ RouteInfoChar_42 : 496|8@1+ (1,0) [0|255] "ascii" INSTRUMENT_CLUSTER_KOMBI
 SG_ RouteInfoChar_43 : 504|8@1+ (1,0) [0|255] "ascii" INSTRUMENT_CLUSTER_KOMBI

CM_ BO_ 427 "Cycle=20ms; Channel=CAN0; CAN-FD; NominalBitrate=500kbit/s; DataBitrate=2000kbit/s;  Data request; receiver answers with response frame; PayloadRouteInfo='DOOR_MODULE_RR -> INSTRUMENT_CLUSTER_KOMBI' in bytes 20-63; Gateway to CAN3";

BO_ 1579 RESP_043_INSTRUMENT_CLUSTER_KOMBI_TO_DOOR_MODULE_RR: 16 INSTRUMENT_CLUSTER_KOMBI
 SG_ CRC8 : 0|8@1+ (1,0) [0|255] "" DOOR_MODULE_RR
 SG_ ResponseCounter : 8|4@1+ (1,0) [0|15] "" DOOR_MODULE_RR
 SG_ AckState : 12|4@1+ (1,0) [0|15] "" DOOR_MODULE_RR
 SG_ ReceivedFrameId : 16|11@1+ (1,0) [0|2047] "" DOOR_MODULE_RR
 SG_ ReceivedCounter : 27|4@1+ (1,0) [0|15] "" DOOR_MODULE_RR
 SG_ ChecksumOk : 31|1@1+ (1,0) [0|1] "" DOOR_MODULE_RR
 SG_ PayloadLength : 32|8@1+ (1,0) [0|64] "byte" DOOR_MODULE_RR
 SG_ ErrorCode : 40|8@1+ (1,0) [0|255] "" DOOR_MODULE_RR
 SG_ ProcessingTimeUs : 48|16@1+ (1,0) [0|65535] "us" DOOR_MODULE_RR
 SG_ ResponseSequence : 64|16@1+ (1,0) [0|65535] "" DOOR_MODULE_RR
 SG_ ReceivedCrc : 80|8@1+ (1,0) [0|255] "" DOOR_MODULE_RR
 SG_ CalculatedCrc : 88|8@1+ (1,0) [0|255] "" DOOR_MODULE_RR

CM_ BO_ 1579 "Cycle=20ms; Channel=CAN0; CAN-FD; NominalBitrate=500kbit/s; DataBitrate=2000kbit/s;  ResponseFor=0x1AB; ACK/NACK with CRC, DLC and counter check;";

BO_ 428 DATA_044_DOOR_MODULE_RR_WINDOW_STATUS_TO_BODY_CONTROL_MODULE: 64 DOOR_MODULE_RR
 SG_ CRC8 : 0|8@1+ (1,0) [0|255] "" BODY_CONTROL_MODULE
 SG_ AliveCounter : 8|4@1+ (1,0) [0|15] "" BODY_CONTROL_MODULE
 SG_ MuxState : 12|4@1+ (1,0) [0|15] "" BODY_CONTROL_MODULE
 SG_ SIG_1AC_00 : 16|12@1+ (0.1,0.0) [0|4095] "rpm" BODY_CONTROL_MODULE
 SG_ SIG_1AC_01 : 28|12@1+ (0.1,0.0) [0|4095] "%" BODY_CONTROL_MODULE
 SG_ SIG_1AC_02 : 40|12@1+ (0.1,0.0) [0|4095] "Nm" BODY_CONTROL_MODULE
 SG_ SIG_1AC_03 : 52|12@1+ (0.1,0.0) [0|4095] "deg" BODY_CONTROL_MODULE
 SG_ SIG_1AC_04 : 64|12@1+ (0.1,0.0) [0|4095] "m" BODY_CONTROL_MODULE
 SG_ SIG_1AC_05 : 76|12@1+ (0.1,0.0) [0|4095] "C" BODY_CONTROL_MODULE
 SG_ SIG_1AC_06 : 88|12@1+ (0.1,0.0) [0|4095] "km/h" BODY_CONTROL_MODULE
 SG_ SIG_1AC_07 : 100|12@1+ (0.1,0.0) [0|4095] "m" BODY_CONTROL_MODULE
 SG_ SIG_1AC_08 : 112|12@1+ (0.1,0.0) [0|4095] "Nm" BODY_CONTROL_MODULE
 SG_ SIG_1AC_09 : 124|12@1+ (0.1,0.0) [0|4095] "rpm" BODY_CONTROL_MODULE
 SG_ SIG_1AC_10 : 136|12@1+ (0.1,0.0) [0|4095] "C" BODY_CONTROL_MODULE
 SG_ SIG_1AC_11 : 148|12@1+ (0.1,0.0) [0|4095] "deg" BODY_CONTROL_MODULE
 SG_ RouteInfoChar_00 : 160|8@1+ (1,0) [0|255] "ascii" BODY_CONTROL_MODULE
 SG_ RouteInfoChar_01 : 168|8@1+ (1,0) [0|255] "ascii" BODY_CONTROL_MODULE
 SG_ RouteInfoChar_02 : 176|8@1+ (1,0) [0|255] "ascii" BODY_CONTROL_MODULE
 SG_ RouteInfoChar_03 : 184|8@1+ (1,0) [0|255] "ascii" BODY_CONTROL_MODULE
 SG_ RouteInfoChar_04 : 192|8@1+ (1,0) [0|255] "ascii" BODY_CONTROL_MODULE
 SG_ RouteInfoChar_05 : 200|8@1+ (1,0) [0|255] "ascii" BODY_CONTROL_MODULE
 SG_ RouteInfoChar_06 : 208|8@1+ (1,0) [0|255] "ascii" BODY_CONTROL_MODULE
 SG_ RouteInfoChar_07 : 216|8@1+ (1,0) [0|255] "ascii" BODY_CONTROL_MODULE
 SG_ RouteInfoChar_08 : 224|8@1+ (1,0) [0|255] "ascii" BODY_CONTROL_MODULE
 SG_ RouteInfoChar_09 : 232|8@1+ (1,0) [0|255] "ascii" BODY_CONTROL_MODULE
 SG_ RouteInfoChar_10 : 240|8@1+ (1,0) [0|255] "ascii" BODY_CONTROL_MODULE
 SG_ RouteInfoChar_11 : 248|8@1+ (1,0) [0|255] "ascii" BODY_CONTROL_MODULE
 SG_ RouteInfoChar_12 : 256|8@1+ (1,0) [0|255] "ascii" BODY_CONTROL_MODULE
 SG_ RouteInfoChar_13 : 264|8@1+ (1,0) [0|255] "ascii" BODY_CONTROL_MODULE
 SG_ RouteInfoChar_14 : 272|8@1+ (1,0) [0|255] "ascii" BODY_CONTROL_MODULE
 SG_ RouteInfoChar_15 : 280|8@1+ (1,0) [0|255] "ascii" BODY_CONTROL_MODULE
 SG_ RouteInfoChar_16 : 288|8@1+ (1,0) [0|255] "ascii" BODY_CONTROL_MODULE
 SG_ RouteInfoChar_17 : 296|8@1+ (1,0) [0|255] "ascii" BODY_CONTROL_MODULE
 SG_ RouteInfoChar_18 : 304|8@1+ (1,0) [0|255] "ascii" BODY_CONTROL_MODULE
 SG_ RouteInfoChar_19 : 312|8@1+ (1,0) [0|255] "ascii" BODY_CONTROL_MODULE
 SG_ RouteInfoChar_20 : 320|8@1+ (1,0) [0|255] "ascii" BODY_CONTROL_MODULE
 SG_ RouteInfoChar_21 : 328|8@1+ (1,0) [0|255] "ascii" BODY_CONTROL_MODULE
 SG_ RouteInfoChar_22 : 336|8@1+ (1,0) [0|255] "ascii" BODY_CONTROL_MODULE
 SG_ RouteInfoChar_23 : 344|8@1+ (1,0) [0|255] "ascii" BODY_CONTROL_MODULE
 SG_ RouteInfoChar_24 : 352|8@1+ (1,0) [0|255] "ascii" BODY_CONTROL_MODULE
 SG_ RouteInfoChar_25 : 360|8@1+ (1,0) [0|255] "ascii" BODY_CONTROL_MODULE
 SG_ RouteInfoChar_26 : 368|8@1+ (1,0) [0|255] "ascii" BODY_CONTROL_MODULE
 SG_ RouteInfoChar_27 : 376|8@1+ (1,0) [0|255] "ascii" BODY_CONTROL_MODULE
 SG_ RouteInfoChar_28 : 384|8@1+ (1,0) [0|255] "ascii" BODY_CONTROL_MODULE
 SG_ RouteInfoChar_29 : 392|8@1+ (1,0) [0|255] "ascii" BODY_CONTROL_MODULE
 SG_ RouteInfoChar_30 : 400|8@1+ (1,0) [0|255] "ascii" BODY_CONTROL_MODULE
 SG_ RouteInfoChar_31 : 408|8@1+ (1,0) [0|255] "ascii" BODY_CONTROL_MODULE
 SG_ RouteInfoChar_32 : 416|8@1+ (1,0) [0|255] "ascii" BODY_CONTROL_MODULE
 SG_ RouteInfoChar_33 : 424|8@1+ (1,0) [0|255] "ascii" BODY_CONTROL_MODULE
 SG_ RouteInfoChar_34 : 432|8@1+ (1,0) [0|255] "ascii" BODY_CONTROL_MODULE
 SG_ RouteInfoChar_35 : 440|8@1+ (1,0) [0|255] "ascii" BODY_CONTROL_MODULE
 SG_ RouteInfoChar_36 : 448|8@1+ (1,0) [0|255] "ascii" BODY_CONTROL_MODULE
 SG_ RouteInfoChar_37 : 456|8@1+ (1,0) [0|255] "ascii" BODY_CONTROL_MODULE
 SG_ RouteInfoChar_38 : 464|8@1+ (1,0) [0|255] "ascii" BODY_CONTROL_MODULE
 SG_ RouteInfoChar_39 : 472|8@1+ (1,0) [0|255] "ascii" BODY_CONTROL_MODULE
 SG_ RouteInfoChar_40 : 480|8@1+ (1,0) [0|255] "ascii" BODY_CONTROL_MODULE
 SG_ RouteInfoChar_41 : 488|8@1+ (1,0) [0|255] "ascii" BODY_CONTROL_MODULE
 SG_ RouteInfoChar_42 : 496|8@1+ (1,0) [0|255] "ascii" BODY_CONTROL_MODULE
 SG_ RouteInfoChar_43 : 504|8@1+ (1,0) [0|255] "ascii" BODY_CONTROL_MODULE

CM_ BO_ 428 "Cycle=50ms; Channel=CAN0; CAN-FD; NominalBitrate=500kbit/s; DataBitrate=2000kbit/s;  Data request; receiver answers with response frame; PayloadRouteInfo='DOOR_MODULE_RR -> BODY_CONTROL_MODULE' in bytes 20-63;";

BO_ 1580 RESP_044_BODY_CONTROL_MODULE_TO_DOOR_MODULE_RR: 16 BODY_CONTROL_MODULE
 SG_ CRC8 : 0|8@1+ (1,0) [0|255] "" DOOR_MODULE_RR
 SG_ ResponseCounter : 8|4@1+ (1,0) [0|15] "" DOOR_MODULE_RR
 SG_ AckState : 12|4@1+ (1,0) [0|15] "" DOOR_MODULE_RR
 SG_ ReceivedFrameId : 16|11@1+ (1,0) [0|2047] "" DOOR_MODULE_RR
 SG_ ReceivedCounter : 27|4@1+ (1,0) [0|15] "" DOOR_MODULE_RR
 SG_ ChecksumOk : 31|1@1+ (1,0) [0|1] "" DOOR_MODULE_RR
 SG_ PayloadLength : 32|8@1+ (1,0) [0|64] "byte" DOOR_MODULE_RR
 SG_ ErrorCode : 40|8@1+ (1,0) [0|255] "" DOOR_MODULE_RR
 SG_ ProcessingTimeUs : 48|16@1+ (1,0) [0|65535] "us" DOOR_MODULE_RR
 SG_ ResponseSequence : 64|16@1+ (1,0) [0|65535] "" DOOR_MODULE_RR
 SG_ ReceivedCrc : 80|8@1+ (1,0) [0|255] "" DOOR_MODULE_RR
 SG_ CalculatedCrc : 88|8@1+ (1,0) [0|255] "" DOOR_MODULE_RR

CM_ BO_ 1580 "Cycle=50ms; Channel=CAN0; CAN-FD; NominalBitrate=500kbit/s; DataBitrate=2000kbit/s;  ResponseFor=0x1AC; ACK/NACK with CRC, DLC and counter check;";

BO_ 429 DATA_045_DOOR_MODULE_RR_LOCK_STATUS_TO_BODY_CONTROL_MODULE: 64 DOOR_MODULE_RR
 SG_ CRC8 : 0|8@1+ (1,0) [0|255] "" BODY_CONTROL_MODULE
 SG_ AliveCounter : 8|4@1+ (1,0) [0|15] "" BODY_CONTROL_MODULE
 SG_ MuxState : 12|4@1+ (1,0) [0|15] "" BODY_CONTROL_MODULE
 SG_ SIG_1AD_00 : 16|12@1+ (0.1,0.0) [0|4095] "C" BODY_CONTROL_MODULE
 SG_ SIG_1AD_01 : 28|12@1+ (0.1,0.0) [0|4095] "m" BODY_CONTROL_MODULE
 SG_ SIG_1AD_02 : 40|12@1+ (0.1,0.0) [0|4095] "m" BODY_CONTROL_MODULE
 SG_ SIG_1AD_03 : 52|12@1+ (0.1,0.0) [0|4095] "obj" BODY_CONTROL_MODULE
 SG_ SIG_1AD_04 : 64|12@1+ (0.1,0.0) [0|4095] "A" BODY_CONTROL_MODULE
 SG_ SIG_1AD_05 : 76|12@1+ (0.1,0.0) [0|4095] "C" BODY_CONTROL_MODULE
 SG_ SIG_1AD_06 : 88|12@1+ (0.1,0.0) [0|4095] "obj" BODY_CONTROL_MODULE
 SG_ SIG_1AD_07 : 100|12@1+ (0.1,0.0) [0|4095] "m" BODY_CONTROL_MODULE
 SG_ SIG_1AD_08 : 112|12@1+ (0.1,0.0) [0|4095] "%" BODY_CONTROL_MODULE
 SG_ SIG_1AD_09 : 124|12@1+ (0.1,0.0) [0|4095] "m" BODY_CONTROL_MODULE
 SG_ SIG_1AD_10 : 136|12@1+ (0.1,0.0) [0|4095] "C" BODY_CONTROL_MODULE
 SG_ SIG_1AD_11 : 148|12@1+ (0.1,0.0) [0|4095] "deg" BODY_CONTROL_MODULE
 SG_ RouteInfoChar_00 : 160|8@1+ (1,0) [0|255] "ascii" BODY_CONTROL_MODULE
 SG_ RouteInfoChar_01 : 168|8@1+ (1,0) [0|255] "ascii" BODY_CONTROL_MODULE
 SG_ RouteInfoChar_02 : 176|8@1+ (1,0) [0|255] "ascii" BODY_CONTROL_MODULE
 SG_ RouteInfoChar_03 : 184|8@1+ (1,0) [0|255] "ascii" BODY_CONTROL_MODULE
 SG_ RouteInfoChar_04 : 192|8@1+ (1,0) [0|255] "ascii" BODY_CONTROL_MODULE
 SG_ RouteInfoChar_05 : 200|8@1+ (1,0) [0|255] "ascii" BODY_CONTROL_MODULE
 SG_ RouteInfoChar_06 : 208|8@1+ (1,0) [0|255] "ascii" BODY_CONTROL_MODULE
 SG_ RouteInfoChar_07 : 216|8@1+ (1,0) [0|255] "ascii" BODY_CONTROL_MODULE
 SG_ RouteInfoChar_08 : 224|8@1+ (1,0) [0|255] "ascii" BODY_CONTROL_MODULE
 SG_ RouteInfoChar_09 : 232|8@1+ (1,0) [0|255] "ascii" BODY_CONTROL_MODULE
 SG_ RouteInfoChar_10 : 240|8@1+ (1,0) [0|255] "ascii" BODY_CONTROL_MODULE
 SG_ RouteInfoChar_11 : 248|8@1+ (1,0) [0|255] "ascii" BODY_CONTROL_MODULE
 SG_ RouteInfoChar_12 : 256|8@1+ (1,0) [0|255] "ascii" BODY_CONTROL_MODULE
 SG_ RouteInfoChar_13 : 264|8@1+ (1,0) [0|255] "ascii" BODY_CONTROL_MODULE
 SG_ RouteInfoChar_14 : 272|8@1+ (1,0) [0|255] "ascii" BODY_CONTROL_MODULE
 SG_ RouteInfoChar_15 : 280|8@1+ (1,0) [0|255] "ascii" BODY_CONTROL_MODULE
 SG_ RouteInfoChar_16 : 288|8@1+ (1,0) [0|255] "ascii" BODY_CONTROL_MODULE
 SG_ RouteInfoChar_17 : 296|8@1+ (1,0) [0|255] "ascii" BODY_CONTROL_MODULE
 SG_ RouteInfoChar_18 : 304|8@1+ (1,0) [0|255] "ascii" BODY_CONTROL_MODULE
 SG_ RouteInfoChar_19 : 312|8@1+ (1,0) [0|255] "ascii" BODY_CONTROL_MODULE
 SG_ RouteInfoChar_20 : 320|8@1+ (1,0) [0|255] "ascii" BODY_CONTROL_MODULE
 SG_ RouteInfoChar_21 : 328|8@1+ (1,0) [0|255] "ascii" BODY_CONTROL_MODULE
 SG_ RouteInfoChar_22 : 336|8@1+ (1,0) [0|255] "ascii" BODY_CONTROL_MODULE
 SG_ RouteInfoChar_23 : 344|8@1+ (1,0) [0|255] "ascii" BODY_CONTROL_MODULE
 SG_ RouteInfoChar_24 : 352|8@1+ (1,0) [0|255] "ascii" BODY_CONTROL_MODULE
 SG_ RouteInfoChar_25 : 360|8@1+ (1,0) [0|255] "ascii" BODY_CONTROL_MODULE
 SG_ RouteInfoChar_26 : 368|8@1+ (1,0) [0|255] "ascii" BODY_CONTROL_MODULE
 SG_ RouteInfoChar_27 : 376|8@1+ (1,0) [0|255] "ascii" BODY_CONTROL_MODULE
 SG_ RouteInfoChar_28 : 384|8@1+ (1,0) [0|255] "ascii" BODY_CONTROL_MODULE
 SG_ RouteInfoChar_29 : 392|8@1+ (1,0) [0|255] "ascii" BODY_CONTROL_MODULE
 SG_ RouteInfoChar_30 : 400|8@1+ (1,0) [0|255] "ascii" BODY_CONTROL_MODULE
 SG_ RouteInfoChar_31 : 408|8@1+ (1,0) [0|255] "ascii" BODY_CONTROL_MODULE
 SG_ RouteInfoChar_32 : 416|8@1+ (1,0) [0|255] "ascii" BODY_CONTROL_MODULE
 SG_ RouteInfoChar_33 : 424|8@1+ (1,0) [0|255] "ascii" BODY_CONTROL_MODULE
 SG_ RouteInfoChar_34 : 432|8@1+ (1,0) [0|255] "ascii" BODY_CONTROL_MODULE
 SG_ RouteInfoChar_35 : 440|8@1+ (1,0) [0|255] "ascii" BODY_CONTROL_MODULE
 SG_ RouteInfoChar_36 : 448|8@1+ (1,0) [0|255] "ascii" BODY_CONTROL_MODULE
 SG_ RouteInfoChar_37 : 456|8@1+ (1,0) [0|255] "ascii" BODY_CONTROL_MODULE
 SG_ RouteInfoChar_38 : 464|8@1+ (1,0) [0|255] "ascii" BODY_CONTROL_MODULE
 SG_ RouteInfoChar_39 : 472|8@1+ (1,0) [0|255] "ascii" BODY_CONTROL_MODULE
 SG_ RouteInfoChar_40 : 480|8@1+ (1,0) [0|255] "ascii" BODY_CONTROL_MODULE
 SG_ RouteInfoChar_41 : 488|8@1+ (1,0) [0|255] "ascii" BODY_CONTROL_MODULE
 SG_ RouteInfoChar_42 : 496|8@1+ (1,0) [0|255] "ascii" BODY_CONTROL_MODULE
 SG_ RouteInfoChar_43 : 504|8@1+ (1,0) [0|255] "ascii" BODY_CONTROL_MODULE

CM_ BO_ 429 "Cycle=50ms; Channel=CAN0; CAN-FD; NominalBitrate=500kbit/s; DataBitrate=2000kbit/s;  Data request; receiver answers with response frame; PayloadRouteInfo='DOOR_MODULE_RR -> BODY_CONTROL_MODULE' in bytes 20-63;";

BO_ 1581 RESP_045_BODY_CONTROL_MODULE_TO_DOOR_MODULE_RR: 16 BODY_CONTROL_MODULE
 SG_ CRC8 : 0|8@1+ (1,0) [0|255] "" DOOR_MODULE_RR
 SG_ ResponseCounter : 8|4@1+ (1,0) [0|15] "" DOOR_MODULE_RR
 SG_ AckState : 12|4@1+ (1,0) [0|15] "" DOOR_MODULE_RR
 SG_ ReceivedFrameId : 16|11@1+ (1,0) [0|2047] "" DOOR_MODULE_RR
 SG_ ReceivedCounter : 27|4@1+ (1,0) [0|15] "" DOOR_MODULE_RR
 SG_ ChecksumOk : 31|1@1+ (1,0) [0|1] "" DOOR_MODULE_RR
 SG_ PayloadLength : 32|8@1+ (1,0) [0|64] "byte" DOOR_MODULE_RR
 SG_ ErrorCode : 40|8@1+ (1,0) [0|255] "" DOOR_MODULE_RR
 SG_ ProcessingTimeUs : 48|16@1+ (1,0) [0|65535] "us" DOOR_MODULE_RR
 SG_ ResponseSequence : 64|16@1+ (1,0) [0|65535] "" DOOR_MODULE_RR
 SG_ ReceivedCrc : 80|8@1+ (1,0) [0|255] "" DOOR_MODULE_RR
 SG_ CalculatedCrc : 88|8@1+ (1,0) [0|255] "" DOOR_MODULE_RR

CM_ BO_ 1581 "Cycle=50ms; Channel=CAN0; CAN-FD; NominalBitrate=500kbit/s; DataBitrate=2000kbit/s;  ResponseFor=0x1AD; ACK/NACK with CRC, DLC and counter check;";

BO_ 430 DATA_046_LIGHT_CONTROL_MODULE_LIGHT_STATUS_TO_INSTRUMENT_CLUSTER_KOMBI: 64 LIGHT_CONTROL_MODULE
 SG_ CRC8 : 0|8@1+ (1,0) [0|255] "" INSTRUMENT_CLUSTER_KOMBI
 SG_ AliveCounter : 8|4@1+ (1,0) [0|15] "" INSTRUMENT_CLUSTER_KOMBI
 SG_ MuxState : 12|4@1+ (1,0) [0|15] "" INSTRUMENT_CLUSTER_KOMBI
 SG_ SIG_1AE_00 : 16|12@1+ (0.1,0.0) [0|4095] "C" INSTRUMENT_CLUSTER_KOMBI
 SG_ SIG_1AE_01 : 28|12@1+ (0.1,0.0) [0|4095] "C" INSTRUMENT_CLUSTER_KOMBI
 SG_ SIG_1AE_02 : 40|12@1+ (0.1,0.0) [0|4095] "V" INSTRUMENT_CLUSTER_KOMBI
 SG_ SIG_1AE_03 : 52|12@1+ (0.1,0.0) [0|4095] "Nm" INSTRUMENT_CLUSTER_KOMBI
 SG_ SIG_1AE_04 : 64|12@1+ (0.1,0.0) [0|4095] "V" INSTRUMENT_CLUSTER_KOMBI
 SG_ SIG_1AE_05 : 76|12@1+ (0.1,0.0) [0|4095] "m" INSTRUMENT_CLUSTER_KOMBI
 SG_ SIG_1AE_06 : 88|12@1+ (0.1,0.0) [0|4095] "C" INSTRUMENT_CLUSTER_KOMBI
 SG_ SIG_1AE_07 : 100|12@1+ (0.1,0.0) [0|4095] "Nm" INSTRUMENT_CLUSTER_KOMBI
 SG_ SIG_1AE_08 : 112|12@1+ (0.1,0.0) [0|4095] "V" INSTRUMENT_CLUSTER_KOMBI
 SG_ SIG_1AE_09 : 124|12@1+ (0.1,0.0) [0|4095] "C" INSTRUMENT_CLUSTER_KOMBI
 SG_ SIG_1AE_10 : 136|12@1+ (0.1,0.0) [0|4095] "rpm" INSTRUMENT_CLUSTER_KOMBI
 SG_ SIG_1AE_11 : 148|12@1+ (0.1,0.0) [0|4095] "V" INSTRUMENT_CLUSTER_KOMBI
 SG_ RouteInfoChar_00 : 160|8@1+ (1,0) [0|255] "ascii" INSTRUMENT_CLUSTER_KOMBI
 SG_ RouteInfoChar_01 : 168|8@1+ (1,0) [0|255] "ascii" INSTRUMENT_CLUSTER_KOMBI
 SG_ RouteInfoChar_02 : 176|8@1+ (1,0) [0|255] "ascii" INSTRUMENT_CLUSTER_KOMBI
 SG_ RouteInfoChar_03 : 184|8@1+ (1,0) [0|255] "ascii" INSTRUMENT_CLUSTER_KOMBI
 SG_ RouteInfoChar_04 : 192|8@1+ (1,0) [0|255] "ascii" INSTRUMENT_CLUSTER_KOMBI
 SG_ RouteInfoChar_05 : 200|8@1+ (1,0) [0|255] "ascii" INSTRUMENT_CLUSTER_KOMBI
 SG_ RouteInfoChar_06 : 208|8@1+ (1,0) [0|255] "ascii" INSTRUMENT_CLUSTER_KOMBI
 SG_ RouteInfoChar_07 : 216|8@1+ (1,0) [0|255] "ascii" INSTRUMENT_CLUSTER_KOMBI
 SG_ RouteInfoChar_08 : 224|8@1+ (1,0) [0|255] "ascii" INSTRUMENT_CLUSTER_KOMBI
 SG_ RouteInfoChar_09 : 232|8@1+ (1,0) [0|255] "ascii" INSTRUMENT_CLUSTER_KOMBI
 SG_ RouteInfoChar_10 : 240|8@1+ (1,0) [0|255] "ascii" INSTRUMENT_CLUSTER_KOMBI
 SG_ RouteInfoChar_11 : 248|8@1+ (1,0) [0|255] "ascii" INSTRUMENT_CLUSTER_KOMBI
 SG_ RouteInfoChar_12 : 256|8@1+ (1,0) [0|255] "ascii" INSTRUMENT_CLUSTER_KOMBI
 SG_ RouteInfoChar_13 : 264|8@1+ (1,0) [0|255] "ascii" INSTRUMENT_CLUSTER_KOMBI
 SG_ RouteInfoChar_14 : 272|8@1+ (1,0) [0|255] "ascii" INSTRUMENT_CLUSTER_KOMBI
 SG_ RouteInfoChar_15 : 280|8@1+ (1,0) [0|255] "ascii" INSTRUMENT_CLUSTER_KOMBI
 SG_ RouteInfoChar_16 : 288|8@1+ (1,0) [0|255] "ascii" INSTRUMENT_CLUSTER_KOMBI
 SG_ RouteInfoChar_17 : 296|8@1+ (1,0) [0|255] "ascii" INSTRUMENT_CLUSTER_KOMBI
 SG_ RouteInfoChar_18 : 304|8@1+ (1,0) [0|255] "ascii" INSTRUMENT_CLUSTER_KOMBI
 SG_ RouteInfoChar_19 : 312|8@1+ (1,0) [0|255] "ascii" INSTRUMENT_CLUSTER_KOMBI
 SG_ RouteInfoChar_20 : 320|8@1+ (1,0) [0|255] "ascii" INSTRUMENT_CLUSTER_KOMBI
 SG_ RouteInfoChar_21 : 328|8@1+ (1,0) [0|255] "ascii" INSTRUMENT_CLUSTER_KOMBI
 SG_ RouteInfoChar_22 : 336|8@1+ (1,0) [0|255] "ascii" INSTRUMENT_CLUSTER_KOMBI
 SG_ RouteInfoChar_23 : 344|8@1+ (1,0) [0|255] "ascii" INSTRUMENT_CLUSTER_KOMBI
 SG_ RouteInfoChar_24 : 352|8@1+ (1,0) [0|255] "ascii" INSTRUMENT_CLUSTER_KOMBI
 SG_ RouteInfoChar_25 : 360|8@1+ (1,0) [0|255] "ascii" INSTRUMENT_CLUSTER_KOMBI
 SG_ RouteInfoChar_26 : 368|8@1+ (1,0) [0|255] "ascii" INSTRUMENT_CLUSTER_KOMBI
 SG_ RouteInfoChar_27 : 376|8@1+ (1,0) [0|255] "ascii" INSTRUMENT_CLUSTER_KOMBI
 SG_ RouteInfoChar_28 : 384|8@1+ (1,0) [0|255] "ascii" INSTRUMENT_CLUSTER_KOMBI
 SG_ RouteInfoChar_29 : 392|8@1+ (1,0) [0|255] "ascii" INSTRUMENT_CLUSTER_KOMBI
 SG_ RouteInfoChar_30 : 400|8@1+ (1,0) [0|255] "ascii" INSTRUMENT_CLUSTER_KOMBI
 SG_ RouteInfoChar_31 : 408|8@1+ (1,0) [0|255] "ascii" INSTRUMENT_CLUSTER_KOMBI
 SG_ RouteInfoChar_32 : 416|8@1+ (1,0) [0|255] "ascii" INSTRUMENT_CLUSTER_KOMBI
 SG_ RouteInfoChar_33 : 424|8@1+ (1,0) [0|255] "ascii" INSTRUMENT_CLUSTER_KOMBI
 SG_ RouteInfoChar_34 : 432|8@1+ (1,0) [0|255] "ascii" INSTRUMENT_CLUSTER_KOMBI
 SG_ RouteInfoChar_35 : 440|8@1+ (1,0) [0|255] "ascii" INSTRUMENT_CLUSTER_KOMBI
 SG_ RouteInfoChar_36 : 448|8@1+ (1,0) [0|255] "ascii" INSTRUMENT_CLUSTER_KOMBI
 SG_ RouteInfoChar_37 : 456|8@1+ (1,0) [0|255] "ascii" INSTRUMENT_CLUSTER_KOMBI
 SG_ RouteInfoChar_38 : 464|8@1+ (1,0) [0|255] "ascii" INSTRUMENT_CLUSTER_KOMBI
 SG_ RouteInfoChar_39 : 472|8@1+ (1,0) [0|255] "ascii" INSTRUMENT_CLUSTER_KOMBI
 SG_ RouteInfoChar_40 : 480|8@1+ (1,0) [0|255] "ascii" INSTRUMENT_CLUSTER_KOMBI
 SG_ RouteInfoChar_41 : 488|8@1+ (1,0) [0|255] "ascii" INSTRUMENT_CLUSTER_KOMBI
 SG_ RouteInfoChar_42 : 496|8@1+ (1,0) [0|255] "ascii" INSTRUMENT_CLUSTER_KOMBI
 SG_ RouteInfoChar_43 : 504|8@1+ (1,0) [0|255] "ascii" INSTRUMENT_CLUSTER_KOMBI

CM_ BO_ 430 "Cycle=20ms; Channel=CAN1; CAN-FD; NominalBitrate=500kbit/s; DataBitrate=2000kbit/s;  Data request; receiver answers with response frame; PayloadRouteInfo='LIGHT_CONTROL_MODULE -> INSTRUMENT_CLUSTER_KOMBI' in bytes 20-63; Gateway to CAN3";

BO_ 1582 RESP_046_INSTRUMENT_CLUSTER_KOMBI_TO_LIGHT_CONTROL_MODULE: 16 INSTRUMENT_CLUSTER_KOMBI
 SG_ CRC8 : 0|8@1+ (1,0) [0|255] "" LIGHT_CONTROL_MODULE
 SG_ ResponseCounter : 8|4@1+ (1,0) [0|15] "" LIGHT_CONTROL_MODULE
 SG_ AckState : 12|4@1+ (1,0) [0|15] "" LIGHT_CONTROL_MODULE
 SG_ ReceivedFrameId : 16|11@1+ (1,0) [0|2047] "" LIGHT_CONTROL_MODULE
 SG_ ReceivedCounter : 27|4@1+ (1,0) [0|15] "" LIGHT_CONTROL_MODULE
 SG_ ChecksumOk : 31|1@1+ (1,0) [0|1] "" LIGHT_CONTROL_MODULE
 SG_ PayloadLength : 32|8@1+ (1,0) [0|64] "byte" LIGHT_CONTROL_MODULE
 SG_ ErrorCode : 40|8@1+ (1,0) [0|255] "" LIGHT_CONTROL_MODULE
 SG_ ProcessingTimeUs : 48|16@1+ (1,0) [0|65535] "us" LIGHT_CONTROL_MODULE
 SG_ ResponseSequence : 64|16@1+ (1,0) [0|65535] "" LIGHT_CONTROL_MODULE
 SG_ ReceivedCrc : 80|8@1+ (1,0) [0|255] "" LIGHT_CONTROL_MODULE
 SG_ CalculatedCrc : 88|8@1+ (1,0) [0|255] "" LIGHT_CONTROL_MODULE

CM_ BO_ 1582 "Cycle=20ms; Channel=CAN1; CAN-FD; NominalBitrate=500kbit/s; DataBitrate=2000kbit/s;  ResponseFor=0x1AE; ACK/NACK with CRC, DLC and counter check;";

BO_ 431 DATA_047_RAIN_LIGHT_SENSOR_RAIN_LIGHT_STATUS_TO_BODY_CONTROL_MODULE: 64 RAIN_LIGHT_SENSOR
 SG_ CRC8 : 0|8@1+ (1,0) [0|255] "" BODY_CONTROL_MODULE
 SG_ AliveCounter : 8|4@1+ (1,0) [0|15] "" BODY_CONTROL_MODULE
 SG_ MuxState : 12|4@1+ (1,0) [0|15] "" BODY_CONTROL_MODULE
 SG_ SIG_1AF_00 : 16|12@1+ (0.1,0.0) [0|4095] "Nm" BODY_CONTROL_MODULE
 SG_ SIG_1AF_01 : 28|12@1+ (0.1,0.0) [0|4095] "V" BODY_CONTROL_MODULE
 SG_ SIG_1AF_02 : 40|12@1+ (0.1,0.0) [0|4095] "A" BODY_CONTROL_MODULE
 SG_ SIG_1AF_03 : 52|12@1+ (0.1,0.0) [0|4095] "A" BODY_CONTROL_MODULE
 SG_ SIG_1AF_04 : 64|12@1+ (0.1,0.0) [0|4095] "m" BODY_CONTROL_MODULE
 SG_ SIG_1AF_05 : 76|12@1+ (0.1,0.0) [0|4095] "rpm" BODY_CONTROL_MODULE
 SG_ SIG_1AF_06 : 88|12@1+ (0.1,0.0) [0|4095] "deg" BODY_CONTROL_MODULE
 SG_ SIG_1AF_07 : 100|12@1+ (0.1,0.0) [0|4095] "deg" BODY_CONTROL_MODULE
 SG_ SIG_1AF_08 : 112|12@1+ (0.1,0.0) [0|4095] "Nm" BODY_CONTROL_MODULE
 SG_ SIG_1AF_09 : 124|12@1+ (0.1,0.0) [0|4095] "%" BODY_CONTROL_MODULE
 SG_ SIG_1AF_10 : 136|12@1+ (0.1,0.0) [0|4095] "deg" BODY_CONTROL_MODULE
 SG_ SIG_1AF_11 : 148|12@1+ (0.1,0.0) [0|4095] "Nm" BODY_CONTROL_MODULE
 SG_ RouteInfoChar_00 : 160|8@1+ (1,0) [0|255] "ascii" BODY_CONTROL_MODULE
 SG_ RouteInfoChar_01 : 168|8@1+ (1,0) [0|255] "ascii" BODY_CONTROL_MODULE
 SG_ RouteInfoChar_02 : 176|8@1+ (1,0) [0|255] "ascii" BODY_CONTROL_MODULE
 SG_ RouteInfoChar_03 : 184|8@1+ (1,0) [0|255] "ascii" BODY_CONTROL_MODULE
 SG_ RouteInfoChar_04 : 192|8@1+ (1,0) [0|255] "ascii" BODY_CONTROL_MODULE
 SG_ RouteInfoChar_05 : 200|8@1+ (1,0) [0|255] "ascii" BODY_CONTROL_MODULE
 SG_ RouteInfoChar_06 : 208|8@1+ (1,0) [0|255] "ascii" BODY_CONTROL_MODULE
 SG_ RouteInfoChar_07 : 216|8@1+ (1,0) [0|255] "ascii" BODY_CONTROL_MODULE
 SG_ RouteInfoChar_08 : 224|8@1+ (1,0) [0|255] "ascii" BODY_CONTROL_MODULE
 SG_ RouteInfoChar_09 : 232|8@1+ (1,0) [0|255] "ascii" BODY_CONTROL_MODULE
 SG_ RouteInfoChar_10 : 240|8@1+ (1,0) [0|255] "ascii" BODY_CONTROL_MODULE
 SG_ RouteInfoChar_11 : 248|8@1+ (1,0) [0|255] "ascii" BODY_CONTROL_MODULE
 SG_ RouteInfoChar_12 : 256|8@1+ (1,0) [0|255] "ascii" BODY_CONTROL_MODULE
 SG_ RouteInfoChar_13 : 264|8@1+ (1,0) [0|255] "ascii" BODY_CONTROL_MODULE
 SG_ RouteInfoChar_14 : 272|8@1+ (1,0) [0|255] "ascii" BODY_CONTROL_MODULE
 SG_ RouteInfoChar_15 : 280|8@1+ (1,0) [0|255] "ascii" BODY_CONTROL_MODULE
 SG_ RouteInfoChar_16 : 288|8@1+ (1,0) [0|255] "ascii" BODY_CONTROL_MODULE
 SG_ RouteInfoChar_17 : 296|8@1+ (1,0) [0|255] "ascii" BODY_CONTROL_MODULE
 SG_ RouteInfoChar_18 : 304|8@1+ (1,0) [0|255] "ascii" BODY_CONTROL_MODULE
 SG_ RouteInfoChar_19 : 312|8@1+ (1,0) [0|255] "ascii" BODY_CONTROL_MODULE
 SG_ RouteInfoChar_20 : 320|8@1+ (1,0) [0|255] "ascii" BODY_CONTROL_MODULE
 SG_ RouteInfoChar_21 : 328|8@1+ (1,0) [0|255] "ascii" BODY_CONTROL_MODULE
 SG_ RouteInfoChar_22 : 336|8@1+ (1,0) [0|255] "ascii" BODY_CONTROL_MODULE
 SG_ RouteInfoChar_23 : 344|8@1+ (1,0) [0|255] "ascii" BODY_CONTROL_MODULE
 SG_ RouteInfoChar_24 : 352|8@1+ (1,0) [0|255] "ascii" BODY_CONTROL_MODULE
 SG_ RouteInfoChar_25 : 360|8@1+ (1,0) [0|255] "ascii" BODY_CONTROL_MODULE
 SG_ RouteInfoChar_26 : 368|8@1+ (1,0) [0|255] "ascii" BODY_CONTROL_MODULE
 SG_ RouteInfoChar_27 : 376|8@1+ (1,0) [0|255] "ascii" BODY_CONTROL_MODULE
 SG_ RouteInfoChar_28 : 384|8@1+ (1,0) [0|255] "ascii" BODY_CONTROL_MODULE
 SG_ RouteInfoChar_29 : 392|8@1+ (1,0) [0|255] "ascii" BODY_CONTROL_MODULE
 SG_ RouteInfoChar_30 : 400|8@1+ (1,0) [0|255] "ascii" BODY_CONTROL_MODULE
 SG_ RouteInfoChar_31 : 408|8@1+ (1,0) [0|255] "ascii" BODY_CONTROL_MODULE
 SG_ RouteInfoChar_32 : 416|8@1+ (1,0) [0|255] "ascii" BODY_CONTROL_MODULE
 SG_ RouteInfoChar_33 : 424|8@1+ (1,0) [0|255] "ascii" BODY_CONTROL_MODULE
 SG_ RouteInfoChar_34 : 432|8@1+ (1,0) [0|255] "ascii" BODY_CONTROL_MODULE
 SG_ RouteInfoChar_35 : 440|8@1+ (1,0) [0|255] "ascii" BODY_CONTROL_MODULE
 SG_ RouteInfoChar_36 : 448|8@1+ (1,0) [0|255] "ascii" BODY_CONTROL_MODULE
 SG_ RouteInfoChar_37 : 456|8@1+ (1,0) [0|255] "ascii" BODY_CONTROL_MODULE
 SG_ RouteInfoChar_38 : 464|8@1+ (1,0) [0|255] "ascii" BODY_CONTROL_MODULE
 SG_ RouteInfoChar_39 : 472|8@1+ (1,0) [0|255] "ascii" BODY_CONTROL_MODULE
 SG_ RouteInfoChar_40 : 480|8@1+ (1,0) [0|255] "ascii" BODY_CONTROL_MODULE
 SG_ RouteInfoChar_41 : 488|8@1+ (1,0) [0|255] "ascii" BODY_CONTROL_MODULE
 SG_ RouteInfoChar_42 : 496|8@1+ (1,0) [0|255] "ascii" BODY_CONTROL_MODULE
 SG_ RouteInfoChar_43 : 504|8@1+ (1,0) [0|255] "ascii" BODY_CONTROL_MODULE

CM_ BO_ 431 "Cycle=50ms; Channel=CAN1; CAN-FD; NominalBitrate=500kbit/s; DataBitrate=2000kbit/s;  Data request; receiver answers with response frame; PayloadRouteInfo='RAIN_LIGHT_SENSOR -> BODY_CONTROL_MODULE' in bytes 20-63;";

BO_ 1583 RESP_047_BODY_CONTROL_MODULE_TO_RAIN_LIGHT_SENSOR: 16 BODY_CONTROL_MODULE
 SG_ CRC8 : 0|8@1+ (1,0) [0|255] "" RAIN_LIGHT_SENSOR
 SG_ ResponseCounter : 8|4@1+ (1,0) [0|15] "" RAIN_LIGHT_SENSOR
 SG_ AckState : 12|4@1+ (1,0) [0|15] "" RAIN_LIGHT_SENSOR
 SG_ ReceivedFrameId : 16|11@1+ (1,0) [0|2047] "" RAIN_LIGHT_SENSOR
 SG_ ReceivedCounter : 27|4@1+ (1,0) [0|15] "" RAIN_LIGHT_SENSOR
 SG_ ChecksumOk : 31|1@1+ (1,0) [0|1] "" RAIN_LIGHT_SENSOR
 SG_ PayloadLength : 32|8@1+ (1,0) [0|64] "byte" RAIN_LIGHT_SENSOR
 SG_ ErrorCode : 40|8@1+ (1,0) [0|255] "" RAIN_LIGHT_SENSOR
 SG_ ProcessingTimeUs : 48|16@1+ (1,0) [0|65535] "us" RAIN_LIGHT_SENSOR
 SG_ ResponseSequence : 64|16@1+ (1,0) [0|65535] "" RAIN_LIGHT_SENSOR
 SG_ ReceivedCrc : 80|8@1+ (1,0) [0|255] "" RAIN_LIGHT_SENSOR
 SG_ CalculatedCrc : 88|8@1+ (1,0) [0|255] "" RAIN_LIGHT_SENSOR

CM_ BO_ 1583 "Cycle=50ms; Channel=CAN1; CAN-FD; NominalBitrate=500kbit/s; DataBitrate=2000kbit/s;  ResponseFor=0x1AF; ACK/NACK with CRC, DLC and counter check;";
