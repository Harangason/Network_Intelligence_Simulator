AUTOSAR XML (schema 4.0)
package /GeneratedCanSystem
  can cluster GeneratedCanCluster
    48 x can frame, all with can-addressing-mode=STANDARD:
      DATA_000_ADAS_DOMAIN_TRAJECTORY_PLAN_TO_STEERING_CONTROLLER: identifier=384, frame-length=64
        pdu DATA_000_ADAS_DOMAIN_TRAJECTORY_PLAN_TO_STEERING_CONTROLLER_PDU: sender=ADAS_DOMAIN, receiver=STEERING_CONTROLLER
          59 x i signal:
            CRC8: start-position=0, length=8
            AliveCounter: start-position=8, length=4
            MuxState: start-position=12, length=4
            SIG_00: start-position=16, length=12
            SIG_01: start-position=28, length=12
            SIG_02: start-position=40, length=12
            SIG_03: start-position=52, length=12
            SIG_04: start-position=64, length=12
            SIG_05: start-position=76, length=12
            SIG_06: start-position=88, length=12
            SIG_07: start-position=100, length=12
            SIG_08: start-position=112, length=12
            SIG_09: start-position=124, length=12
            SIG_10: start-position=136, length=12
            SIG_11: start-position=148, length=12
            RouteInfoChar_00: start-position=160, length=8
            RouteInfoChar_01: start-position=168, length=8
            RouteInfoChar_02: start-position=176, length=8
            RouteInfoChar_03: start-position=184, length=8
            RouteInfoChar_04: start-position=192, length=8
            RouteInfoChar_05: start-position=200, length=8
            RouteInfoChar_06: start-position=208, length=8
            RouteInfoChar_07: start-position=216, length=8
            RouteInfoChar_08: start-position=224, length=8
            RouteInfoChar_09: start-position=232, length=8
            RouteInfoChar_10: start-position=240, length=8
            RouteInfoChar_11: start-position=248, length=8
            RouteInfoChar_12: start-position=256, length=8
            RouteInfoChar_13: start-position=264, length=8
            RouteInfoChar_14: start-position=272, length=8
            RouteInfoChar_15: start-position=280, length=8
            RouteInfoChar_16: start-position=288, length=8
            RouteInfoChar_17: start-position=296, length=8
            RouteInfoChar_18: start-position=304, length=8
            RouteInfoChar_19: start-position=312, length=8
            RouteInfoChar_20: start-position=320, length=8
            RouteInfoChar_21: start-position=328, length=8
            RouteInfoChar_22: start-position=336, length=8
            RouteInfoChar_23: start-position=344, length=8
            RouteInfoChar_24: start-position=352, length=8
            RouteInfoChar_25: start-position=360, length=8
            RouteInfoChar_26: start-position=368, length=8
            RouteInfoChar_27: start-position=376, length=8
            RouteInfoChar_28: start-position=384, length=8
            RouteInfoChar_29: start-position=392, length=8
            RouteInfoChar_30: start-position=400, length=8
            RouteInfoChar_31: start-position=408, length=8
            RouteInfoChar_32: start-position=416, length=8
            RouteInfoChar_33: start-position=424, length=8
            RouteInfoChar_34: start-position=432, length=8
            RouteInfoChar_35: start-position=440, length=8
            RouteInfoChar_36: start-position=448, length=8
            RouteInfoChar_37: start-position=456, length=8
            RouteInfoChar_38: start-position=464, length=8
            RouteInfoChar_39: start-position=472, length=8
            RouteInfoChar_40: start-position=480, length=8
            RouteInfoChar_41: start-position=488, length=8
            RouteInfoChar_42: start-position=496, length=8
            RouteInfoChar_43: start-position=504, length=8
      RESP_000_STEERING_CONTROLLER_TO_ADAS_DOMAIN: identifier=1536, frame-length=16
        pdu RESP_000_STEERING_CONTROLLER_TO_ADAS_DOMAIN_PDU: sender=STEERING_CONTROLLER, receiver=ADAS_DOMAIN
          12 x i signal:
            CRC8: start-position=0, length=8
            ResponseCounter: start-position=8, length=4
            AckState: start-position=12, length=4
            ReceivedFrameId: start-position=16, length=11
            ReceivedCounter: start-position=27, length=4
            ChecksumOk: start-position=31, length=1
            PayloadLength: start-position=32, length=8
            ErrorCode: start-position=40, length=8
            ProcessingTimeUs: start-position=48, length=16
            ResponseSequence: start-position=64, length=16
            ReceivedCrc: start-position=80, length=8
            CalculatedCrc: start-position=88, length=8
      DATA_001_ADAS_DOMAIN_MOTION_REQUEST_TO_BRAKE_CONTROLLER: identifier=385, frame-length=64
        pdu DATA_001_ADAS_DOMAIN_MOTION_REQUEST_TO_BRAKE_CONTROLLER_PDU: sender=ADAS_DOMAIN, receiver=BRAKE_CONTROLLER
          59 x i signal:
            CRC8: start-position=0, length=8
            AliveCounter: start-position=8, length=4
            MuxState: start-position=12, length=4
            SIG_00: start-position=16, length=12
            SIG_01: start-position=28, length=12
            SIG_02: start-position=40, length=12
            SIG_03: start-position=52, length=12
            SIG_04: start-position=64, length=12
            SIG_05: start-position=76, length=12
            SIG_06: start-position=88, length=12
            SIG_07: start-position=100, length=12
            SIG_08: start-position=112, length=12
            SIG_09: start-position=124, length=12
            SIG_10: start-position=136, length=12
            SIG_11: start-position=148, length=12
            RouteInfoChar_00: start-position=160, length=8
            RouteInfoChar_01: start-position=168, length=8
            RouteInfoChar_02: start-position=176, length=8
            RouteInfoChar_03: start-position=184, length=8
            RouteInfoChar_04: start-position=192, length=8
            RouteInfoChar_05: start-position=200, length=8
            RouteInfoChar_06: start-position=208, length=8
            RouteInfoChar_07: start-position=216, length=8
            RouteInfoChar_08: start-position=224, length=8
            RouteInfoChar_09: start-position=232, length=8
            RouteInfoChar_10: start-position=240, length=8
            RouteInfoChar_11: start-position=248, length=8
            RouteInfoChar_12: start-position=256, length=8
            RouteInfoChar_13: start-position=264, length=8
            RouteInfoChar_14: start-position=272, length=8
            RouteInfoChar_15: start-position=280, length=8
            RouteInfoChar_16: start-position=288, length=8
            RouteInfoChar_17: start-position=296, length=8
            RouteInfoChar_18: start-position=304, length=8
            RouteInfoChar_19: start-position=312, length=8
            RouteInfoChar_20: start-position=320, length=8
            RouteInfoChar_21: start-position=328, length=8
            RouteInfoChar_22: start-position=336, length=8
            RouteInfoChar_23: start-position=344, length=8
            RouteInfoChar_24: start-position=352, length=8
            RouteInfoChar_25: start-position=360, length=8
            RouteInfoChar_26: start-position=368, length=8
            RouteInfoChar_27: start-position=376, length=8
            RouteInfoChar_28: start-position=384, length=8
            RouteInfoChar_29: start-position=392, length=8
            RouteInfoChar_30: start-position=400, length=8
            RouteInfoChar_31: start-position=408, length=8
            RouteInfoChar_32: start-position=416, length=8
            RouteInfoChar_33: start-position=424, length=8
            RouteInfoChar_34: start-position=432, length=8
            RouteInfoChar_35: start-position=440, length=8
            RouteInfoChar_36: start-position=448, length=8
            RouteInfoChar_37: start-position=456, length=8
            RouteInfoChar_38: start-position=464, length=8
            RouteInfoChar_39: start-position=472, length=8
            RouteInfoChar_40: start-position=480, length=8
            RouteInfoChar_41: start-position=488, length=8
            RouteInfoChar_42: start-position=496, length=8
            RouteInfoChar_43: start-position=504, length=8
      RESP_001_BRAKE_CONTROLLER_TO_ADAS_DOMAIN: identifier=1537, frame-length=16
        pdu RESP_001_BRAKE_CONTROLLER_TO_ADAS_DOMAIN_PDU: sender=BRAKE_CONTROLLER, receiver=ADAS_DOMAIN
          12 x i signal:
            CRC8: start-position=0, length=8
            ResponseCounter: start-position=8, length=4
            AckState: start-position=12, length=4
            ReceivedFrameId: start-position=16, length=11
            ReceivedCounter: start-position=27, length=4
            ChecksumOk: start-position=31, length=1
            PayloadLength: start-position=32, length=8
            ErrorCode: start-position=40, length=8
            ProcessingTimeUs: start-position=48, length=16
            ResponseSequence: start-position=64, length=16
            ReceivedCrc: start-position=80, length=8
            CalculatedCrc: start-position=88, length=8
      DATA_002_ADAS_DOMAIN_STEERING_TORQUE_REQUEST_TO_STEERING_CONTROLLER: identifier=386, frame-length=64
        pdu DATA_002_ADAS_DOMAIN_STEERING_TORQUE_REQUEST_TO_STEERING_CONTROLLER_PDU: sender=ADAS_DOMAIN, receiver=STEERING_CONTROLLER
          59 x i signal:
            CRC8: start-position=0, length=8
            AliveCounter: start-position=8, length=4
            MuxState: start-position=12, length=4
            SIG_00: start-position=16, length=12
            SIG_01: start-position=28, length=12
            SIG_02: start-position=40, length=12
            SIG_03: start-position=52, length=12
            SIG_04: start-position=64, length=12
            SIG_05: start-position=76, length=12
            SIG_06: start-position=88, length=12
            SIG_07: start-position=100, length=12
            SIG_08: start-position=112, length=12
            SIG_09: start-position=124, length=12
            SIG_10: start-position=136, length=12
            SIG_11: start-position=148, length=12
            RouteInfoChar_00: start-position=160, length=8
            RouteInfoChar_01: start-position=168, length=8
            RouteInfoChar_02: start-position=176, length=8
            RouteInfoChar_03: start-position=184, length=8
            RouteInfoChar_04: start-position=192, length=8
            RouteInfoChar_05: start-position=200, length=8
            RouteInfoChar_06: start-position=208, length=8
            RouteInfoChar_07: start-position=216, length=8
            RouteInfoChar_08: start-position=224, length=8
            RouteInfoChar_09: start-position=232, length=8
            RouteInfoChar_10: start-position=240, length=8
            RouteInfoChar_11: start-position=248, length=8
            RouteInfoChar_12: start-position=256, length=8
            RouteInfoChar_13: start-position=264, length=8
            RouteInfoChar_14: start-position=272, length=8
            RouteInfoChar_15: start-position=280, length=8
            RouteInfoChar_16: start-position=288, length=8
            RouteInfoChar_17: start-position=296, length=8
            RouteInfoChar_18: start-position=304, length=8
            RouteInfoChar_19: start-position=312, length=8
            RouteInfoChar_20: start-position=320, length=8
            RouteInfoChar_21: start-position=328, length=8
            RouteInfoChar_22: start-position=336, length=8
            RouteInfoChar_23: start-position=344, length=8
            RouteInfoChar_24: start-position=352, length=8
            RouteInfoChar_25: start-position=360, length=8
            RouteInfoChar_26: start-position=368, length=8
            RouteInfoChar_27: start-position=376, length=8
            RouteInfoChar_28: start-position=384, length=8
            RouteInfoChar_29: start-position=392, length=8
            RouteInfoChar_30: start-position=400, length=8
            RouteInfoChar_31: start-position=408, length=8
            RouteInfoChar_32: start-position=416, length=8
            RouteInfoChar_33: start-position=424, length=8
            RouteInfoChar_34: start-position=432, length=8
            RouteInfoChar_35: start-position=440, length=8
            RouteInfoChar_36: start-position=448, length=8
            RouteInfoChar_37: start-position=456, length=8
            RouteInfoChar_38: start-position=464, length=8
            RouteInfoChar_39: start-position=472, length=8
            RouteInfoChar_40: start-position=480, length=8
            RouteInfoChar_41: start-position=488, length=8
            RouteInfoChar_42: start-position=496, length=8
            RouteInfoChar_43: start-position=504, length=8
      RESP_002_STEERING_CONTROLLER_TO_ADAS_DOMAIN: identifier=1538, frame-length=16
        pdu RESP_002_STEERING_CONTROLLER_TO_ADAS_DOMAIN_PDU: sender=STEERING_CONTROLLER, receiver=ADAS_DOMAIN
          12 x i signal:
            CRC8: start-position=0, length=8
            ResponseCounter: start-position=8, length=4
            AckState: start-position=12, length=4
            ReceivedFrameId: start-position=16, length=11
            ReceivedCounter: start-position=27, length=4
            ChecksumOk: start-position=31, length=1
            PayloadLength: start-position=32, length=8
            ErrorCode: start-position=40, length=8
            ProcessingTimeUs: start-position=48, length=16
            ResponseSequence: start-position=64, length=16
            ReceivedCrc: start-position=80, length=8
            CalculatedCrc: start-position=88, length=8
      DATA_003_CAMERA_FRONT_WIDE_LANE_MODEL_TO_ADAS_DOMAIN: identifier=387, frame-length=64
        pdu DATA_003_CAMERA_FRONT_WIDE_LANE_MODEL_TO_ADAS_DOMAIN_PDU: sender=CAMERA_FRONT_WIDE, receiver=ADAS_DOMAIN
          59 x i signal:
            CRC8: start-position=0, length=8
            AliveCounter: start-position=8, length=4
            MuxState: start-position=12, length=4
            SIG_00: start-position=16, length=12
            SIG_01: start-position=28, length=12
            SIG_02: start-position=40, length=12
            SIG_03: start-position=52, length=12
            SIG_04: start-position=64, length=12
            SIG_05: start-position=76, length=12
            SIG_06: start-position=88, length=12
            SIG_07: start-position=100, length=12
            SIG_08: start-position=112, length=12
            SIG_09: start-position=124, length=12
            SIG_10: start-position=136, length=12
            SIG_11: start-position=148, length=12
            RouteInfoChar_00: start-position=160, length=8
            RouteInfoChar_01: start-position=168, length=8
            RouteInfoChar_02: start-position=176, length=8
            RouteInfoChar_03: start-position=184, length=8
            RouteInfoChar_04: start-position=192, length=8
            RouteInfoChar_05: start-position=200, length=8
            RouteInfoChar_06: start-position=208, length=8
            RouteInfoChar_07: start-position=216, length=8
            RouteInfoChar_08: start-position=224, length=8
            RouteInfoChar_09: start-position=232, length=8
            RouteInfoChar_10: start-position=240, length=8
            RouteInfoChar_11: start-position=248, length=8
            RouteInfoChar_12: start-position=256, length=8
            RouteInfoChar_13: start-position=264, length=8
            RouteInfoChar_14: start-position=272, length=8
            RouteInfoChar_15: start-position=280, length=8
            RouteInfoChar_16: start-position=288, length=8
            RouteInfoChar_17: start-position=296, length=8
            RouteInfoChar_18: start-position=304, length=8
            RouteInfoChar_19: start-position=312, length=8
            RouteInfoChar_20: start-position=320, length=8
            RouteInfoChar_21: start-position=328, length=8
            RouteInfoChar_22: start-position=336, length=8
            RouteInfoChar_23: start-position=344, length=8
            RouteInfoChar_24: start-position=352, length=8
            RouteInfoChar_25: start-position=360, length=8
            RouteInfoChar_26: start-position=368, length=8
            RouteInfoChar_27: start-position=376, length=8
            RouteInfoChar_28: start-position=384, length=8
            RouteInfoChar_29: start-position=392, length=8
            RouteInfoChar_30: start-position=400, length=8
            RouteInfoChar_31: start-position=408, length=8
            RouteInfoChar_32: start-position=416, length=8
            RouteInfoChar_33: start-position=424, length=8
            RouteInfoChar_34: start-position=432, length=8
            RouteInfoChar_35: start-position=440, length=8
            RouteInfoChar_36: start-position=448, length=8
            RouteInfoChar_37: start-position=456, length=8
            RouteInfoChar_38: start-position=464, length=8
            RouteInfoChar_39: start-position=472, length=8
            RouteInfoChar_40: start-position=480, length=8
            RouteInfoChar_41: start-position=488, length=8
            RouteInfoChar_42: start-position=496, length=8
            RouteInfoChar_43: start-position=504, length=8
      RESP_003_ADAS_DOMAIN_TO_CAMERA_FRONT_WIDE: identifier=1539, frame-length=16
        pdu RESP_003_ADAS_DOMAIN_TO_CAMERA_FRONT_WIDE_PDU: sender=ADAS_DOMAIN, receiver=CAMERA_FRONT_WIDE
          12 x i signal:
            CRC8: start-position=0, length=8
            ResponseCounter: start-position=8, length=4
            AckState: start-position=12, length=4
            ReceivedFrameId: start-position=16, length=11
            ReceivedCounter: start-position=27, length=4
            ChecksumOk: start-position=31, length=1
            PayloadLength: start-position=32, length=8
            ErrorCode: start-position=40, length=8
            ProcessingTimeUs: start-position=48, length=16
            ResponseSequence: start-position=64, length=16
            ReceivedCrc: start-position=80, length=8
            CalculatedCrc: start-position=88, length=8
      DATA_004_CAMERA_FRONT_WIDE_OBJECT_LIST_TO_ADAS_DOMAIN: identifier=388, frame-length=64
        pdu DATA_004_CAMERA_FRONT_WIDE_OBJECT_LIST_TO_ADAS_DOMAIN_PDU: sender=CAMERA_FRONT_WIDE, receiver=ADAS_DOMAIN
          59 x i signal:
            CRC8: start-position=0, length=8
            AliveCounter: start-position=8, length=4
            MuxState: start-position=12, length=4
            SIG_00: start-position=16, length=12
            SIG_01: start-position=28, length=12
            SIG_02: start-position=40, length=12
            SIG_03: start-position=52, length=12
            SIG_04: start-position=64, length=12
            SIG_05: start-position=76, length=12
            SIG_06: start-position=88, length=12
            SIG_07: start-position=100, length=12
            SIG_08: start-position=112, length=12
            SIG_09: start-position=124, length=12
            SIG_10: start-position=136, length=12
            SIG_11: start-position=148, length=12
            RouteInfoChar_00: start-position=160, length=8
            RouteInfoChar_01: start-position=168, length=8
            RouteInfoChar_02: start-position=176, length=8
            RouteInfoChar_03: start-position=184, length=8
            RouteInfoChar_04: start-position=192, length=8
            RouteInfoChar_05: start-position=200, length=8
            RouteInfoChar_06: start-position=208, length=8
            RouteInfoChar_07: start-position=216, length=8
            RouteInfoChar_08: start-position=224, length=8
            RouteInfoChar_09: start-position=232, length=8
            RouteInfoChar_10: start-position=240, length=8
            RouteInfoChar_11: start-position=248, length=8
            RouteInfoChar_12: start-position=256, length=8
            RouteInfoChar_13: start-position=264, length=8
            RouteInfoChar_14: start-position=272, length=8
            RouteInfoChar_15: start-position=280, length=8
            RouteInfoChar_16: start-position=288, length=8
            RouteInfoChar_17: start-position=296, length=8
            RouteInfoChar_18: start-position=304, length=8
            RouteInfoChar_19: start-position=312, length=8
            RouteInfoChar_20: start-position=320, length=8
            RouteInfoChar_21: start-position=328, length=8
            RouteInfoChar_22: start-position=336, length=8
            RouteInfoChar_23: start-position=344, length=8
            RouteInfoChar_24: start-position=352, length=8
            RouteInfoChar_25: start-position=360, length=8
            RouteInfoChar_26: start-position=368, length=8
            RouteInfoChar_27: start-position=376, length=8
            RouteInfoChar_28: start-position=384, length=8
            RouteInfoChar_29: start-position=392, length=8
            RouteInfoChar_30: start-position=400, length=8
            RouteInfoChar_31: start-position=408, length=8
            RouteInfoChar_32: start-position=416, length=8
            RouteInfoChar_33: start-position=424, length=8
            RouteInfoChar_34: start-position=432, length=8
            RouteInfoChar_35: start-position=440, length=8
            RouteInfoChar_36: start-position=448, length=8
            RouteInfoChar_37: start-position=456, length=8
            RouteInfoChar_38: start-position=464, length=8
            RouteInfoChar_39: start-position=472, length=8
            RouteInfoChar_40: start-position=480, length=8
            RouteInfoChar_41: start-position=488, length=8
            RouteInfoChar_42: start-position=496, length=8
            RouteInfoChar_43: start-position=504, length=8
      RESP_004_ADAS_DOMAIN_TO_CAMERA_FRONT_WIDE: identifier=1540, frame-length=16
        pdu RESP_004_ADAS_DOMAIN_TO_CAMERA_FRONT_WIDE_PDU: sender=ADAS_DOMAIN, receiver=CAMERA_FRONT_WIDE
          12 x i signal:
            CRC8: start-position=0, length=8
            ResponseCounter: start-position=8, length=4
            AckState: start-position=12, length=4
            ReceivedFrameId: start-position=16, length=11
            ReceivedCounter: start-position=27, length=4
            ChecksumOk: start-position=31, length=1
            PayloadLength: start-position=32, length=8
            ErrorCode: start-position=40, length=8
            ProcessingTimeUs: start-position=48, length=16
            ResponseSequence: start-position=64, length=16
            ReceivedCrc: start-position=80, length=8
            CalculatedCrc: start-position=88, length=8
      DATA_005_RADAR_FRONT_LONG_RANGE_OBJECT_LIST_TO_ADAS_DOMAIN: identifier=389, frame-length=64
        pdu DATA_005_RADAR_FRONT_LONG_RANGE_OBJECT_LIST_TO_ADAS_DOMAIN_PDU: sender=RADAR_FRONT_LONG_RANGE, receiver=ADAS_DOMAIN
          59 x i signal:
            CRC8: start-position=0, length=8
            AliveCounter: start-position=8, length=4
            MuxState: start-position=12, length=4
            SIG_00: start-position=16, length=12
            SIG_01: start-position=28, length=12
            SIG_02: start-position=40, length=12
            SIG_03: start-position=52, length=12
            SIG_04: start-position=64, length=12
            SIG_05: start-position=76, length=12
            SIG_06: start-position=88, length=12
            SIG_07: start-position=100, length=12
            SIG_08: start-position=112, length=12
            SIG_09: start-position=124, length=12
            SIG_10: start-position=136, length=12
            SIG_11: start-position=148, length=12
            RouteInfoChar_00: start-position=160, length=8
            RouteInfoChar_01: start-position=168, length=8
            RouteInfoChar_02: start-position=176, length=8
            RouteInfoChar_03: start-position=184, length=8
            RouteInfoChar_04: start-position=192, length=8
            RouteInfoChar_05: start-position=200, length=8
            RouteInfoChar_06: start-position=208, length=8
            RouteInfoChar_07: start-position=216, length=8
            RouteInfoChar_08: start-position=224, length=8
            RouteInfoChar_09: start-position=232, length=8
            RouteInfoChar_10: start-position=240, length=8
            RouteInfoChar_11: start-position=248, length=8
            RouteInfoChar_12: start-position=256, length=8
            RouteInfoChar_13: start-position=264, length=8
            RouteInfoChar_14: start-position=272, length=8
            RouteInfoChar_15: start-position=280, length=8
            RouteInfoChar_16: start-position=288, length=8
            RouteInfoChar_17: start-position=296, length=8
            RouteInfoChar_18: start-position=304, length=8
            RouteInfoChar_19: start-position=312, length=8
            RouteInfoChar_20: start-position=320, length=8
            RouteInfoChar_21: start-position=328, length=8
            RouteInfoChar_22: start-position=336, length=8
            RouteInfoChar_23: start-position=344, length=8
            RouteInfoChar_24: start-position=352, length=8
            RouteInfoChar_25: start-position=360, length=8
            RouteInfoChar_26: start-position=368, length=8
            RouteInfoChar_27: start-position=376, length=8
            RouteInfoChar_28: start-position=384, length=8
            RouteInfoChar_29: start-position=392, length=8
            RouteInfoChar_30: start-position=400, length=8
            RouteInfoChar_31: start-position=408, length=8
            RouteInfoChar_32: start-position=416, length=8
            RouteInfoChar_33: start-position=424, length=8
            RouteInfoChar_34: start-position=432, length=8
            RouteInfoChar_35: start-position=440, length=8
            RouteInfoChar_36: start-position=448, length=8
            RouteInfoChar_37: start-position=456, length=8
            RouteInfoChar_38: start-position=464, length=8
            RouteInfoChar_39: start-position=472, length=8
            RouteInfoChar_40: start-position=480, length=8
            RouteInfoChar_41: start-position=488, length=8
            RouteInfoChar_42: start-position=496, length=8
            RouteInfoChar_43: start-position=504, length=8
      RESP_005_ADAS_DOMAIN_TO_RADAR_FRONT_LONG_RANGE: identifier=1541, frame-length=16
        pdu RESP_005_ADAS_DOMAIN_TO_RADAR_FRONT_LONG_RANGE_PDU: sender=ADAS_DOMAIN, receiver=RADAR_FRONT_LONG_RANGE
          12 x i signal:
            CRC8: start-position=0, length=8
            ResponseCounter: start-position=8, length=4
            AckState: start-position=12, length=4
            ReceivedFrameId: start-position=16, length=11
            ReceivedCounter: start-position=27, length=4
            ChecksumOk: start-position=31, length=1
            PayloadLength: start-position=32, length=8
            ErrorCode: start-position=40, length=8
            ProcessingTimeUs: start-position=48, length=16
            ResponseSequence: start-position=64, length=16
            ReceivedCrc: start-position=80, length=8
            CalculatedCrc: start-position=88, length=8
      DATA_006_RADAR_REAR_CORNER_LEFT_BLIND_SPOT_OBJECTS_TO_ADAS_DOMAIN: identifier=390, frame-length=64
        pdu DATA_006_RADAR_REAR_CORNER_LEFT_BLIND_SPOT_OBJECTS_TO_ADAS_DOMAIN_PDU: sender=RADAR_REAR_CORNER_LEFT, receiver=ADAS_DOMAIN
          59 x i signal:
            CRC8: start-position=0, length=8
            AliveCounter: start-position=8, length=4
            MuxState: start-position=12, length=4
            SIG_00: start-position=16, length=12
            SIG_01: start-position=28, length=12
            SIG_02: start-position=40, length=12
            SIG_03: start-position=52, length=12
            SIG_04: start-position=64, length=12
            SIG_05: start-position=76, length=12
            SIG_06: start-position=88, length=12
            SIG_07: start-position=100, length=12
            SIG_08: start-position=112, length=12
            SIG_09: start-position=124, length=12
            SIG_10: start-position=136, length=12
            SIG_11: start-position=148, length=12
            RouteInfoChar_00: start-position=160, length=8
            RouteInfoChar_01: start-position=168, length=8
            RouteInfoChar_02: start-position=176, length=8
            RouteInfoChar_03: start-position=184, length=8
            RouteInfoChar_04: start-position=192, length=8
            RouteInfoChar_05: start-position=200, length=8
            RouteInfoChar_06: start-position=208, length=8
            RouteInfoChar_07: start-position=216, length=8
            RouteInfoChar_08: start-position=224, length=8
            RouteInfoChar_09: start-position=232, length=8
            RouteInfoChar_10: start-position=240, length=8
            RouteInfoChar_11: start-position=248, length=8
            RouteInfoChar_12: start-position=256, length=8
            RouteInfoChar_13: start-position=264, length=8
            RouteInfoChar_14: start-position=272, length=8
            RouteInfoChar_15: start-position=280, length=8
            RouteInfoChar_16: start-position=288, length=8
            RouteInfoChar_17: start-position=296, length=8
            RouteInfoChar_18: start-position=304, length=8
            RouteInfoChar_19: start-position=312, length=8
            RouteInfoChar_20: start-position=320, length=8
            RouteInfoChar_21: start-position=328, length=8
            RouteInfoChar_22: start-position=336, length=8
            RouteInfoChar_23: start-position=344, length=8
            RouteInfoChar_24: start-position=352, length=8
            RouteInfoChar_25: start-position=360, length=8
            RouteInfoChar_26: start-position=368, length=8
            RouteInfoChar_27: start-position=376, length=8
            RouteInfoChar_28: start-position=384, length=8
            RouteInfoChar_29: start-position=392, length=8
            RouteInfoChar_30: start-position=400, length=8
            RouteInfoChar_31: start-position=408, length=8
            RouteInfoChar_32: start-position=416, length=8
            RouteInfoChar_33: start-position=424, length=8
            RouteInfoChar_34: start-position=432, length=8
            RouteInfoChar_35: start-position=440, length=8
            RouteInfoChar_36: start-position=448, length=8
            RouteInfoChar_37: start-position=456, length=8
            RouteInfoChar_38: start-position=464, length=8
            RouteInfoChar_39: start-position=472, length=8
            RouteInfoChar_40: start-position=480, length=8
            RouteInfoChar_41: start-position=488, length=8
            RouteInfoChar_42: start-position=496, length=8
            RouteInfoChar_43: start-position=504, length=8
      RESP_006_ADAS_DOMAIN_TO_RADAR_REAR_CORNER_LEFT: identifier=1542, frame-length=16
        pdu RESP_006_ADAS_DOMAIN_TO_RADAR_REAR_CORNER_LEFT_PDU: sender=ADAS_DOMAIN, receiver=RADAR_REAR_CORNER_LEFT
          12 x i signal:
            CRC8: start-position=0, length=8
            ResponseCounter: start-position=8, length=4
            AckState: start-position=12, length=4
            ReceivedFrameId: start-position=16, length=11
            ReceivedCounter: start-position=27, length=4
            ChecksumOk: start-position=31, length=1
            PayloadLength: start-position=32, length=8
            ErrorCode: start-position=40, length=8
            ProcessingTimeUs: start-position=48, length=16
            ResponseSequence: start-position=64, length=16
            ReceivedCrc: start-position=80, length=8
            CalculatedCrc: start-position=88, length=8
      DATA_007_IMU_YAW_RATE_SENSOR_VEHICLE_DYNAMICS_TO_ADAS_DOMAIN: identifier=391, frame-length=64
        pdu DATA_007_IMU_YAW_RATE_SENSOR_VEHICLE_DYNAMICS_TO_ADAS_DOMAIN_PDU: sender=IMU_YAW_RATE_SENSOR, receiver=ADAS_DOMAIN
          59 x i signal:
            CRC8: start-position=0, length=8
            AliveCounter: start-position=8, length=4
            MuxState: start-position=12, length=4
            SIG_00: start-position=16, length=12
            SIG_01: start-position=28, length=12
            SIG_02: start-position=40, length=12
            SIG_03: start-position=52, length=12
            SIG_04: start-position=64, length=12
            SIG_05: start-position=76, length=12
            SIG_06: start-position=88, length=12
            SIG_07: start-position=100, length=12
            SIG_08: start-position=112, length=12
            SIG_09: start-position=124, length=12
            SIG_10: start-position=136, length=12
            SIG_11: start-position=148, length=12
            RouteInfoChar_00: start-position=160, length=8
            RouteInfoChar_01: start-position=168, length=8
            RouteInfoChar_02: start-position=176, length=8
            RouteInfoChar_03: start-position=184, length=8
            RouteInfoChar_04: start-position=192, length=8
            RouteInfoChar_05: start-position=200, length=8
            RouteInfoChar_06: start-position=208, length=8
            RouteInfoChar_07: start-position=216, length=8
            RouteInfoChar_08: start-position=224, length=8
            RouteInfoChar_09: start-position=232, length=8
            RouteInfoChar_10: start-position=240, length=8
            RouteInfoChar_11: start-position=248, length=8
            RouteInfoChar_12: start-position=256, length=8
            RouteInfoChar_13: start-position=264, length=8
            RouteInfoChar_14: start-position=272, length=8
            RouteInfoChar_15: start-position=280, length=8
            RouteInfoChar_16: start-position=288, length=8
            RouteInfoChar_17: start-position=296, length=8
            RouteInfoChar_18: start-position=304, length=8
            RouteInfoChar_19: start-position=312, length=8
            RouteInfoChar_20: start-position=320, length=8
            RouteInfoChar_21: start-position=328, length=8
            RouteInfoChar_22: start-position=336, length=8
            RouteInfoChar_23: start-position=344, length=8
            RouteInfoChar_24: start-position=352, length=8
            RouteInfoChar_25: start-position=360, length=8
            RouteInfoChar_26: start-position=368, length=8
            RouteInfoChar_27: start-position=376, length=8
            RouteInfoChar_28: start-position=384, length=8
            RouteInfoChar_29: start-position=392, length=8
            RouteInfoChar_30: start-position=400, length=8
            RouteInfoChar_31: start-position=408, length=8
            RouteInfoChar_32: start-position=416, length=8
            RouteInfoChar_33: start-position=424, length=8
            RouteInfoChar_34: start-position=432, length=8
            RouteInfoChar_35: start-position=440, length=8
            RouteInfoChar_36: start-position=448, length=8
            RouteInfoChar_37: start-position=456, length=8
            RouteInfoChar_38: start-position=464, length=8
            RouteInfoChar_39: start-position=472, length=8
            RouteInfoChar_40: start-position=480, length=8
            RouteInfoChar_41: start-position=488, length=8
            RouteInfoChar_42: start-position=496, length=8
            RouteInfoChar_43: start-position=504, length=8
      RESP_007_ADAS_DOMAIN_TO_IMU_YAW_RATE_SENSOR: identifier=1543, frame-length=16
        pdu RESP_007_ADAS_DOMAIN_TO_IMU_YAW_RATE_SENSOR_PDU: sender=ADAS_DOMAIN, receiver=IMU_YAW_RATE_SENSOR
          12 x i signal:
            CRC8: start-position=0, length=8
            ResponseCounter: start-position=8, length=4
            AckState: start-position=12, length=4
            ReceivedFrameId: start-position=16, length=11
            ReceivedCounter: start-position=27, length=4
            ChecksumOk: start-position=31, length=1
            PayloadLength: start-position=32, length=8
            ErrorCode: start-position=40, length=8
            ProcessingTimeUs: start-position=48, length=16
            ResponseSequence: start-position=64, length=16
            ReceivedCrc: start-position=80, length=8
            CalculatedCrc: start-position=88, length=8
      DATA_008_BRAKE_CONTROLLER_BRAKE_STATUS_TO_ADAS_DOMAIN: identifier=392, frame-length=64
        pdu DATA_008_BRAKE_CONTROLLER_BRAKE_STATUS_TO_ADAS_DOMAIN_PDU: sender=BRAKE_CONTROLLER, receiver=ADAS_DOMAIN
          59 x i signal:
            CRC8: start-position=0, length=8
            AliveCounter: start-position=8, length=4
            MuxState: start-position=12, length=4
            SIG_00: start-position=16, length=12
            SIG_01: start-position=28, length=12
            SIG_02: start-position=40, length=12
            SIG_03: start-position=52, length=12
            SIG_04: start-position=64, length=12
            SIG_05: start-position=76, length=12
            SIG_06: start-position=88, length=12
            SIG_07: start-position=100, length=12
            SIG_08: start-position=112, length=12
            SIG_09: start-position=124, length=12
            SIG_10: start-position=136, length=12
            SIG_11: start-position=148, length=12
            RouteInfoChar_00: start-position=160, length=8
            RouteInfoChar_01: start-position=168, length=8
            RouteInfoChar_02: start-position=176, length=8
            RouteInfoChar_03: start-position=184, length=8
            RouteInfoChar_04: start-position=192, length=8
            RouteInfoChar_05: start-position=200, length=8
            RouteInfoChar_06: start-position=208, length=8
            RouteInfoChar_07: start-position=216, length=8
            RouteInfoChar_08: start-position=224, length=8
            RouteInfoChar_09: start-position=232, length=8
            RouteInfoChar_10: start-position=240, length=8
            RouteInfoChar_11: start-position=248, length=8
            RouteInfoChar_12: start-position=256, length=8
            RouteInfoChar_13: start-position=264, length=8
            RouteInfoChar_14: start-position=272, length=8
            RouteInfoChar_15: start-position=280, length=8
            RouteInfoChar_16: start-position=288, length=8
            RouteInfoChar_17: start-position=296, length=8
            RouteInfoChar_18: start-position=304, length=8
            RouteInfoChar_19: start-position=312, length=8
            RouteInfoChar_20: start-position=320, length=8
            RouteInfoChar_21: start-position=328, length=8
            RouteInfoChar_22: start-position=336, length=8
            RouteInfoChar_23: start-position=344, length=8
            RouteInfoChar_24: start-position=352, length=8
            RouteInfoChar_25: start-position=360, length=8
            RouteInfoChar_26: start-position=368, length=8
            RouteInfoChar_27: start-position=376, length=8
            RouteInfoChar_28: start-position=384, length=8
            RouteInfoChar_29: start-position=392, length=8
            RouteInfoChar_30: start-position=400, length=8
            RouteInfoChar_31: start-position=408, length=8
            RouteInfoChar_32: start-position=416, length=8
            RouteInfoChar_33: start-position=424, length=8
            RouteInfoChar_34: start-position=432, length=8
            RouteInfoChar_35: start-position=440, length=8
            RouteInfoChar_36: start-position=448, length=8
            RouteInfoChar_37: start-position=456, length=8
            RouteInfoChar_38: start-position=464, length=8
            RouteInfoChar_39: start-position=472, length=8
            RouteInfoChar_40: start-position=480, length=8
            RouteInfoChar_41: start-position=488, length=8
            RouteInfoChar_42: start-position=496, length=8
            RouteInfoChar_43: start-position=504, length=8
      RESP_008_ADAS_DOMAIN_TO_BRAKE_CONTROLLER: identifier=1544, frame-length=16
        pdu RESP_008_ADAS_DOMAIN_TO_BRAKE_CONTROLLER_PDU: sender=ADAS_DOMAIN, receiver=BRAKE_CONTROLLER
          12 x i signal:
            CRC8: start-position=0, length=8
            ResponseCounter: start-position=8, length=4
            AckState: start-position=12, length=4
            ReceivedFrameId: start-position=16, length=11
            ReceivedCounter: start-position=27, length=4
            ChecksumOk: start-position=31, length=1
            PayloadLength: start-position=32, length=8
            ErrorCode: start-position=40, length=8
            ProcessingTimeUs: start-position=48, length=16
            ResponseSequence: start-position=64, length=16
            ReceivedCrc: start-position=80, length=8
            CalculatedCrc: start-position=88, length=8
      DATA_009_BRAKE_CONTROLLER_BRAKE_STATUS_TO_DIAG_TESTER: identifier=393, frame-length=64
        pdu DATA_009_BRAKE_CONTROLLER_BRAKE_STATUS_TO_DIAG_TESTER_PDU: sender=BRAKE_CONTROLLER, receiver=DIAG_TESTER
          59 x i signal:
            CRC8: start-position=0, length=8
            AliveCounter: start-position=8, length=4
            MuxState: start-position=12, length=4
            SIG_00: start-position=16, length=12
            SIG_01: start-position=28, length=12
            SIG_02: start-position=40, length=12
            SIG_03: start-position=52, length=12
            SIG_04: start-position=64, length=12
            SIG_05: start-position=76, length=12
            SIG_06: start-position=88, length=12
            SIG_07: start-position=100, length=12
            SIG_08: start-position=112, length=12
            SIG_09: start-position=124, length=12
            SIG_10: start-position=136, length=12
            SIG_11: start-position=148, length=12
            RouteInfoChar_00: start-position=160, length=8
            RouteInfoChar_01: start-position=168, length=8
            RouteInfoChar_02: start-position=176, length=8
            RouteInfoChar_03: start-position=184, length=8
            RouteInfoChar_04: start-position=192, length=8
            RouteInfoChar_05: start-position=200, length=8
            RouteInfoChar_06: start-position=208, length=8
            RouteInfoChar_07: start-position=216, length=8
            RouteInfoChar_08: start-position=224, length=8
            RouteInfoChar_09: start-position=232, length=8
            RouteInfoChar_10: start-position=240, length=8
            RouteInfoChar_11: start-position=248, length=8
            RouteInfoChar_12: start-position=256, length=8
            RouteInfoChar_13: start-position=264, length=8
            RouteInfoChar_14: start-position=272, length=8
            RouteInfoChar_15: start-position=280, length=8
            RouteInfoChar_16: start-position=288, length=8
            RouteInfoChar_17: start-position=296, length=8
            RouteInfoChar_18: start-position=304, length=8
            RouteInfoChar_19: start-position=312, length=8
            RouteInfoChar_20: start-position=320, length=8
            RouteInfoChar_21: start-position=328, length=8
            RouteInfoChar_22: start-position=336, length=8
            RouteInfoChar_23: start-position=344, length=8
            RouteInfoChar_24: start-position=352, length=8
            RouteInfoChar_25: start-position=360, length=8
            RouteInfoChar_26: start-position=368, length=8
            RouteInfoChar_27: start-position=376, length=8
            RouteInfoChar_28: start-position=384, length=8
            RouteInfoChar_29: start-position=392, length=8
            RouteInfoChar_30: start-position=400, length=8
            RouteInfoChar_31: start-position=408, length=8
            RouteInfoChar_32: start-position=416, length=8
            RouteInfoChar_33: start-position=424, length=8
            RouteInfoChar_34: start-position=432, length=8
            RouteInfoChar_35: start-position=440, length=8
            RouteInfoChar_36: start-position=448, length=8
            RouteInfoChar_37: start-position=456, length=8
            RouteInfoChar_38: start-position=464, length=8
            RouteInfoChar_39: start-position=472, length=8
            RouteInfoChar_40: start-position=480, length=8
            RouteInfoChar_41: start-position=488, length=8
            RouteInfoChar_42: start-position=496, length=8
            RouteInfoChar_43: start-position=504, length=8
      RESP_009_DIAG_TESTER_TO_BRAKE_CONTROLLER: identifier=1545, frame-length=16
        pdu RESP_009_DIAG_TESTER_TO_BRAKE_CONTROLLER_PDU: sender=DIAG_TESTER, receiver=BRAKE_CONTROLLER
          12 x i signal:
            CRC8: start-position=0, length=8
            ResponseCounter: start-position=8, length=4
            AckState: start-position=12, length=4
            ReceivedFrameId: start-position=16, length=11
            ReceivedCounter: start-position=27, length=4
            ChecksumOk: start-position=31, length=1
            PayloadLength: start-position=32, length=8
            ErrorCode: start-position=40, length=8
            ProcessingTimeUs: start-position=48, length=16
            ResponseSequence: start-position=64, length=16
            ReceivedCrc: start-position=80, length=8
            CalculatedCrc: start-position=88, length=8
      DATA_010_STEERING_CONTROLLER_STEERING_STATUS_TO_ADAS_DOMAIN: identifier=394, frame-length=64
        pdu DATA_010_STEERING_CONTROLLER_STEERING_STATUS_TO_ADAS_DOMAIN_PDU: sender=STEERING_CONTROLLER, receiver=ADAS_DOMAIN
          59 x i signal:
            CRC8: start-position=0, length=8
            AliveCounter: start-position=8, length=4
            MuxState: start-position=12, length=4
            SIG_00: start-position=16, length=12
            SIG_01: start-position=28, length=12
            SIG_02: start-position=40, length=12
            SIG_03: start-position=52, length=12
            SIG_04: start-position=64, length=12
            SIG_05: start-position=76, length=12
            SIG_06: start-position=88, length=12
            SIG_07: start-position=100, length=12
            SIG_08: start-position=112, length=12
            SIG_09: start-position=124, length=12
            SIG_10: start-position=136, length=12
            SIG_11: start-position=148, length=12
            RouteInfoChar_00: start-position=160, length=8
            RouteInfoChar_01: start-position=168, length=8
            RouteInfoChar_02: start-position=176, length=8
            RouteInfoChar_03: start-position=184, length=8
            RouteInfoChar_04: start-position=192, length=8
            RouteInfoChar_05: start-position=200, length=8
            RouteInfoChar_06: start-position=208, length=8
            RouteInfoChar_07: start-position=216, length=8
            RouteInfoChar_08: start-position=224, length=8
            RouteInfoChar_09: start-position=232, length=8
            RouteInfoChar_10: start-position=240, length=8
            RouteInfoChar_11: start-position=248, length=8
            RouteInfoChar_12: start-position=256, length=8
            RouteInfoChar_13: start-position=264, length=8
            RouteInfoChar_14: start-position=272, length=8
            RouteInfoChar_15: start-position=280, length=8
            RouteInfoChar_16: start-position=288, length=8
            RouteInfoChar_17: start-position=296, length=8
            RouteInfoChar_18: start-position=304, length=8
            RouteInfoChar_19: start-position=312, length=8
            RouteInfoChar_20: start-position=320, length=8
            RouteInfoChar_21: start-position=328, length=8
            RouteInfoChar_22: start-position=336, length=8
            RouteInfoChar_23: start-position=344, length=8
            RouteInfoChar_24: start-position=352, length=8
            RouteInfoChar_25: start-position=360, length=8
            RouteInfoChar_26: start-position=368, length=8
            RouteInfoChar_27: start-position=376, length=8
            RouteInfoChar_28: start-position=384, length=8
            RouteInfoChar_29: start-position=392, length=8
            RouteInfoChar_30: start-position=400, length=8
            RouteInfoChar_31: start-position=408, length=8
            RouteInfoChar_32: start-position=416, length=8
            RouteInfoChar_33: start-position=424, length=8
            RouteInfoChar_34: start-position=432, length=8
            RouteInfoChar_35: start-position=440, length=8
            RouteInfoChar_36: start-position=448, length=8
            RouteInfoChar_37: start-position=456, length=8
            RouteInfoChar_38: start-position=464, length=8
            RouteInfoChar_39: start-position=472, length=8
            RouteInfoChar_40: start-position=480, length=8
            RouteInfoChar_41: start-position=488, length=8
            RouteInfoChar_42: start-position=496, length=8
            RouteInfoChar_43: start-position=504, length=8
      RESP_010_ADAS_DOMAIN_TO_STEERING_CONTROLLER: identifier=1546, frame-length=16
        pdu RESP_010_ADAS_DOMAIN_TO_STEERING_CONTROLLER_PDU: sender=ADAS_DOMAIN, receiver=STEERING_CONTROLLER
          12 x i signal:
            CRC8: start-position=0, length=8
            ResponseCounter: start-position=8, length=4
            AckState: start-position=12, length=4
            ReceivedFrameId: start-position=16, length=11
            ReceivedCounter: start-position=27, length=4
            ChecksumOk: start-position=31, length=1
            PayloadLength: start-position=32, length=8
            ErrorCode: start-position=40, length=8
            ProcessingTimeUs: start-position=48, length=16
            ResponseSequence: start-position=64, length=16
            ReceivedCrc: start-position=80, length=8
            CalculatedCrc: start-position=88, length=8
      DATA_011_STEERING_CONTROLLER_STEERING_STATUS_TO_DIAG_TESTER: identifier=395, frame-length=64
        pdu DATA_011_STEERING_CONTROLLER_STEERING_STATUS_TO_DIAG_TESTER_PDU: sender=STEERING_CONTROLLER, receiver=DIAG_TESTER
          59 x i signal:
            CRC8: start-position=0, length=8
            AliveCounter: start-position=8, length=4
            MuxState: start-position=12, length=4
            SIG_00: start-position=16, length=12
            SIG_01: start-position=28, length=12
            SIG_02: start-position=40, length=12
            SIG_03: start-position=52, length=12
            SIG_04: start-position=64, length=12
            SIG_05: start-position=76, length=12
            SIG_06: start-position=88, length=12
            SIG_07: start-position=100, length=12
            SIG_08: start-position=112, length=12
            SIG_09: start-position=124, length=12
            SIG_10: start-position=136, length=12
            SIG_11: start-position=148, length=12
            RouteInfoChar_00: start-position=160, length=8
            RouteInfoChar_01: start-position=168, length=8
            RouteInfoChar_02: start-position=176, length=8
            RouteInfoChar_03: start-position=184, length=8
            RouteInfoChar_04: start-position=192, length=8
            RouteInfoChar_05: start-position=200, length=8
            RouteInfoChar_06: start-position=208, length=8
            RouteInfoChar_07: start-position=216, length=8
            RouteInfoChar_08: start-position=224, length=8
            RouteInfoChar_09: start-position=232, length=8
            RouteInfoChar_10: start-position=240, length=8
            RouteInfoChar_11: start-position=248, length=8
            RouteInfoChar_12: start-position=256, length=8
            RouteInfoChar_13: start-position=264, length=8
            RouteInfoChar_14: start-position=272, length=8
            RouteInfoChar_15: start-position=280, length=8
            RouteInfoChar_16: start-position=288, length=8
            RouteInfoChar_17: start-position=296, length=8
            RouteInfoChar_18: start-position=304, length=8
            RouteInfoChar_19: start-position=312, length=8
            RouteInfoChar_20: start-position=320, length=8
            RouteInfoChar_21: start-position=328, length=8
            RouteInfoChar_22: start-position=336, length=8
            RouteInfoChar_23: start-position=344, length=8
            RouteInfoChar_24: start-position=352, length=8
            RouteInfoChar_25: start-position=360, length=8
            RouteInfoChar_26: start-position=368, length=8
            RouteInfoChar_27: start-position=376, length=8
            RouteInfoChar_28: start-position=384, length=8
            RouteInfoChar_29: start-position=392, length=8
            RouteInfoChar_30: start-position=400, length=8
            RouteInfoChar_31: start-position=408, length=8
            RouteInfoChar_32: start-position=416, length=8
            RouteInfoChar_33: start-position=424, length=8
            RouteInfoChar_34: start-position=432, length=8
            RouteInfoChar_35: start-position=440, length=8
            RouteInfoChar_36: start-position=448, length=8
            RouteInfoChar_37: start-position=456, length=8
            RouteInfoChar_38: start-position=464, length=8
            RouteInfoChar_39: start-position=472, length=8
            RouteInfoChar_40: start-position=480, length=8
            RouteInfoChar_41: start-position=488, length=8
            RouteInfoChar_42: start-position=496, length=8
            RouteInfoChar_43: start-position=504, length=8
      RESP_011_DIAG_TESTER_TO_STEERING_CONTROLLER: identifier=1547, frame-length=16
        pdu RESP_011_DIAG_TESTER_TO_STEERING_CONTROLLER_PDU: sender=DIAG_TESTER, receiver=STEERING_CONTROLLER
          12 x i signal:
            CRC8: start-position=0, length=8
            ResponseCounter: start-position=8, length=4
            AckState: start-position=12, length=4
            ReceivedFrameId: start-position=16, length=11
            ReceivedCounter: start-position=27, length=4
            ChecksumOk: start-position=31, length=1
            PayloadLength: start-position=32, length=8
            ErrorCode: start-position=40, length=8
            ProcessingTimeUs: start-position=48, length=16
            ResponseSequence: start-position=64, length=16
            ReceivedCrc: start-position=80, length=8
            CalculatedCrc: start-position=88, length=8
      DATA_012_CENTRAL_GATEWAY_ROUTING_STATUS_TO_DIAG_TESTER: identifier=396, frame-length=64
        pdu DATA_012_CENTRAL_GATEWAY_ROUTING_STATUS_TO_DIAG_TESTER_PDU: sender=CENTRAL_GATEWAY, receiver=DIAG_TESTER
          59 x i signal:
            CRC8: start-position=0, length=8
            AliveCounter: start-position=8, length=4
            MuxState: start-position=12, length=4
            SIG_00: start-position=16, length=12
            SIG_01: start-position=28, length=12
            SIG_02: start-position=40, length=12
            SIG_03: start-position=52, length=12
            SIG_04: start-position=64, length=12
            SIG_05: start-position=76, length=12
            SIG_06: start-position=88, length=12
            SIG_07: start-position=100, length=12
            SIG_08: start-position=112, length=12
            SIG_09: start-position=124, length=12
            SIG_10: start-position=136, length=12
            SIG_11: start-position=148, length=12
            RouteInfoChar_00: start-position=160, length=8
            RouteInfoChar_01: start-position=168, length=8
            RouteInfoChar_02: start-position=176, length=8
            RouteInfoChar_03: start-position=184, length=8
            RouteInfoChar_04: start-position=192, length=8
            RouteInfoChar_05: start-position=200, length=8
            RouteInfoChar_06: start-position=208, length=8
            RouteInfoChar_07: start-position=216, length=8
            RouteInfoChar_08: start-position=224, length=8
            RouteInfoChar_09: start-position=232, length=8
            RouteInfoChar_10: start-position=240, length=8
            RouteInfoChar_11: start-position=248, length=8
            RouteInfoChar_12: start-position=256, length=8
            RouteInfoChar_13: start-position=264, length=8
            RouteInfoChar_14: start-position=272, length=8
            RouteInfoChar_15: start-position=280, length=8
            RouteInfoChar_16: start-position=288, length=8
            RouteInfoChar_17: start-position=296, length=8
            RouteInfoChar_18: start-position=304, length=8
            RouteInfoChar_19: start-position=312, length=8
            RouteInfoChar_20: start-position=320, length=8
            RouteInfoChar_21: start-position=328, length=8
            RouteInfoChar_22: start-position=336, length=8
            RouteInfoChar_23: start-position=344, length=8
            RouteInfoChar_24: start-position=352, length=8
            RouteInfoChar_25: start-position=360, length=8
            RouteInfoChar_26: start-position=368, length=8
            RouteInfoChar_27: start-position=376, length=8
            RouteInfoChar_28: start-position=384, length=8
            RouteInfoChar_29: start-position=392, length=8
            RouteInfoChar_30: start-position=400, length=8
            RouteInfoChar_31: start-position=408, length=8
            RouteInfoChar_32: start-position=416, length=8
            RouteInfoChar_33: start-position=424, length=8
            RouteInfoChar_34: start-position=432, length=8
            RouteInfoChar_35: start-position=440, length=8
            RouteInfoChar_36: start-position=448, length=8
            RouteInfoChar_37: start-position=456, length=8
            RouteInfoChar_38: start-position=464, length=8
            RouteInfoChar_39: start-position=472, length=8
            RouteInfoChar_40: start-position=480, length=8
            RouteInfoChar_41: start-position=488, length=8
            RouteInfoChar_42: start-position=496, length=8
            RouteInfoChar_43: start-position=504, length=8
      RESP_012_DIAG_TESTER_TO_CENTRAL_GATEWAY: identifier=1548, frame-length=16
        pdu RESP_012_DIAG_TESTER_TO_CENTRAL_GATEWAY_PDU: sender=DIAG_TESTER, receiver=CENTRAL_GATEWAY
          12 x i signal:
            CRC8: start-position=0, length=8
            ResponseCounter: start-position=8, length=4
            AckState: start-position=12, length=4
            ReceivedFrameId: start-position=16, length=11
            ReceivedCounter: start-position=27, length=4
            ChecksumOk: start-position=31, length=1
            PayloadLength: start-position=32, length=8
            ErrorCode: start-position=40, length=8
            ProcessingTimeUs: start-position=48, length=16
            ResponseSequence: start-position=64, length=16
            ReceivedCrc: start-position=80, length=8
            CalculatedCrc: start-position=88, length=8
      DATA_013_CENTRAL_GATEWAY_SYNC_TIME_TO_CAMERA_FRONT_WIDE: identifier=397, frame-length=64
        pdu DATA_013_CENTRAL_GATEWAY_SYNC_TIME_TO_CAMERA_FRONT_WIDE_PDU: sender=CENTRAL_GATEWAY, receiver=CAMERA_FRONT_WIDE
          59 x i signal:
            CRC8: start-position=0, length=8
            AliveCounter: start-position=8, length=4
            MuxState: start-position=12, length=4
            SIG_00: start-position=16, length=12
            SIG_01: start-position=28, length=12
            SIG_02: start-position=40, length=12
            SIG_03: start-position=52, length=12
            SIG_04: start-position=64, length=12
            SIG_05: start-position=76, length=12
            SIG_06: start-position=88, length=12
            SIG_07: start-position=100, length=12
            SIG_08: start-position=112, length=12
            SIG_09: start-position=124, length=12
            SIG_10: start-position=136, length=12
            SIG_11: start-position=148, length=12
            RouteInfoChar_00: start-position=160, length=8
            RouteInfoChar_01: start-position=168, length=8
            RouteInfoChar_02: start-position=176, length=8
            RouteInfoChar_03: start-position=184, length=8
            RouteInfoChar_04: start-position=192, length=8
            RouteInfoChar_05: start-position=200, length=8
            RouteInfoChar_06: start-position=208, length=8
            RouteInfoChar_07: start-position=216, length=8
            RouteInfoChar_08: start-position=224, length=8
            RouteInfoChar_09: start-position=232, length=8
            RouteInfoChar_10: start-position=240, length=8
            RouteInfoChar_11: start-position=248, length=8
            RouteInfoChar_12: start-position=256, length=8
            RouteInfoChar_13: start-position=264, length=8
            RouteInfoChar_14: start-position=272, length=8
            RouteInfoChar_15: start-position=280, length=8
            RouteInfoChar_16: start-position=288, length=8
            RouteInfoChar_17: start-position=296, length=8
            RouteInfoChar_18: start-position=304, length=8
            RouteInfoChar_19: start-position=312, length=8
            RouteInfoChar_20: start-position=320, length=8
            RouteInfoChar_21: start-position=328, length=8
            RouteInfoChar_22: start-position=336, length=8
            RouteInfoChar_23: start-position=344, length=8
            RouteInfoChar_24: start-position=352, length=8
            RouteInfoChar_25: start-position=360, length=8
            RouteInfoChar_26: start-position=368, length=8
            RouteInfoChar_27: start-position=376, length=8
            RouteInfoChar_28: start-position=384, length=8
            RouteInfoChar_29: start-position=392, length=8
            RouteInfoChar_30: start-position=400, length=8
            RouteInfoChar_31: start-position=408, length=8
            RouteInfoChar_32: start-position=416, length=8
            RouteInfoChar_33: start-position=424, length=8
            RouteInfoChar_34: start-position=432, length=8
            RouteInfoChar_35: start-position=440, length=8
            RouteInfoChar_36: start-position=448, length=8
            RouteInfoChar_37: start-position=456, length=8
            RouteInfoChar_38: start-position=464, length=8
            RouteInfoChar_39: start-position=472, length=8
            RouteInfoChar_40: start-position=480, length=8
            RouteInfoChar_41: start-position=488, length=8
            RouteInfoChar_42: start-position=496, length=8
            RouteInfoChar_43: start-position=504, length=8
      RESP_013_CAMERA_FRONT_WIDE_TO_CENTRAL_GATEWAY: identifier=1549, frame-length=16
        pdu RESP_013_CAMERA_FRONT_WIDE_TO_CENTRAL_GATEWAY_PDU: sender=CAMERA_FRONT_WIDE, receiver=CENTRAL_GATEWAY
          12 x i signal:
            CRC8: start-position=0, length=8
            ResponseCounter: start-position=8, length=4
            AckState: start-position=12, length=4
            ReceivedFrameId: start-position=16, length=11
            ReceivedCounter: start-position=27, length=4
            ChecksumOk: start-position=31, length=1
            PayloadLength: start-position=32, length=8
            ErrorCode: start-position=40, length=8
            ProcessingTimeUs: start-position=48, length=16
            ResponseSequence: start-position=64, length=16
            ReceivedCrc: start-position=80, length=8
            CalculatedCrc: start-position=88, length=8
      DATA_014_CENTRAL_GATEWAY_SYNC_TIME_TO_RADAR_FRONT_LONG_RANGE: identifier=398, frame-length=64
        pdu DATA_014_CENTRAL_GATEWAY_SYNC_TIME_TO_RADAR_FRONT_LONG_RANGE_PDU: sender=CENTRAL_GATEWAY, receiver=RADAR_FRONT_LONG_RANGE
          59 x i signal:
            CRC8: start-position=0, length=8
            AliveCounter: start-position=8, length=4
            MuxState: start-position=12, length=4
            SIG_00: start-position=16, length=12
            SIG_01: start-position=28, length=12
            SIG_02: start-position=40, length=12
            SIG_03: start-position=52, length=12
            SIG_04: start-position=64, length=12
            SIG_05: start-position=76, length=12
            SIG_06: start-position=88, length=12
            SIG_07: start-position=100, length=12
            SIG_08: start-position=112, length=12
            SIG_09: start-position=124, length=12
            SIG_10: start-position=136, length=12
            SIG_11: start-position=148, length=12
            RouteInfoChar_00: start-position=160, length=8
            RouteInfoChar_01: start-position=168, length=8
            RouteInfoChar_02: start-position=176, length=8
            RouteInfoChar_03: start-position=184, length=8
            RouteInfoChar_04: start-position=192, length=8
            RouteInfoChar_05: start-position=200, length=8
            RouteInfoChar_06: start-position=208, length=8
            RouteInfoChar_07: start-position=216, length=8
            RouteInfoChar_08: start-position=224, length=8
            RouteInfoChar_09: start-position=232, length=8
            RouteInfoChar_10: start-position=240, length=8
            RouteInfoChar_11: start-position=248, length=8
            RouteInfoChar_12: start-position=256, length=8
            RouteInfoChar_13: start-position=264, length=8
            RouteInfoChar_14: start-position=272, length=8
            RouteInfoChar_15: start-position=280, length=8
            RouteInfoChar_16: start-position=288, length=8
            RouteInfoChar_17: start-position=296, length=8
            RouteInfoChar_18: start-position=304, length=8
            RouteInfoChar_19: start-position=312, length=8
            RouteInfoChar_20: start-position=320, length=8
            RouteInfoChar_21: start-position=328, length=8
            RouteInfoChar_22: start-position=336, length=8
            RouteInfoChar_23: start-position=344, length=8
            RouteInfoChar_24: start-position=352, length=8
            RouteInfoChar_25: start-position=360, length=8
            RouteInfoChar_26: start-position=368, length=8
            RouteInfoChar_27: start-position=376, length=8
            RouteInfoChar_28: start-position=384, length=8
            RouteInfoChar_29: start-position=392, length=8
            RouteInfoChar_30: start-position=400, length=8
            RouteInfoChar_31: start-position=408, length=8
            RouteInfoChar_32: start-position=416, length=8
            RouteInfoChar_33: start-position=424, length=8
            RouteInfoChar_34: start-position=432, length=8
            RouteInfoChar_35: start-position=440, length=8
            RouteInfoChar_36: start-position=448, length=8
            RouteInfoChar_37: start-position=456, length=8
            RouteInfoChar_38: start-position=464, length=8
            RouteInfoChar_39: start-position=472, length=8
            RouteInfoChar_40: start-position=480, length=8
            RouteInfoChar_41: start-position=488, length=8
            RouteInfoChar_42: start-position=496, length=8
            RouteInfoChar_43: start-position=504, length=8
      RESP_014_RADAR_FRONT_LONG_RANGE_TO_CENTRAL_GATEWAY: identifier=1550, frame-length=16
        pdu RESP_014_RADAR_FRONT_LONG_RANGE_TO_CENTRAL_GATEWAY_PDU: sender=RADAR_FRONT_LONG_RANGE, receiver=CENTRAL_GATEWAY
          12 x i signal:
            CRC8: start-position=0, length=8
            ResponseCounter: start-position=8, length=4
            AckState: start-position=12, length=4
            ReceivedFrameId: start-position=16, length=11
            ReceivedCounter: start-position=27, length=4
            ChecksumOk: start-position=31, length=1
            PayloadLength: start-position=32, length=8
            ErrorCode: start-position=40, length=8
            ProcessingTimeUs: start-position=48, length=16
            ResponseSequence: start-position=64, length=16
            ReceivedCrc: start-position=80, length=8
            CalculatedCrc: start-position=88, length=8
      DATA_015_CENTRAL_GATEWAY_SYNC_TIME_TO_RADAR_REAR_CORNER_LEFT: identifier=399, frame-length=64
        pdu DATA_015_CENTRAL_GATEWAY_SYNC_TIME_TO_RADAR_REAR_CORNER_LEFT_PDU: sender=CENTRAL_GATEWAY, receiver=RADAR_REAR_CORNER_LEFT
          59 x i signal:
            CRC8: start-position=0, length=8
            AliveCounter: start-position=8, length=4
            MuxState: start-position=12, length=4
            SIG_00: start-position=16, length=12
            SIG_01: start-position=28, length=12
            SIG_02: start-position=40, length=12
            SIG_03: start-position=52, length=12
            SIG_04: start-position=64, length=12
            SIG_05: start-position=76, length=12
            SIG_06: start-position=88, length=12
            SIG_07: start-position=100, length=12
            SIG_08: start-position=112, length=12
            SIG_09: start-position=124, length=12
            SIG_10: start-position=136, length=12
            SIG_11: start-position=148, length=12
            RouteInfoChar_00: start-position=160, length=8
            RouteInfoChar_01: start-position=168, length=8
            RouteInfoChar_02: start-position=176, length=8
            RouteInfoChar_03: start-position=184, length=8
            RouteInfoChar_04: start-position=192, length=8
            RouteInfoChar_05: start-position=200, length=8
            RouteInfoChar_06: start-position=208, length=8
            RouteInfoChar_07: start-position=216, length=8
            RouteInfoChar_08: start-position=224, length=8
            RouteInfoChar_09: start-position=232, length=8
            RouteInfoChar_10: start-position=240, length=8
            RouteInfoChar_11: start-position=248, length=8
            RouteInfoChar_12: start-position=256, length=8
            RouteInfoChar_13: start-position=264, length=8
            RouteInfoChar_14: start-position=272, length=8
            RouteInfoChar_15: start-position=280, length=8
            RouteInfoChar_16: start-position=288, length=8
            RouteInfoChar_17: start-position=296, length=8
            RouteInfoChar_18: start-position=304, length=8
            RouteInfoChar_19: start-position=312, length=8
            RouteInfoChar_20: start-position=320, length=8
            RouteInfoChar_21: start-position=328, length=8
            RouteInfoChar_22: start-position=336, length=8
            RouteInfoChar_23: start-position=344, length=8
            RouteInfoChar_24: start-position=352, length=8
            RouteInfoChar_25: start-position=360, length=8
            RouteInfoChar_26: start-position=368, length=8
            RouteInfoChar_27: start-position=376, length=8
            RouteInfoChar_28: start-position=384, length=8
            RouteInfoChar_29: start-position=392, length=8
            RouteInfoChar_30: start-position=400, length=8
            RouteInfoChar_31: start-position=408, length=8
            RouteInfoChar_32: start-position=416, length=8
            RouteInfoChar_33: start-position=424, length=8
            RouteInfoChar_34: start-position=432, length=8
            RouteInfoChar_35: start-position=440, length=8
            RouteInfoChar_36: start-position=448, length=8
            RouteInfoChar_37: start-position=456, length=8
            RouteInfoChar_38: start-position=464, length=8
            RouteInfoChar_39: start-position=472, length=8
            RouteInfoChar_40: start-position=480, length=8
            RouteInfoChar_41: start-position=488, length=8
            RouteInfoChar_42: start-position=496, length=8
            RouteInfoChar_43: start-position=504, length=8
      RESP_015_RADAR_REAR_CORNER_LEFT_TO_CENTRAL_GATEWAY: identifier=1551, frame-length=16
        pdu RESP_015_RADAR_REAR_CORNER_LEFT_TO_CENTRAL_GATEWAY_PDU: sender=RADAR_REAR_CORNER_LEFT, receiver=CENTRAL_GATEWAY
          12 x i signal:
            CRC8: start-position=0, length=8
            ResponseCounter: start-position=8, length=4
            AckState: start-position=12, length=4
            ReceivedFrameId: start-position=16, length=11
            ReceivedCounter: start-position=27, length=4
            ChecksumOk: start-position=31, length=1
            PayloadLength: start-position=32, length=8
            ErrorCode: start-position=40, length=8
            ProcessingTimeUs: start-position=48, length=16
            ResponseSequence: start-position=64, length=16
            ReceivedCrc: start-position=80, length=8
            CalculatedCrc: start-position=88, length=8
      DATA_016_CENTRAL_GATEWAY_SYNC_TIME_TO_IMU_YAW_RATE_SENSOR: identifier=400, frame-length=64
        pdu DATA_016_CENTRAL_GATEWAY_SYNC_TIME_TO_IMU_YAW_RATE_SENSOR_PDU: sender=CENTRAL_GATEWAY, receiver=IMU_YAW_RATE_SENSOR
          59 x i signal:
            CRC8: start-position=0, length=8
            AliveCounter: start-position=8, length=4
            MuxState: start-position=12, length=4
            SIG_00: start-position=16, length=12
            SIG_01: start-position=28, length=12
            SIG_02: start-position=40, length=12
            SIG_03: start-position=52, length=12
            SIG_04: start-position=64, length=12
            SIG_05: start-position=76, length=12
            SIG_06: start-position=88, length=12
            SIG_07: start-position=100, length=12
            SIG_08: start-position=112, length=12
            SIG_09: start-position=124, length=12
            SIG_10: start-position=136, length=12
            SIG_11: start-position=148, length=12
            RouteInfoChar_00: start-position=160, length=8
            RouteInfoChar_01: start-position=168, length=8
            RouteInfoChar_02: start-position=176, length=8
            RouteInfoChar_03: start-position=184, length=8
            RouteInfoChar_04: start-position=192, length=8
            RouteInfoChar_05: start-position=200, length=8
            RouteInfoChar_06: start-position=208, length=8
            RouteInfoChar_07: start-position=216, length=8
            RouteInfoChar_08: start-position=224, length=8
            RouteInfoChar_09: start-position=232, length=8
            RouteInfoChar_10: start-position=240, length=8
            RouteInfoChar_11: start-position=248, length=8
            RouteInfoChar_12: start-position=256, length=8
            RouteInfoChar_13: start-position=264, length=8
            RouteInfoChar_14: start-position=272, length=8
            RouteInfoChar_15: start-position=280, length=8
            RouteInfoChar_16: start-position=288, length=8
            RouteInfoChar_17: start-position=296, length=8
            RouteInfoChar_18: start-position=304, length=8
            RouteInfoChar_19: start-position=312, length=8
            RouteInfoChar_20: start-position=320, length=8
            RouteInfoChar_21: start-position=328, length=8
            RouteInfoChar_22: start-position=336, length=8
            RouteInfoChar_23: start-position=344, length=8
            RouteInfoChar_24: start-position=352, length=8
            RouteInfoChar_25: start-position=360, length=8
            RouteInfoChar_26: start-position=368, length=8
            RouteInfoChar_27: start-position=376, length=8
            RouteInfoChar_28: start-position=384, length=8
            RouteInfoChar_29: start-position=392, length=8
            RouteInfoChar_30: start-position=400, length=8
            RouteInfoChar_31: start-position=408, length=8
            RouteInfoChar_32: start-position=416, length=8
            RouteInfoChar_33: start-position=424, length=8
            RouteInfoChar_34: start-position=432, length=8
            RouteInfoChar_35: start-position=440, length=8
            RouteInfoChar_36: start-position=448, length=8
            RouteInfoChar_37: start-position=456, length=8
            RouteInfoChar_38: start-position=464, length=8
            RouteInfoChar_39: start-position=472, length=8
            RouteInfoChar_40: start-position=480, length=8
            RouteInfoChar_41: start-position=488, length=8
            RouteInfoChar_42: start-position=496, length=8
            RouteInfoChar_43: start-position=504, length=8
      RESP_016_IMU_YAW_RATE_SENSOR_TO_CENTRAL_GATEWAY: identifier=1552, frame-length=16
        pdu RESP_016_IMU_YAW_RATE_SENSOR_TO_CENTRAL_GATEWAY_PDU: sender=IMU_YAW_RATE_SENSOR, receiver=CENTRAL_GATEWAY
          12 x i signal:
            CRC8: start-position=0, length=8
            ResponseCounter: start-position=8, length=4
            AckState: start-position=12, length=4
            ReceivedFrameId: start-position=16, length=11
            ReceivedCounter: start-position=27, length=4
            ChecksumOk: start-position=31, length=1
            PayloadLength: start-position=32, length=8
            ErrorCode: start-position=40, length=8
            ProcessingTimeUs: start-position=48, length=16
            ResponseSequence: start-position=64, length=16
            ReceivedCrc: start-position=80, length=8
            CalculatedCrc: start-position=88, length=8
      DATA_017_CENTRAL_GATEWAY_SYNC_TIME_TO_LIDAR_FRONT: identifier=401, frame-length=64
        pdu DATA_017_CENTRAL_GATEWAY_SYNC_TIME_TO_LIDAR_FRONT_PDU: sender=CENTRAL_GATEWAY, receiver=LIDAR_FRONT
          59 x i signal:
            CRC8: start-position=0, length=8
            AliveCounter: start-position=8, length=4
            MuxState: start-position=12, length=4
            SIG_00: start-position=16, length=12
            SIG_01: start-position=28, length=12
            SIG_02: start-position=40, length=12
            SIG_03: start-position=52, length=12
            SIG_04: start-position=64, length=12
            SIG_05: start-position=76, length=12
            SIG_06: start-position=88, length=12
            SIG_07: start-position=100, length=12
            SIG_08: start-position=112, length=12
            SIG_09: start-position=124, length=12
            SIG_10: start-position=136, length=12
            SIG_11: start-position=148, length=12
            RouteInfoChar_00: start-position=160, length=8
            RouteInfoChar_01: start-position=168, length=8
            RouteInfoChar_02: start-position=176, length=8
            RouteInfoChar_03: start-position=184, length=8
            RouteInfoChar_04: start-position=192, length=8
            RouteInfoChar_05: start-position=200, length=8
            RouteInfoChar_06: start-position=208, length=8
            RouteInfoChar_07: start-position=216, length=8
            RouteInfoChar_08: start-position=224, length=8
            RouteInfoChar_09: start-position=232, length=8
            RouteInfoChar_10: start-position=240, length=8
            RouteInfoChar_11: start-position=248, length=8
            RouteInfoChar_12: start-position=256, length=8
            RouteInfoChar_13: start-position=264, length=8
            RouteInfoChar_14: start-position=272, length=8
            RouteInfoChar_15: start-position=280, length=8
            RouteInfoChar_16: start-position=288, length=8
            RouteInfoChar_17: start-position=296, length=8
            RouteInfoChar_18: start-position=304, length=8
            RouteInfoChar_19: start-position=312, length=8
            RouteInfoChar_20: start-position=320, length=8
            RouteInfoChar_21: start-position=328, length=8
            RouteInfoChar_22: start-position=336, length=8
            RouteInfoChar_23: start-position=344, length=8
            RouteInfoChar_24: start-position=352, length=8
            RouteInfoChar_25: start-position=360, length=8
            RouteInfoChar_26: start-position=368, length=8
            RouteInfoChar_27: start-position=376, length=8
            RouteInfoChar_28: start-position=384, length=8
            RouteInfoChar_29: start-position=392, length=8
            RouteInfoChar_30: start-position=400, length=8
            RouteInfoChar_31: start-position=408, length=8
            RouteInfoChar_32: start-position=416, length=8
            RouteInfoChar_33: start-position=424, length=8
            RouteInfoChar_34: start-position=432, length=8
            RouteInfoChar_35: start-position=440, length=8
            RouteInfoChar_36: start-position=448, length=8
            RouteInfoChar_37: start-position=456, length=8
            RouteInfoChar_38: start-position=464, length=8
            RouteInfoChar_39: start-position=472, length=8
            RouteInfoChar_40: start-position=480, length=8
            RouteInfoChar_41: start-position=488, length=8
            RouteInfoChar_42: start-position=496, length=8
            RouteInfoChar_43: start-position=504, length=8
      RESP_017_LIDAR_FRONT_TO_CENTRAL_GATEWAY: identifier=1553, frame-length=16
        pdu RESP_017_LIDAR_FRONT_TO_CENTRAL_GATEWAY_PDU: sender=LIDAR_FRONT, receiver=CENTRAL_GATEWAY
          12 x i signal:
            CRC8: start-position=0, length=8
            ResponseCounter: start-position=8, length=4
            AckState: start-position=12, length=4
            ReceivedFrameId: start-position=16, length=11
            ReceivedCounter: start-position=27, length=4
            ChecksumOk: start-position=31, length=1
            PayloadLength: start-position=32, length=8
            ErrorCode: start-position=40, length=8
            ProcessingTimeUs: start-position=48, length=16
            ResponseSequence: start-position=64, length=16
            ReceivedCrc: start-position=80, length=8
            CalculatedCrc: start-position=88, length=8
      DATA_018_CENTRAL_GATEWAY_SYNC_TIME_TO_AMBIENT_TEMP_SENSOR: identifier=402, frame-length=64
        pdu DATA_018_CENTRAL_GATEWAY_SYNC_TIME_TO_AMBIENT_TEMP_SENSOR_PDU: sender=CENTRAL_GATEWAY, receiver=AMBIENT_TEMP_SENSOR
          59 x i signal:
            CRC8: start-position=0, length=8
            AliveCounter: start-position=8, length=4
            MuxState: start-position=12, length=4
            SIG_00: start-position=16, length=12
            SIG_01: start-position=28, length=12
            SIG_02: start-position=40, length=12
            SIG_03: start-position=52, length=12
            SIG_04: start-position=64, length=12
            SIG_05: start-position=76, length=12
            SIG_06: start-position=88, length=12
            SIG_07: start-position=100, length=12
            SIG_08: start-position=112, length=12
            SIG_09: start-position=124, length=12
            SIG_10: start-position=136, length=12
            SIG_11: start-position=148, length=12
            RouteInfoChar_00: start-position=160, length=8
            RouteInfoChar_01: start-position=168, length=8
            RouteInfoChar_02: start-position=176, length=8
            RouteInfoChar_03: start-position=184, length=8
            RouteInfoChar_04: start-position=192, length=8
            RouteInfoChar_05: start-position=200, length=8
            RouteInfoChar_06: start-position=208, length=8
            RouteInfoChar_07: start-position=216, length=8
            RouteInfoChar_08: start-position=224, length=8
            RouteInfoChar_09: start-position=232, length=8
            RouteInfoChar_10: start-position=240, length=8
            RouteInfoChar_11: start-position=248, length=8
            RouteInfoChar_12: start-position=256, length=8
            RouteInfoChar_13: start-position=264, length=8
            RouteInfoChar_14: start-position=272, length=8
            RouteInfoChar_15: start-position=280, length=8
            RouteInfoChar_16: start-position=288, length=8
            RouteInfoChar_17: start-position=296, length=8
            RouteInfoChar_18: start-position=304, length=8
            RouteInfoChar_19: start-position=312, length=8
            RouteInfoChar_20: start-position=320, length=8
            RouteInfoChar_21: start-position=328, length=8
            RouteInfoChar_22: start-position=336, length=8
            RouteInfoChar_23: start-position=344, length=8
            RouteInfoChar_24: start-position=352, length=8
            RouteInfoChar_25: start-position=360, length=8
            RouteInfoChar_26: start-position=368, length=8
            RouteInfoChar_27: start-position=376, length=8
            RouteInfoChar_28: start-position=384, length=8
            RouteInfoChar_29: start-position=392, length=8
            RouteInfoChar_30: start-position=400, length=8
            RouteInfoChar_31: start-position=408, length=8
            RouteInfoChar_32: start-position=416, length=8
            RouteInfoChar_33: start-position=424, length=8
            RouteInfoChar_34: start-position=432, length=8
            RouteInfoChar_35: start-position=440, length=8
            RouteInfoChar_36: start-position=448, length=8
            RouteInfoChar_37: start-position=456, length=8
            RouteInfoChar_38: start-position=464, length=8
            RouteInfoChar_39: start-position=472, length=8
            RouteInfoChar_40: start-position=480, length=8
            RouteInfoChar_41: start-position=488, length=8
            RouteInfoChar_42: start-position=496, length=8
            RouteInfoChar_43: start-position=504, length=8
      RESP_018_AMBIENT_TEMP_SENSOR_TO_CENTRAL_GATEWAY: identifier=1554, frame-length=16
        pdu RESP_018_AMBIENT_TEMP_SENSOR_TO_CENTRAL_GATEWAY_PDU: sender=AMBIENT_TEMP_SENSOR, receiver=CENTRAL_GATEWAY
          12 x i signal:
            CRC8: start-position=0, length=8
            ResponseCounter: start-position=8, length=4
            AckState: start-position=12, length=4
            ReceivedFrameId: start-position=16, length=11
            ReceivedCounter: start-position=27, length=4
            ChecksumOk: start-position=31, length=1
            PayloadLength: start-position=32, length=8
            ErrorCode: start-position=40, length=8
            ProcessingTimeUs: start-position=48, length=16
            ResponseSequence: start-position=64, length=16
            ReceivedCrc: start-position=80, length=8
            CalculatedCrc: start-position=88, length=8
      DATA_019_CENTRAL_GATEWAY_SYNC_TIME_TO_ADAS_ECU_TEMP_SENSOR: identifier=403, frame-length=64
        pdu DATA_019_CENTRAL_GATEWAY_SYNC_TIME_TO_ADAS_ECU_TEMP_SENSOR_PDU: sender=CENTRAL_GATEWAY, receiver=ADAS_ECU_TEMP_SENSOR
          59 x i signal:
            CRC8: start-position=0, length=8
            AliveCounter: start-position=8, length=4
            MuxState: start-position=12, length=4
            SIG_00: start-position=16, length=12
            SIG_01: start-position=28, length=12
            SIG_02: start-position=40, length=12
            SIG_03: start-position=52, length=12
            SIG_04: start-position=64, length=12
            SIG_05: start-position=76, length=12
            SIG_06: start-position=88, length=12
            SIG_07: start-position=100, length=12
            SIG_08: start-position=112, length=12
            SIG_09: start-position=124, length=12
            SIG_10: start-position=136, length=12
            SIG_11: start-position=148, length=12
            RouteInfoChar_00: start-position=160, length=8
            RouteInfoChar_01: start-position=168, length=8
            RouteInfoChar_02: start-position=176, length=8
            RouteInfoChar_03: start-position=184, length=8
            RouteInfoChar_04: start-position=192, length=8
            RouteInfoChar_05: start-position=200, length=8
            RouteInfoChar_06: start-position=208, length=8
            RouteInfoChar_07: start-position=216, length=8
            RouteInfoChar_08: start-position=224, length=8
            RouteInfoChar_09: start-position=232, length=8
            RouteInfoChar_10: start-position=240, length=8
            RouteInfoChar_11: start-position=248, length=8
            RouteInfoChar_12: start-position=256, length=8
            RouteInfoChar_13: start-position=264, length=8
            RouteInfoChar_14: start-position=272, length=8
            RouteInfoChar_15: start-position=280, length=8
            RouteInfoChar_16: start-position=288, length=8
            RouteInfoChar_17: start-position=296, length=8
            RouteInfoChar_18: start-position=304, length=8
            RouteInfoChar_19: start-position=312, length=8
            RouteInfoChar_20: start-position=320, length=8
            RouteInfoChar_21: start-position=328, length=8
            RouteInfoChar_22: start-position=336, length=8
            RouteInfoChar_23: start-position=344, length=8
            RouteInfoChar_24: start-position=352, length=8
            RouteInfoChar_25: start-position=360, length=8
            RouteInfoChar_26: start-position=368, length=8
            RouteInfoChar_27: start-position=376, length=8
            RouteInfoChar_28: start-position=384, length=8
            RouteInfoChar_29: start-position=392, length=8
            RouteInfoChar_30: start-position=400, length=8
            RouteInfoChar_31: start-position=408, length=8
            RouteInfoChar_32: start-position=416, length=8
            RouteInfoChar_33: start-position=424, length=8
            RouteInfoChar_34: start-position=432, length=8
            RouteInfoChar_35: start-position=440, length=8
            RouteInfoChar_36: start-position=448, length=8
            RouteInfoChar_37: start-position=456, length=8
            RouteInfoChar_38: start-position=464, length=8
            RouteInfoChar_39: start-position=472, length=8
            RouteInfoChar_40: start-position=480, length=8
            RouteInfoChar_41: start-position=488, length=8
            RouteInfoChar_42: start-position=496, length=8
            RouteInfoChar_43: start-position=504, length=8
      RESP_019_ADAS_ECU_TEMP_SENSOR_TO_CENTRAL_GATEWAY: identifier=1555, frame-length=16
        pdu RESP_019_ADAS_ECU_TEMP_SENSOR_TO_CENTRAL_GATEWAY_PDU: sender=ADAS_ECU_TEMP_SENSOR, receiver=CENTRAL_GATEWAY
          12 x i signal:
            CRC8: start-position=0, length=8
            ResponseCounter: start-position=8, length=4
            AckState: start-position=12, length=4
            ReceivedFrameId: start-position=16, length=11
            ReceivedCounter: start-position=27, length=4
            ChecksumOk: start-position=31, length=1
            PayloadLength: start-position=32, length=8
            ErrorCode: start-position=40, length=8
            ProcessingTimeUs: start-position=48, length=16
            ResponseSequence: start-position=64, length=16
            ReceivedCrc: start-position=80, length=8
            CalculatedCrc: start-position=88, length=8
      DATA_020_DIAG_TESTER_DIAGNOSTIC_REQUEST_TO_CENTRAL_GATEWAY: identifier=404, frame-length=64
        pdu DATA_020_DIAG_TESTER_DIAGNOSTIC_REQUEST_TO_CENTRAL_GATEWAY_PDU: sender=DIAG_TESTER, receiver=CENTRAL_GATEWAY
          59 x i signal:
            CRC8: start-position=0, length=8
            AliveCounter: start-position=8, length=4
            MuxState: start-position=12, length=4
            SIG_00: start-position=16, length=12
            SIG_01: start-position=28, length=12
            SIG_02: start-position=40, length=12
            SIG_03: start-position=52, length=12
            SIG_04: start-position=64, length=12
            SIG_05: start-position=76, length=12
            SIG_06: start-position=88, length=12
            SIG_07: start-position=100, length=12
            SIG_08: start-position=112, length=12
            SIG_09: start-position=124, length=12
            SIG_10: start-position=136, length=12
            SIG_11: start-position=148, length=12
            RouteInfoChar_00: start-position=160, length=8
            RouteInfoChar_01: start-position=168, length=8
            RouteInfoChar_02: start-position=176, length=8
            RouteInfoChar_03: start-position=184, length=8
            RouteInfoChar_04: start-position=192, length=8
            RouteInfoChar_05: start-position=200, length=8
            RouteInfoChar_06: start-position=208, length=8
            RouteInfoChar_07: start-position=216, length=8
            RouteInfoChar_08: start-position=224, length=8
            RouteInfoChar_09: start-position=232, length=8
            RouteInfoChar_10: start-position=240, length=8
            RouteInfoChar_11: start-position=248, length=8
            RouteInfoChar_12: start-position=256, length=8
            RouteInfoChar_13: start-position=264, length=8
            RouteInfoChar_14: start-position=272, length=8
            RouteInfoChar_15: start-position=280, length=8
            RouteInfoChar_16: start-position=288, length=8
            RouteInfoChar_17: start-position=296, length=8
            RouteInfoChar_18: start-position=304, length=8
            RouteInfoChar_19: start-position=312, length=8
            RouteInfoChar_20: start-position=320, length=8
            RouteInfoChar_21: start-position=328, length=8
            RouteInfoChar_22: start-position=336, length=8
            RouteInfoChar_23: start-position=344, length=8
            RouteInfoChar_24: start-position=352, length=8
            RouteInfoChar_25: start-position=360, length=8
            RouteInfoChar_26: start-position=368, length=8
            RouteInfoChar_27: start-position=376, length=8
            RouteInfoChar_28: start-position=384, length=8
            RouteInfoChar_29: start-position=392, length=8
            RouteInfoChar_30: start-position=400, length=8
            RouteInfoChar_31: start-position=408, length=8
            RouteInfoChar_32: start-position=416, length=8
            RouteInfoChar_33: start-position=424, length=8
            RouteInfoChar_34: start-position=432, length=8
            RouteInfoChar_35: start-position=440, length=8
            RouteInfoChar_36: start-position=448, length=8
            RouteInfoChar_37: start-position=456, length=8
            RouteInfoChar_38: start-position=464, length=8
            RouteInfoChar_39: start-position=472, length=8
            RouteInfoChar_40: start-position=480, length=8
            RouteInfoChar_41: start-position=488, length=8
            RouteInfoChar_42: start-position=496, length=8
            RouteInfoChar_43: start-position=504, length=8
      RESP_020_CENTRAL_GATEWAY_TO_DIAG_TESTER: identifier=1556, frame-length=16
        pdu RESP_020_CENTRAL_GATEWAY_TO_DIAG_TESTER_PDU: sender=CENTRAL_GATEWAY, receiver=DIAG_TESTER
          12 x i signal:
            CRC8: start-position=0, length=8
            ResponseCounter: start-position=8, length=4
            AckState: start-position=12, length=4
            ReceivedFrameId: start-position=16, length=11
            ReceivedCounter: start-position=27, length=4
            ChecksumOk: start-position=31, length=1
            PayloadLength: start-position=32, length=8
            ErrorCode: start-position=40, length=8
            ProcessingTimeUs: start-position=48, length=16
            ResponseSequence: start-position=64, length=16
            ReceivedCrc: start-position=80, length=8
            CalculatedCrc: start-position=88, length=8
      DATA_021_LIDAR_FRONT_OBJECT_LIST_TO_ADAS_DOMAIN: identifier=405, frame-length=64
        pdu DATA_021_LIDAR_FRONT_OBJECT_LIST_TO_ADAS_DOMAIN_PDU: sender=LIDAR_FRONT, receiver=ADAS_DOMAIN
          59 x i signal:
            CRC8: start-position=0, length=8
            AliveCounter: start-position=8, length=4
            MuxState: start-position=12, length=4
            SIG_00: start-position=16, length=12
            SIG_01: start-position=28, length=12
            SIG_02: start-position=40, length=12
            SIG_03: start-position=52, length=12
            SIG_04: start-position=64, length=12
            SIG_05: start-position=76, length=12
            SIG_06: start-position=88, length=12
            SIG_07: start-position=100, length=12
            SIG_08: start-position=112, length=12
            SIG_09: start-position=124, length=12
            SIG_10: start-position=136, length=12
            SIG_11: start-position=148, length=12
            RouteInfoChar_00: start-position=160, length=8
            RouteInfoChar_01: start-position=168, length=8
            RouteInfoChar_02: start-position=176, length=8
            RouteInfoChar_03: start-position=184, length=8
            RouteInfoChar_04: start-position=192, length=8
            RouteInfoChar_05: start-position=200, length=8
            RouteInfoChar_06: start-position=208, length=8
            RouteInfoChar_07: start-position=216, length=8
            RouteInfoChar_08: start-position=224, length=8
            RouteInfoChar_09: start-position=232, length=8
            RouteInfoChar_10: start-position=240, length=8
            RouteInfoChar_11: start-position=248, length=8
            RouteInfoChar_12: start-position=256, length=8
            RouteInfoChar_13: start-position=264, length=8
            RouteInfoChar_14: start-position=272, length=8
            RouteInfoChar_15: start-position=280, length=8
            RouteInfoChar_16: start-position=288, length=8
            RouteInfoChar_17: start-position=296, length=8
            RouteInfoChar_18: start-position=304, length=8
            RouteInfoChar_19: start-position=312, length=8
            RouteInfoChar_20: start-position=320, length=8
            RouteInfoChar_21: start-position=328, length=8
            RouteInfoChar_22: start-position=336, length=8
            RouteInfoChar_23: start-position=344, length=8
            RouteInfoChar_24: start-position=352, length=8
            RouteInfoChar_25: start-position=360, length=8
            RouteInfoChar_26: start-position=368, length=8
            RouteInfoChar_27: start-position=376, length=8
            RouteInfoChar_28: start-position=384, length=8
            RouteInfoChar_29: start-position=392, length=8
            RouteInfoChar_30: start-position=400, length=8
            RouteInfoChar_31: start-position=408, length=8
            RouteInfoChar_32: start-position=416, length=8
            RouteInfoChar_33: start-position=424, length=8
            RouteInfoChar_34: start-position=432, length=8
            RouteInfoChar_35: start-position=440, length=8
            RouteInfoChar_36: start-position=448, length=8
            RouteInfoChar_37: start-position=456, length=8
            RouteInfoChar_38: start-position=464, length=8
            RouteInfoChar_39: start-position=472, length=8
            RouteInfoChar_40: start-position=480, length=8
            RouteInfoChar_41: start-position=488, length=8
            RouteInfoChar_42: start-position=496, length=8
            RouteInfoChar_43: start-position=504, length=8
      RESP_021_ADAS_DOMAIN_TO_LIDAR_FRONT: identifier=1557, frame-length=16
        pdu RESP_021_ADAS_DOMAIN_TO_LIDAR_FRONT_PDU: sender=ADAS_DOMAIN, receiver=LIDAR_FRONT
          12 x i signal:
            CRC8: start-position=0, length=8
            ResponseCounter: start-position=8, length=4
            AckState: start-position=12, length=4
            ReceivedFrameId: start-position=16, length=11
            ReceivedCounter: start-position=27, length=4
            ChecksumOk: start-position=31, length=1
            PayloadLength: start-position=32, length=8
            ErrorCode: start-position=40, length=8
            ProcessingTimeUs: start-position=48, length=16
            ResponseSequence: start-position=64, length=16
            ReceivedCrc: start-position=80, length=8
            CalculatedCrc: start-position=88, length=8
      DATA_022_AMBIENT_TEMP_SENSOR_AMBIENT_TEMPERATURE_TO_CENTRAL_GATEWAY: identifier=406, frame-length=64
        pdu DATA_022_AMBIENT_TEMP_SENSOR_AMBIENT_TEMPERATURE_TO_CENTRAL_GATEWAY_PDU: sender=AMBIENT_TEMP_SENSOR, receiver=CENTRAL_GATEWAY
          59 x i signal:
            CRC8: start-position=0, length=8
            AliveCounter: start-position=8, length=4
            MuxState: start-position=12, length=4
            SIG_00: start-position=16, length=12
            SIG_01: start-position=28, length=12
            SIG_02: start-position=40, length=12
            SIG_03: start-position=52, length=12
            SIG_04: start-position=64, length=12
            SIG_05: start-position=76, length=12
            SIG_06: start-position=88, length=12
            SIG_07: start-position=100, length=12
            SIG_08: start-position=112, length=12
            SIG_09: start-position=124, length=12
            SIG_10: start-position=136, length=12
            SIG_11: start-position=148, length=12
            RouteInfoChar_00: start-position=160, length=8
            RouteInfoChar_01: start-position=168, length=8
            RouteInfoChar_02: start-position=176, length=8
            RouteInfoChar_03: start-position=184, length=8
            RouteInfoChar_04: start-position=192, length=8
            RouteInfoChar_05: start-position=200, length=8
            RouteInfoChar_06: start-position=208, length=8
            RouteInfoChar_07: start-position=216, length=8
            RouteInfoChar_08: start-position=224, length=8
            RouteInfoChar_09: start-position=232, length=8
            RouteInfoChar_10: start-position=240, length=8
            RouteInfoChar_11: start-position=248, length=8
            RouteInfoChar_12: start-position=256, length=8
            RouteInfoChar_13: start-position=264, length=8
            RouteInfoChar_14: start-position=272, length=8
            RouteInfoChar_15: start-position=280, length=8
            RouteInfoChar_16: start-position=288, length=8
            RouteInfoChar_17: start-position=296, length=8
            RouteInfoChar_18: start-position=304, length=8
            RouteInfoChar_19: start-position=312, length=8
            RouteInfoChar_20: start-position=320, length=8
            RouteInfoChar_21: start-position=328, length=8
            RouteInfoChar_22: start-position=336, length=8
            RouteInfoChar_23: start-position=344, length=8
            RouteInfoChar_24: start-position=352, length=8
            RouteInfoChar_25: start-position=360, length=8
            RouteInfoChar_26: start-position=368, length=8
            RouteInfoChar_27: start-position=376, length=8
            RouteInfoChar_28: start-position=384, length=8
            RouteInfoChar_29: start-position=392, length=8
            RouteInfoChar_30: start-position=400, length=8
            RouteInfoChar_31: start-position=408, length=8
            RouteInfoChar_32: start-position=416, length=8
            RouteInfoChar_33: start-position=424, length=8
            RouteInfoChar_34: start-position=432, length=8
            RouteInfoChar_35: start-position=440, length=8
            RouteInfoChar_36: start-position=448, length=8
            RouteInfoChar_37: start-position=456, length=8
            RouteInfoChar_38: start-position=464, length=8
            RouteInfoChar_39: start-position=472, length=8
            RouteInfoChar_40: start-position=480, length=8
            RouteInfoChar_41: start-position=488, length=8
            RouteInfoChar_42: start-position=496, length=8
            RouteInfoChar_43: start-position=504, length=8
      RESP_022_CENTRAL_GATEWAY_TO_AMBIENT_TEMP_SENSOR: identifier=1558, frame-length=16
        pdu RESP_022_CENTRAL_GATEWAY_TO_AMBIENT_TEMP_SENSOR_PDU: sender=CENTRAL_GATEWAY, receiver=AMBIENT_TEMP_SENSOR
          12 x i signal:
            CRC8: start-position=0, length=8
            ResponseCounter: start-position=8, length=4
            AckState: start-position=12, length=4
            ReceivedFrameId: start-position=16, length=11
            ReceivedCounter: start-position=27, length=4
            ChecksumOk: start-position=31, length=1
            PayloadLength: start-position=32, length=8
            ErrorCode: start-position=40, length=8
            ProcessingTimeUs: start-position=48, length=16
            ResponseSequence: start-position=64, length=16
            ReceivedCrc: start-position=80, length=8
            CalculatedCrc: start-position=88, length=8
      DATA_023_ADAS_ECU_TEMP_SENSOR_ECU_TEMPERATURE_TO_CENTRAL_GATEWAY: identifier=407, frame-length=64
        pdu DATA_023_ADAS_ECU_TEMP_SENSOR_ECU_TEMPERATURE_TO_CENTRAL_GATEWAY_PDU: sender=ADAS_ECU_TEMP_SENSOR, receiver=CENTRAL_GATEWAY
          59 x i signal:
            CRC8: start-position=0, length=8
            AliveCounter: start-position=8, length=4
            MuxState: start-position=12, length=4
            SIG_00: start-position=16, length=12
            SIG_01: start-position=28, length=12
            SIG_02: start-position=40, length=12
            SIG_03: start-position=52, length=12
            SIG_04: start-position=64, length=12
            SIG_05: start-position=76, length=12
            SIG_06: start-position=88, length=12
            SIG_07: start-position=100, length=12
            SIG_08: start-position=112, length=12
            SIG_09: start-position=124, length=12
            SIG_10: start-position=136, length=12
            SIG_11: start-position=148, length=12
            RouteInfoChar_00: start-position=160, length=8
            RouteInfoChar_01: start-position=168, length=8
            RouteInfoChar_02: start-position=176, length=8
            RouteInfoChar_03: start-position=184, length=8
            RouteInfoChar_04: start-position=192, length=8
            RouteInfoChar_05: start-position=200, length=8
            RouteInfoChar_06: start-position=208, length=8
            RouteInfoChar_07: start-position=216, length=8
            RouteInfoChar_08: start-position=224, length=8
            RouteInfoChar_09: start-position=232, length=8
            RouteInfoChar_10: start-position=240, length=8
            RouteInfoChar_11: start-position=248, length=8
            RouteInfoChar_12: start-position=256, length=8
            RouteInfoChar_13: start-position=264, length=8
            RouteInfoChar_14: start-position=272, length=8
            RouteInfoChar_15: start-position=280, length=8
            RouteInfoChar_16: start-position=288, length=8
            RouteInfoChar_17: start-position=296, length=8
            RouteInfoChar_18: start-position=304, length=8
            RouteInfoChar_19: start-position=312, length=8
            RouteInfoChar_20: start-position=320, length=8
            RouteInfoChar_21: start-position=328, length=8
            RouteInfoChar_22: start-position=336, length=8
            RouteInfoChar_23: start-position=344, length=8
            RouteInfoChar_24: start-position=352, length=8
            RouteInfoChar_25: start-position=360, length=8
            RouteInfoChar_26: start-position=368, length=8
            RouteInfoChar_27: start-position=376, length=8
            RouteInfoChar_28: start-position=384, length=8
            RouteInfoChar_29: start-position=392, length=8
            RouteInfoChar_30: start-position=400, length=8
            RouteInfoChar_31: start-position=408, length=8
            RouteInfoChar_32: start-position=416, length=8
            RouteInfoChar_33: start-position=424, length=8
            RouteInfoChar_34: start-position=432, length=8
            RouteInfoChar_35: start-position=440, length=8
            RouteInfoChar_36: start-position=448, length=8
            RouteInfoChar_37: start-position=456, length=8
            RouteInfoChar_38: start-position=464, length=8
            RouteInfoChar_39: start-position=472, length=8
            RouteInfoChar_40: start-position=480, length=8
            RouteInfoChar_41: start-position=488, length=8
            RouteInfoChar_42: start-position=496, length=8
            RouteInfoChar_43: start-position=504, length=8
      RESP_023_CENTRAL_GATEWAY_TO_ADAS_ECU_TEMP_SENSOR: identifier=1559, frame-length=16
        pdu RESP_023_CENTRAL_GATEWAY_TO_ADAS_ECU_TEMP_SENSOR_PDU: sender=CENTRAL_GATEWAY, receiver=ADAS_ECU_TEMP_SENSOR
          12 x i signal:
            CRC8: start-position=0, length=8
            ResponseCounter: start-position=8, length=4
            AckState: start-position=12, length=4
            ReceivedFrameId: start-position=16, length=11
            ReceivedCounter: start-position=27, length=4
            ChecksumOk: start-position=31, length=1
            PayloadLength: start-position=32, length=8
            ErrorCode: start-position=40, length=8
            ProcessingTimeUs: start-position=48, length=16
            ResponseSequence: start-position=64, length=16
            ReceivedCrc: start-position=80, length=8
            CalculatedCrc: start-position=88, length=8
